## prj.conf
```kconfig
# =========================================================
# MINIMAL SYSTEM
# =========================================================

CONFIG_PRINTK=y
CONFIG_CONSOLE=y
CONFIG_UART_CONSOLE=y

# =========================================================
# LOGGING (minimal)
# =========================================================

CONFIG_LOG=y
CONFIG_LOG_BACKEND_UART=y
CONFIG_LOG_MODE_IMMEDIATE=y

# =========================================================
# LTE LINK CONTROL DEBUG
# =========================================================
CONFIG_LTE_LINK_CONTROL_LOG_LEVEL_DBG=y

# =========================================================
# AT MONITOR (optional but useful)
# =========================================================

CONFIG_AT_MONITOR=y
CONFIG_AT_MONITOR_LOG_LEVEL_DBG=y

# =========================================================
# MODEM / Nordic
# =========================================================

CONFIG_NRF_MODEM_LIB=y
CONFIG_MODEM_INFO=y

# =========================================================
# MODEM / Link control
# =========================================================
CONFIG_LTE_LINK_CONTROL=y
CONFIG_LTE_LINK_CONTROL_LOG_LEVEL_DBG=y

# =========================================================
# NETWORK
# =========================================================

CONFIG_NETWORKING=y
CONFIG_NET_SOCKETS=y
CONFIG_NET_IPV4=y
CONFIG_NET_TCP=y

# =========================================================
# Stacks
# =========================================================
CONFIG_SYSTEM_WORKQUEUE_STACK_SIZE=2048
CONFIG_NET_SOCKETS_SERVICE_STACK_SIZE=2048

CONFIG_MAIN_STACK_SIZE=10240
CONFIG_HEAP_MEM_POOL_SIZE=10240

#CONFIG_NET_SOCKETS_SERVICE_STACK_SIZE=4096
#CONFIG_SYSTEM_WORKQUEUE_STACK_SIZE=4096

CONFIG_AT_MONITOR_HEAP_SIZE=4096


# =========================================================
# DNS
# =========================================================

CONFIG_DNS_RESOLVER=y

# STCP
CONFIG_STCP=y
CONFIG_STCP_DEBUG=y
CONFIG_STCP_DEBUG_LATENCY=n
CONFIG_STCP_SELFTEST=n

# STCP / Watchdog
CONFIG_STCP_WATCHDOG_ENABLE=n
CONFIG_STCP_WATCHDOG_MAX_TIMEOUT=1200
CONFIG_STCP_WATCHDOG_CHECK_INTERVAL=15

# STCP / AES
CONFIG_STCP_AES_BYPASS=n

# STCP / MQTT
CONFIG_MQTT_LIB=y
CONFIG_MQTT_LIB_STCP=y

# STCP / Status monitor & Statistics
CONFIG_STCP_STATUS_MONITOR=y
CONFIG_STCP_STATUS_MONITOR_STATISTICS=y
CONFIG_STCP_STATUS_MONITOR_LOG_INTERVAL=5

# STCP ISP's APN name
CONFIG_STCP_LTE_APN_NAME="internet"

# STCP networking: Where to connect
CONFIG_STCP_CONNECT_TO_HOST="lja.fi"
CONFIG_STCP_CONNECT_TO_PORT=7777


# STCP / testing
CONFIG_STCP_TESTING=y
# Sets debuggin on IF this is Y or if not then default is STCP_DEBUG setting
CONFIG_STCP_TESTING_LOG=y

# Disables testing debugs completely.
CONFIG_STCP_TESTING_LOG_COMPLETELY_OFF=n

CONFIG_STCP_TESTING_PEER_HOSTNAME_TO_CONNECT="lja.fi"
CONFIG_STCP_TESTING_PEER_PORT_TO_CONNECT=7777
# strftime format string 
CONFIG_STCP_TESTING_PAYLOAD_FORMAT="TErveppä terve! %Y-%m-%d %H:%M:%S ..."

# Testing mode 
CONFIG_STCP_TESTING_MODE=2

# Date-support for nice payload generation
# if user needs
CONFIG_DATE_TIME=y

# Power saving mode (=n)
CONFIG_LTE_PSM_REQ=n

# optimisations here
CONFIG_NET_BUF_RX_COUNT=8
CONFIG_NET_BUF_TX_COUNT=8
CONFIG_NET_PKT_RX_COUNT=4
CONFIG_NET_PKT_TX_COUNT=4
CONFIG_NET_MAX_CONTEXTS=4
CONFIG_NET_NATIVE=y
CONFIG_NET_OFFLOAD=y
CONFIG_NET_SOCKETS_OFFLOAD=y
CONFIG_NET_LOG=n
CONFIG_NET_TCP_LOG_LEVEL_OFF=y
CONFIG_NET_UDP_LOG_LEVEL_OFF=y
```

## src/main.c
```c
#include <zephyr/random/random.h>
#include <zephyr/kernel.h>
#include <zephyr/net/socket.h>
#include <errno.h>
#include <string.h>
#include <stdlib.h>
#include <zephyr/init.h>
#include <modem/lte_lc.h>

#include <zephyr/kernel.h>
#include <zephyr/sys/timeutil.h>
#include <zephyr/sys/heap_listener.h>
#include <zephyr/sys/sys_heap.h>
#include <zephyr/kernel.h>
#include <zephyr/net/mqtt.h>
#include <fcntl.h>

#include <stcp_api.h>
#include <stcp/settings.h>
#include <stcp/utils.h>
#include <stcp/dns.h>
#include "stcp_mqtt.h"
#include <stcp/debug.h>

#include "mqtt_demo_utils.h"


#if CONFIG_MQTT_LIB_STCP

extern int mqtt_connected;
extern struct mqtt_client client;
K_MUTEX_DEFINE(client_lock);

int stpc_mqtt_subscribe(struct mqtt_client *clientPtr)
{
    static char *subTo = "testi";

    MDBG("Subscribing .... waiting for CONNACK event (max %d ms)",
        STCP_MQTT_WAIT_CONNACK_EVENT_FOR_MSEC);

    int ACK = stcp_mqtt_wait_for_connak_event(STCP_MQTT_WAIT_CONNACK_EVENT_FOR_MSEC);

    // 0 == Success
    if (ACK) {
        MWRN("Got no ACK event in %d ms...", STCP_MQTT_WAIT_CONNACK_EVENT_FOR_MSEC);
        return -EAGAIN;
    }

    if (!mqtt_connected) {
        MDBG("Not connected => NOT subbing...");
        return -EAGAIN;
    }

    MDBGBIG("Subscribing starts...");

    MDBG("Client API: %p", clientPtr->transport.stcp.stcp_api_instance);
    MDBG("Client FD: %d", clientPtr->transport.stcp.sock);

    MDBG("Subscribing to %s", subTo);

    struct mqtt_topic subscribe_topic = {
        .topic = {
            .utf8 = subTo,
            .size = strlen(subTo),
        },
        .qos = MQTT_QOS_0_AT_MOST_ONCE
    };

    const struct mqtt_subscription_list subscription_list = {
        .list = &subscribe_topic,
        .list_count = 1,
        .message_id = 1
    };

        
    CLIENT_LOCK(&client_lock);
    int ret = mqtt_subscribe(clientPtr, &subscription_list);
    CLIENT_UNLOCK(&client_lock);

    MDBG("mqtt_subscribe ret: %d", ret);
    stcp_mqtt_reset_connak_event_seen();
    return ret;

}


void make_timestamp(char *out, size_t max_len)
{
    int64_t now_ms = k_uptime_get();

    time_t now_sec = now_ms / 1000;

    struct tm tm;
    gmtime_r(&now_sec, &tm);

    snprintf(out, max_len,
             "STCP DEBUG SENT AT %04d-%02d-%02dT%02d:%02d:%02dZ",
             tm.tm_year + 1900,
             tm.tm_mon + 1,
             tm.tm_mday,
             tm.tm_hour,
             tm.tm_min,
             tm.tm_sec);
}
#endif // CONFIG_MQTT_LIB_STCP

int main(void)
{

#if CONFIG_MQTT_LIB_STCP
//#  if STCP_COMPILE_MQTT

    int rc = stcp_library_init();
    if (rc != 0) {
        MWRN("STCP init error, rc: %d", rc);
    } else {
        MINF("STCP READY!");
    }

    MDBG("Doign DNS resolving");
    stcp_dns_resolve_all();

# if (CONFIG_STCP_TESTING && (CONFIG_STCP_TEST_MODE == 3))
    MINF("FSM starting....");
    stpc_mqtt_init_fsm_thread();
    MINF("FSM started....");
# else
#  if !CONFIG_STCP_TESTING
    MINF("FSM starting....");
    stpc_mqtt_init_fsm_thread();
    MINF("FSM started....");
#  endif
# endif

    while (1) {
        SLEEP_SEC(600);
    }

    return 0;
#endif // CONFIG_MQTT_LIB_STCP
}
```
