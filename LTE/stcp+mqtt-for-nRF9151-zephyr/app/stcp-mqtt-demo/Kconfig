## STCPv2/zephyr/nordic-3.4.0/POIS/stcp-module/build-nrf9151/Kconfig/soc/Kconfig.sysbuild.tmp
```kconfig
# Load Sysbuild SoC Kconfig descriptions.
osource "/home/pomo/git/STCP/STCPv2/zephyr/nordic/zephyr/soc/xlnx/zynqmp/Kconfig.sysbuild"
osource "/home/pomo/git/STCP/STCPv2/zephyr/nordic/zephyr/soc/xlnx/zynq7000/Kconfig.sysbuild"
osource "/home/pomo/git/STCP/STCPv2/zephyr/nordic/zephyr/soc/xlnx/versalnet/Kconfig.sysbuild"
osource "/home/pomo/git/STCP/STCPv2/zephyr/nordic/zephyr/soc/xlnx/versal2/Kconfig.sysbuild"
osource "/home/pomo/git/STCP/STCPv2/zephyr/nordic/zephyr/soc/xlnx/versal/Kconfig.sysbuild"
osource "/home/pomo/git/STCP/STCPv2/zephyr/nordic/zephyr/soc/xen/Kconfig.sysbuild"
osource "/home/pomo/git/STCP/STCPv2/zephyr/nordic/zephyr/soc/wch/ch32v/Kconfig.sysbuild"
osource "/home/pomo/git/STCP/STCPv2/zephyr/nordic/zephyr/soc/ti/simplelink/Kconfig.sysbuild"
osource "/home/pomo/git/STCP/STCPv2/zephyr/nordic/zephyr/soc/ti/mspm0/Kconfig.sysbuild"
osource "/home/pomo/git/STCP/STCPv2/zephyr/nordic/zephyr/soc/ti/lm3s6965/Kconfig.sysbuild"
osource "/home/pomo/git/STCP/STCPv2/zephyr/nordic/zephyr/soc/ti/k3/Kconfig.sysbuild"
osource "/home/pomo/git/STCP/STCPv2/zephyr/nordic/zephyr/soc/telink/tlsr/Kconfig.sysbuild"
osource "/home/pomo/git/STCP/STCPv2/zephyr/nordic/zephyr/soc/syna/sr100/Kconfig.sysbuild"
osource "/home/pomo/git/STCP/STCPv2/zephyr/nordic/zephyr/soc/starfive/jh71xx/Kconfig.sysbuild"
osource "/home/pomo/git/STCP/STCPv2/zephyr/nordic/zephyr/soc/st/stm32/Kconfig.sysbuild"
osource "/home/pomo/git/STCP/STCPv2/zephyr/nordic/zephyr/soc/snps/qemu_arc/Kconfig.sysbuild"
osource "/home/pomo/git/STCP/STCPv2/zephyr/nordic/zephyr/soc/snps/nsim/arc_v/Kconfig.sysbuild"
osource "/home/pomo/git/STCP/STCPv2/zephyr/nordic/zephyr/soc/snps/nsim/arc_classic/Kconfig.sysbuild"
osource "/home/pomo/git/STCP/STCPv2/zephyr/nordic/zephyr/soc/snps/hsdk4xd/Kconfig.sysbuild"
osource "/home/pomo/git/STCP/STCPv2/zephyr/nordic/zephyr/soc/snps/hsdk/Kconfig.sysbuild"
osource "/home/pomo/git/STCP/STCPv2/zephyr/nordic/zephyr/soc/snps/emsk/Kconfig.sysbuild"
osource "/home/pomo/git/STCP/STCPv2/zephyr/nordic/zephyr/soc/snps/emsdp/Kconfig.sysbuild"
osource "/home/pomo/git/STCP/STCPv2/zephyr/nordic/zephyr/soc/snps/arc_iot/Kconfig.sysbuild"
osource "/home/pomo/git/STCP/STCPv2/zephyr/nordic/zephyr/soc/silabs/Kconfig.sysbuild"
osource "/home/pomo/git/STCP/STCPv2/zephyr/nordic/zephyr/soc/sifli/sf32/Kconfig.sysbuild"
osource "/home/pomo/git/STCP/STCPv2/zephyr/nordic/zephyr/soc/sifive/sifive_freedom/Kconfig.sysbuild"
osource "/home/pomo/git/STCP/STCPv2/zephyr/nordic/zephyr/soc/sensry/Kconfig.sysbuild"
osource "/home/pomo/git/STCP/STCPv2/zephyr/nordic/zephyr/soc/rockchip/Kconfig.sysbuild"
osource "/home/pomo/git/STCP/STCPv2/zephyr/nordic/zephyr/soc/renode/riscv_virtual/Kconfig.sysbuild"
osource "/home/pomo/git/STCP/STCPv2/zephyr/nordic/zephyr/soc/renode/cortex_r8_virtual/Kconfig.sysbuild"
osource "/home/pomo/git/STCP/STCPv2/zephyr/nordic/zephyr/soc/renesas/smartbond/Kconfig.sysbuild"
osource "/home/pomo/git/STCP/STCPv2/zephyr/nordic/zephyr/soc/renesas/rz/Kconfig.sysbuild"
osource "/home/pomo/git/STCP/STCPv2/zephyr/nordic/zephyr/soc/renesas/rx/Kconfig.sysbuild"
osource "/home/pomo/git/STCP/STCPv2/zephyr/nordic/zephyr/soc/renesas/rcar/Kconfig.sysbuild"
osource "/home/pomo/git/STCP/STCPv2/zephyr/nordic/zephyr/soc/renesas/ra/Kconfig.sysbuild"
osource "/home/pomo/git/STCP/STCPv2/zephyr/nordic/zephyr/soc/realtek/fingerprint/Kconfig.sysbuild"
osource "/home/pomo/git/STCP/STCPv2/zephyr/nordic/zephyr/soc/realtek/ec/Kconfig.sysbuild"
osource "/home/pomo/git/STCP/STCPv2/zephyr/nordic/zephyr/soc/realtek/bee/Kconfig.sysbuild"
osource "/home/pomo/git/STCP/STCPv2/zephyr/nordic/zephyr/soc/realtek/ameba/Kconfig.sysbuild"
osource "/home/pomo/git/STCP/STCPv2/zephyr/nordic/zephyr/soc/raspberrypi/rpi_pico/Kconfig.sysbuild"
osource "/home/pomo/git/STCP/STCPv2/zephyr/nordic/zephyr/soc/quicklogic/eos_s3/Kconfig.sysbuild"
osource "/home/pomo/git/STCP/STCPv2/zephyr/nordic/zephyr/soc/qemu/virt_riscv/Kconfig.sysbuild"
osource "/home/pomo/git/STCP/STCPv2/zephyr/nordic/zephyr/soc/qemu/or1k/Kconfig.sysbuild"
osource "/home/pomo/git/STCP/STCPv2/zephyr/nordic/zephyr/soc/qemu/malta/Kconfig.sysbuild"
osource "/home/pomo/git/STCP/STCPv2/zephyr/nordic/zephyr/soc/openisa/rv32m1/Kconfig.sysbuild"
osource "/home/pomo/git/STCP/STCPv2/zephyr/nordic/zephyr/soc/openhwgroup/cva6/Kconfig.sysbuild"
osource "/home/pomo/git/STCP/STCPv2/zephyr/nordic/zephyr/soc/oct/osd32mp15x/Kconfig.sysbuild"
osource "/home/pomo/git/STCP/STCPv2/zephyr/nordic/zephyr/soc/nxp/s32/Kconfig.sysbuild"
osource "/home/pomo/git/STCP/STCPv2/zephyr/nordic/zephyr/soc/nxp/rw/Kconfig.sysbuild"
osource "/home/pomo/git/STCP/STCPv2/zephyr/nordic/zephyr/soc/nxp/mcx/Kconfig.sysbuild"
osource "/home/pomo/git/STCP/STCPv2/zephyr/nordic/zephyr/soc/nxp/lpc/Kconfig.sysbuild"
osource "/home/pomo/git/STCP/STCPv2/zephyr/nordic/zephyr/soc/nxp/layerscape/Kconfig.sysbuild"
osource "/home/pomo/git/STCP/STCPv2/zephyr/nordic/zephyr/soc/nxp/kinetis/Kconfig.sysbuild"
osource "/home/pomo/git/STCP/STCPv2/zephyr/nordic/zephyr/soc/nxp/imxrt/Kconfig.sysbuild"
osource "/home/pomo/git/STCP/STCPv2/zephyr/nordic/zephyr/soc/nxp/imx/Kconfig.sysbuild"
osource "/home/pomo/git/STCP/STCPv2/zephyr/nordic/zephyr/soc/nuvoton/numicro/Kconfig.sysbuild"
osource "/home/pomo/git/STCP/STCPv2/zephyr/nordic/zephyr/soc/nuvoton/numaker/Kconfig.sysbuild"
osource "/home/pomo/git/STCP/STCPv2/zephyr/nordic/zephyr/soc/nuvoton/npcx/Kconfig.sysbuild"
osource "/home/pomo/git/STCP/STCPv2/zephyr/nordic/zephyr/soc/nuvoton/npcm/Kconfig.sysbuild"
osource "/home/pomo/git/STCP/STCPv2/zephyr/nordic/zephyr/soc/nordic/Kconfig.sysbuild"
osource "/home/pomo/git/STCP/STCPv2/zephyr/nordic/zephyr/soc/neorv32/Kconfig.sysbuild"
osource "/home/pomo/git/STCP/STCPv2/zephyr/nordic/zephyr/soc/native/inf_clock/Kconfig.sysbuild"
osource "/home/pomo/git/STCP/STCPv2/zephyr/nordic/zephyr/soc/microchip/sam/sama7/Kconfig.sysbuild"
osource "/home/pomo/git/STCP/STCPv2/zephyr/nordic/zephyr/soc/microchip/sam/sam_d5x_e5x/Kconfig.sysbuild"
osource "/home/pomo/git/STCP/STCPv2/zephyr/nordic/zephyr/soc/microchip/pic64/Kconfig.sysbuild"
osource "/home/pomo/git/STCP/STCPv2/zephyr/nordic/zephyr/soc/microchip/pic32c/pic32cz_ca/Kconfig.sysbuild"
osource "/home/pomo/git/STCP/STCPv2/zephyr/nordic/zephyr/soc/microchip/pic32c/pic32cx_sg/Kconfig.sysbuild"
osource "/home/pomo/git/STCP/STCPv2/zephyr/nordic/zephyr/soc/microchip/pic32c/pic32cm_pl/Kconfig.sysbuild"
osource "/home/pomo/git/STCP/STCPv2/zephyr/nordic/zephyr/soc/microchip/pic32c/pic32cm_jh/Kconfig.sysbuild"
osource "/home/pomo/git/STCP/STCPv2/zephyr/nordic/zephyr/soc/microchip/miv/Kconfig.sysbuild"
osource "/home/pomo/git/STCP/STCPv2/zephyr/nordic/zephyr/soc/microchip/mec/Kconfig.sysbuild"
osource "/home/pomo/git/STCP/STCPv2/zephyr/nordic/zephyr/soc/mediatek/mt8xxx/Kconfig.sysbuild"
osource "/home/pomo/git/STCP/STCPv2/zephyr/nordic/zephyr/soc/lowrisc/opentitan/Kconfig.sysbuild"
osource "/home/pomo/git/STCP/STCPv2/zephyr/nordic/zephyr/soc/litex/litex_vexriscv/Kconfig.sysbuild"
osource "/home/pomo/git/STCP/STCPv2/zephyr/nordic/zephyr/soc/ite/ec/Kconfig.sysbuild"
osource "/home/pomo/git/STCP/STCPv2/zephyr/nordic/zephyr/soc/intel/wildcat_lake/Kconfig.sysbuild"
osource "/home/pomo/git/STCP/STCPv2/zephyr/nordic/zephyr/soc/intel/raptor_lake/Kconfig.sysbuild"
osource "/home/pomo/git/STCP/STCPv2/zephyr/nordic/zephyr/soc/intel/panther_lake/Kconfig.sysbuild"
osource "/home/pomo/git/STCP/STCPv2/zephyr/nordic/zephyr/soc/intel/lakemont/Kconfig.sysbuild"
osource "/home/pomo/git/STCP/STCPv2/zephyr/nordic/zephyr/soc/intel/intel_socfpga_std/Kconfig.sysbuild"
osource "/home/pomo/git/STCP/STCPv2/zephyr/nordic/zephyr/soc/intel/intel_socfpga/Kconfig.sysbuild"
osource "/home/pomo/git/STCP/STCPv2/zephyr/nordic/zephyr/soc/intel/intel_niosv/Kconfig.sysbuild"
osource "/home/pomo/git/STCP/STCPv2/zephyr/nordic/zephyr/soc/intel/intel_ish/Kconfig.sysbuild"
osource "/home/pomo/git/STCP/STCPv2/zephyr/nordic/zephyr/soc/intel/intel_adsp/Kconfig.sysbuild"
osource "/home/pomo/git/STCP/STCPv2/zephyr/nordic/zephyr/soc/intel/elkhart_lake/Kconfig.sysbuild"
osource "/home/pomo/git/STCP/STCPv2/zephyr/nordic/zephyr/soc/intel/atom/Kconfig.sysbuild"
osource "/home/pomo/git/STCP/STCPv2/zephyr/nordic/zephyr/soc/intel/apollo_lake/Kconfig.sysbuild"
osource "/home/pomo/git/STCP/STCPv2/zephyr/nordic/zephyr/soc/intel/alder_lake/Kconfig.sysbuild"
osource "/home/pomo/git/STCP/STCPv2/zephyr/nordic/zephyr/soc/infineon/psoc4/Kconfig.sysbuild"
osource "/home/pomo/git/STCP/STCPv2/zephyr/nordic/zephyr/soc/infineon/edge/Kconfig.sysbuild"
osource "/home/pomo/git/STCP/STCPv2/zephyr/nordic/zephyr/soc/infineon/cat3/Kconfig.sysbuild"
osource "/home/pomo/git/STCP/STCPv2/zephyr/nordic/zephyr/soc/infineon/cat1c/Kconfig.sysbuild"
osource "/home/pomo/git/STCP/STCPv2/zephyr/nordic/zephyr/soc/infineon/cat1b/Kconfig.sysbuild"
osource "/home/pomo/git/STCP/STCPv2/zephyr/nordic/zephyr/soc/infineon/cat1a/Kconfig.sysbuild"
osource "/home/pomo/git/STCP/STCPv2/zephyr/nordic/zephyr/soc/gd/gd32/Kconfig.sysbuild"
osource "/home/pomo/git/STCP/STCPv2/zephyr/nordic/zephyr/soc/gaisler/leon3/Kconfig.sysbuild"
osource "/home/pomo/git/STCP/STCPv2/zephyr/nordic/zephyr/soc/gaisler/gr716a/Kconfig.sysbuild"
osource "/home/pomo/git/STCP/STCPv2/zephyr/nordic/zephyr/soc/focaltech/Kconfig.sysbuild"
osource "/home/pomo/git/STCP/STCPv2/zephyr/nordic/zephyr/soc/espressif/Kconfig.sysbuild"
osource "/home/pomo/git/STCP/STCPv2/zephyr/nordic/zephyr/soc/ene/kb1200/Kconfig.sysbuild"
osource "/home/pomo/git/STCP/STCPv2/zephyr/nordic/zephyr/soc/ene/kb106x/Kconfig.sysbuild"
osource "/home/pomo/git/STCP/STCPv2/zephyr/nordic/zephyr/soc/elan/em32f967/Kconfig.sysbuild"
osource "/home/pomo/git/STCP/STCPv2/zephyr/nordic/zephyr/soc/egis/Kconfig.sysbuild"
osource "/home/pomo/git/STCP/STCPv2/zephyr/nordic/zephyr/soc/efinix/sapphire/Kconfig.sysbuild"
osource "/home/pomo/git/STCP/STCPv2/zephyr/nordic/zephyr/soc/cdns/xtensa_sample_controller/Kconfig.sysbuild"
osource "/home/pomo/git/STCP/STCPv2/zephyr/nordic/zephyr/soc/cdns/swerv/Kconfig.sysbuild"
osource "/home/pomo/git/STCP/STCPv2/zephyr/nordic/zephyr/soc/cdns/sample_controller32/Kconfig.sysbuild"
osource "/home/pomo/git/STCP/STCPv2/zephyr/nordic/zephyr/soc/cdns/dc233c/Kconfig.sysbuild"
osource "/home/pomo/git/STCP/STCPv2/zephyr/nordic/zephyr/soc/brcm/bcmvk/Kconfig.sysbuild"
osource "/home/pomo/git/STCP/STCPv2/zephyr/nordic/zephyr/soc/brcm/bcm2712/Kconfig.sysbuild"
osource "/home/pomo/git/STCP/STCPv2/zephyr/nordic/zephyr/soc/brcm/bcm2711/Kconfig.sysbuild"
osource "/home/pomo/git/STCP/STCPv2/zephyr/nordic/zephyr/soc/blackberry/qnxhv_vm/Kconfig.sysbuild"
osource "/home/pomo/git/STCP/STCPv2/zephyr/nordic/zephyr/soc/bflb/Kconfig.sysbuild"
osource "/home/pomo/git/STCP/STCPv2/zephyr/nordic/zephyr/soc/atmel/sam0/Kconfig.sysbuild"
osource "/home/pomo/git/STCP/STCPv2/zephyr/nordic/zephyr/soc/atmel/sam/Kconfig.sysbuild"
osource "/home/pomo/git/STCP/STCPv2/zephyr/nordic/zephyr/soc/aspeed/Kconfig.sysbuild"
osource "/home/pomo/git/STCP/STCPv2/zephyr/nordic/zephyr/soc/arm/Kconfig.sysbuild"
osource "/home/pomo/git/STCP/STCPv2/zephyr/nordic/zephyr/soc/arm/beetle/Kconfig.sysbuild"
osource "/home/pomo/git/STCP/STCPv2/zephyr/nordic/zephyr/soc/antmicro/myra/Kconfig.sysbuild"
osource "/home/pomo/git/STCP/STCPv2/zephyr/nordic/zephyr/soc/andestech/Kconfig.sysbuild"
osource "/home/pomo/git/STCP/STCPv2/zephyr/nordic/zephyr/soc/amd/acp_6_0/Kconfig.sysbuild"
osource "/home/pomo/git/STCP/STCPv2/zephyr/nordic/zephyr/soc/ambiq/Kconfig.sysbuild"
osource "/home/pomo/git/STCP/STCPv2/zephyr/nordic/zephyr/soc/allwinner/sun8i_h3/Kconfig.sysbuild"
osource "/home/pomo/git/STCP/STCPv2/zephyr/nordic/zephyr/soc/alif/ensemble/Kconfig.sysbuild"
osource "/home/pomo/git/STCP/STCPv2/zephyr/nordic/zephyr/soc/aesc/Kconfig.sysbuild"
osource "/home/pomo/git/STCP/STCPv2/zephyr/nordic/zephyr/soc/adi/max32/Kconfig.sysbuild"
osource "/home/pomo/git/STCP/STCPv2/zephyr/nordic/nrf/soc/sercomm/nrf91/Kconfig.sysbuild"
osource "/home/pomo/git/STCP/STCPv2/zephyr/nordic/nrf/soc/nordic/Kconfig.sysbuild"
```
