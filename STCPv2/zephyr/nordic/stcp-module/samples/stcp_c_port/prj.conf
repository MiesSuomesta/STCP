## CMakeLists.txt
```
cmake_minimum_required(VERSION 3.20.0)
find_package(Zephyr REQUIRED HINTS $ENV{ZEPHYR_BASE})
project(stcp_c_port)
target_sources(app PRIVATE src/main.c)
```

## prj.conf
```kconfig
CONFIG_NETWORKING=y
CONFIG_NET_IPV4=y
CONFIG_NET_TCP=y
CONFIG_NET_UDP=y
CONFIG_NET_SOCKETS=y
CONFIG_NET_SOCKETS_OFFLOAD=y
CONFIG_STCP=y
CONFIG_STCP_LOG_LEVEL=4
CONFIG_LOG=y
CONFIG_PRINTK=y
CONFIG_SERIAL=y
CONFIG_CONSOLE=y
CONFIG_UART_CONSOLE=y
CONFIG_MAIN_STACK_SIZE=4096
CONFIG_HEAP_MEM_POOL_SIZE=16384
```

## src/main.c
```c
#include <errno.h>
#include <zephyr/kernel.h>
#include <zephyr/net/socket.h>
#include <stcp/stcp.h>

int main(void)
{
    int fd = zsock_socket(AF_STCP, SOCK_STREAM, STCP_PROTO_TCP);

    printk("STCP Zephyr C port\n");
    if (fd < 0) {
        printk("socket(AF_STCP) failed: errno=%d\n", errno);
        return 0;
    }

    printk("socket(AF_STCP) OK, fd=%d\n", fd);
    zsock_close(fd);
    printk("close OK\n");
    return 0;
}
```
