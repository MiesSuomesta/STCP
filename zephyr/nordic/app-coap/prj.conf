## prj.conf
```kconfig
# STCP CoAP application only.

CONFIG_COAP=y
CONFIG_STCP_COAP_INTERVAL_MS=2000

# Application memory / diagnostics
CONFIG_MAIN_STACK_SIZE=4096
CONFIG_SYSTEM_WORKQUEUE_STACK_SIZE=4096
CONFIG_THREAD_STACK_INFO=y
CONFIG_INIT_STACKS=y
CONFIG_STACK_SENTINEL=y

# CoAP build needs a larger W5500 RX worker than the base application.
```

## ethernet.conf
```kconfig
# STCP Ethernet build for nRF9151 DK + Seeed W5500

CONFIG_THREAD_STACK_INFO=y
CONFIG_INIT_STACKS=y
CONFIG_STACK_SENTINEL=y

# Console and shell
CONFIG_SERIAL=y
CONFIG_CONSOLE=y
CONFIG_UART_CONSOLE=y
CONFIG_PRINTK=y
CONFIG_SHELL=y
CONFIG_SHELL_BACKEND_SERIAL=y
CONFIG_SHELL_PROMPT_UART="stcp> "

# Logging
CONFIG_LOG=y
CONFIG_LOG_MODE_IMMEDIATE=y
CONFIG_LOG_MODE_DEFERRED=n

# Älä ohjaa printk:iä deferred loggerin kautta.
CONFIG_LOG_PRINTK=n

CONFIG_LOG_DEFAULT_LEVEL=2
CONFIG_KERNEL_LOG_LEVEL_WRN=y
CONFIG_LOG_BACKEND_UART=y
CONFIG_SPI_LOG_LEVEL_WRN=y
CONFIG_ETHERNET_LOG_LEVEL_INF=y
CONFIG_NET_LOG=n

# Native Zephyr network stack
CONFIG_NETWORKING=y
CONFIG_NET_BUF=y
CONFIG_NET_NATIVE=y
CONFIG_NET_IPV4=y
CONFIG_NET_IPV6=n
CONFIG_NET_TCP=y
CONFIG_NET_UDP=y
CONFIG_NET_SOCKETS=y
CONFIG_NET_SOCKETS_OFFLOAD=n
CONFIG_NET_L2_ETHERNET=y
CONFIG_ETH_W5500=y
CONFIG_SPI=y
CONFIG_GPIO=y
CONFIG_NET_ARP=y

# Static LAN configuration
CONFIG_NET_DHCPV4=n
CONFIG_NET_CONFIG_SETTINGS=y
CONFIG_NET_CONFIG_AUTO_INIT=y
CONFIG_NET_CONFIG_NEED_IPV4=y
CONFIG_NET_CONFIG_INIT_TIMEOUT=10
CONFIG_NET_CONFIG_MY_IPV4_ADDR="192.168.1.50"
CONFIG_NET_CONFIG_MY_IPV4_NETMASK="255.255.255.0"
CONFIG_NET_CONFIG_MY_IPV4_GW="192.168.1.111"

# MQTT
CONFIG_STCP_MQTT_BROKER_IPV4="192.168.1.20"
CONFIG_STCP_MQTT_BROKER_PORT=18830

# Network management and diagnostics
CONFIG_NET_MGMT=y
CONFIG_NET_MGMT_EVENT=y
CONFIG_NET_CONNECTION_MANAGER=y
CONFIG_NET_SHELL=y
CONFIG_NET_STATISTICS=y

# MQTT and STCP
CONFIG_MQTT_LIB=y

# Memory
#CONFIG_HEAP_MEM_POOL_SIZE=98304
CONFIG_HEAP_MEM_POOL_SIZE=32768
CONFIG_MAIN_STACK_SIZE=4096
CONFIG_ETH_W5500_RX_THREAD_STACK_SIZE=16384
CONFIG_SYSTEM_WORKQUEUE_STACK_SIZE=4096

# Utilities
CONFIG_RING_BUFFER=y
CONFIG_REBOOT=y
CONFIG_ENTROPY_GENERATOR=y
CONFIG_THREAD_NAME=y
CONFIG_ASSERT=y
CONFIG_SPEED_OPTIMIZATIONS=y
CONFIG_ASSERT_VERBOSE=n

# Echo benchmark
CONFIG_ECHO_TRANSPORT_STCP=y
CONFIG_ECHO_SERVER_HOST="192.168.1.20"
CONFIG_ECHO_SERVER_PORT="19000"
CONFIG_ECHO_SOCKET_TIMEOUT_MS=60000
CONFIG_BENCH_TOTAL_BYTES=1048576
CONFIG_BENCH_MAX_CHUNK_SIZE=65536
#OLI CONFIG_BENCH_CHUNK_SIZE=16384
CONFIG_BENCH_CHUNK_SIZE=4096
CONFIG_BENCH_PAUSE_SECONDS=5
CONFIG_BENCH_REPORT_INTERVAL_MS=5000
CONFIG_BENCH_SENDER_STACK_SIZE=4096
CONFIG_BENCH_FULL_RX_BUFFER_SIZE=4096
CONFIG_STCP_BENCH_SHELL=y
CONFIG_STCP_BENCH_AUTORUN=n

# Ethernet build: modem/LTE stack disabled
CONFIG_NRF_MODEM_LIB=n
CONFIG_LTE_LINK_CONTROL=n
CONFIG_PDN=n

CONFIG_BENCH_STCP_BLOCKING_CONNECT=y

# PSA_CRYPTO_CLIENT is generated/hidden in NCS 3.3.0; do not assign it directly.
# Client benchmark needs one active STCP socket; keep one spare for recovery.
# The RX stack is embedded in every pool entry, so limiting the pool saves
# 24+ KiB of static RAM compared with the default eight sockets.
CONFIG_MBEDTLS_PSA_CRYPTO_C=y

# Run benchmark and Rust STCP session creation outside shell_uart.
CONFIG_BENCH_WORKER_STACK_SIZE=8192
CONFIG_BENCH_WORKER_PRIORITY=5
CONFIG_THREAD_STACK_INFO=y



# Clean STCP Zephyr adapter: custom AF_STCP provider, not global socket offload.
CONFIG_STCP=y
CONFIG_STCP_SOCKET_PRIORITY=20
CONFIG_STCP_MAX_SOCKETS=2
CONFIG_STCP_CONNECT_TIMEOUT_MS=60000
CONFIG_STCP_LOG_LEVEL=3
CONFIG_STCP_RUST_TOOLCHAIN="nightly"
#CONFIG_STCP_RUST_RX_STACK_SIZE=3072
CONFIG_STCP_RUST_RX_STACK_SIZE=8192
CONFIG_STCP_RUST_RX_PRIORITY=7
CONFIG_STCP_RUST_RX_BUFFER_SIZE=2048
CONFIG_STCP_RUST_X25519_SOFTWARE=y
CONFIG_STCP_RUST_TRACE_WIRE=n
CONFIG_STCP_RUST_TRACE_EVENTS=n
CONFIG_STCP_RUST_TRACE_ALLOC=n
CONFIG_STCP_RUST_TRACE_CRYPTO=n

# AF_STCP connect is deliberately blocking in the benchmark shell for bring-up.

# CoAP over STCP
CONFIG_COAP=y

CONFIG_STCP_COAP_INTERVAL_MS=2000

CONFIG_ETH_W5500_RX_THREAD_STACK_SIZE=16384
```

## lte.conf
```kconfig
CONFIG_STCP=y
CONFIG_NET_SOCKETS=y
CONFIG_NET_SOCKETS_OFFLOAD=y
CONFIG_NET_NATIVE=n
CONFIG_STCP_RUST_TRACE_WIRE=n
CONFIG_STCP_RUST_TRACE_EVENTS=n
CONFIG_STCP_RUST_TRACE_ALLOC=n
CONFIG_STCP_RUST_TRACE_CRYPTO=n
CONFIG_LTE_LINK_CONTROL=y
CONFIG_STCP_TRANSPORT_ETHERNET=n
CONFIG_NET_L2_ETHERNET=n
CONFIG_ETH_W5500=n
CONFIG_NET_CONFIG_AUTO_INIT=n
```

## stcp_lte.conf
```kconfig
CONFIG_STCP=y
CONFIG_NET_SOCKETS=y
CONFIG_NET_SOCKETS_OFFLOAD=n
CONFIG_NET_NATIVE=y
CONFIG_NET_NATIVE_IP=y
CONFIG_NET_NATIVE_IPV4=y
CONFIG_NET_NATIVE_TCP=y
CONFIG_NET_NATIVE_UDP=y
CONFIG_NET_ARP=y
CONFIG_STCP_RUST_TRACE_WIRE=n
CONFIG_STCP_RUST_TRACE_EVENTS=n
CONFIG_STCP_RUST_TRACE_ALLOC=n
CONFIG_STCP_RUST_TRACE_CRYPTO=n
CONFIG_LTE_LINK_CONTROL=y
```

## src/coap_stcp_transport.h
```c
#ifndef COAP_STCP_TRANSPORT_H
#define COAP_STCP_TRANSPORT_H

#include <stddef.h>
#include <stdint.h>

int coap_stcp_connect(void);
void coap_stcp_close(void);
int coap_stcp_send(const uint8_t *data, size_t len);
int coap_stcp_recv(uint8_t *data, size_t len);
int coap_stcp_fd(void);

#endif
```

## src/mqtt_stcp_transport.c
```c
#include <errno.h>
#include <stddef.h>
#include <stdint.h>

#include <zephyr/logging/log.h>
#include <zephyr/net/mqtt.h>
#include <zephyr/net/net_ip.h>
#include <zephyr/net/socket.h>

#include <stcp/stcp.h>

#include "mqtt_stcp_transport.h"

LOG_MODULE_REGISTER(mqtt_stcp_transport, LOG_LEVEL_INF);

static struct mqtt_stcp_transport_data *transport_data(struct mqtt_client *client)
{
    return (struct mqtt_stcp_transport_data *)
        client->transport.custom_transport_data;
}

static const struct mqtt_stcp_transport_data *
transport_data_const(const struct mqtt_client *client)
{
    return (const struct mqtt_stcp_transport_data *)
        client->transport.custom_transport_data;
}

int mqtt_stcp_poll_fd(const struct mqtt_client *client)
{
    const struct mqtt_stcp_transport_data *data = transport_data_const(client);

    return data != NULL ? data->fd : -1;
}

int mqtt_client_custom_transport_connect(struct mqtt_client *client)
{
    struct mqtt_stcp_transport_data *data = transport_data(client);
    struct net_sockaddr_in peer = { 0 };
    int fd;
    int rc;

    if (data == NULL) {
        return -EINVAL;
    }

    /*
     * Do not reuse client->broker here.  The MQTT layer only needs the
     * broker object for its own bookkeeping; the STCP transport builds the
     * actual IPv4 carrier destination explicitly from the application
     * configuration.  This also guarantees that zsock_connect() receives
     * the port in network byte order.
     */
    peer.sin_family = NET_AF_INET;
    peer.sin_port = net_htons(CONFIG_STCP_MQTT_BROKER_PORT);

    rc = zsock_inet_pton(NET_AF_INET,
                         CONFIG_STCP_MQTT_BROKER_IPV4,
                         &peer.sin_addr);
    if (rc != 1) {
        LOG_ERR("Invalid MQTT broker IPv4 address: %s",
                CONFIG_STCP_MQTT_BROKER_IPV4);
        return -EINVAL;
    }

    LOG_INF("MQTT STCP connect target=%s:%d host_port=%u raw_port=%u",
            CONFIG_STCP_MQTT_BROKER_IPV4,
            CONFIG_STCP_MQTT_BROKER_PORT,
            (unsigned int)net_ntohs(peer.sin_port),
            (unsigned int)peer.sin_port);

    fd = zsock_socket(AF_STCP, NET_SOCK_STREAM, IPPROTO_STCP);
    if (fd < 0) {
        return -errno;
    }

    if (zsock_connect(fd,
                      (const struct net_sockaddr *)&peer,
                      sizeof(peer)) < 0) {
        int err = -errno;

        LOG_ERR("MQTT STCP connect failed target=%s:%d fd=%d errno=%d",
                CONFIG_STCP_MQTT_BROKER_IPV4,
                CONFIG_STCP_MQTT_BROKER_PORT,
                fd, errno);

        (void)zsock_close(fd);
        return err;
    }

    data->fd = fd;

    LOG_INF("MQTT custom transport connected over STCP fd=%d target=%s:%d",
            fd,
            CONFIG_STCP_MQTT_BROKER_IPV4,
            CONFIG_STCP_MQTT_BROKER_PORT);
    return 0;
}

int mqtt_client_custom_transport_write(struct mqtt_client *client,
                                       const uint8_t *data,
                                       uint32_t datalen)
{
    struct mqtt_stcp_transport_data *transport = transport_data(client);
    uint32_t sent = 0U;

    if (transport == NULL || transport->fd < 0) {
        return -ENOTCONN;
    }

    while (sent < datalen) {
        ssize_t n = zsock_send(transport->fd,
                               data + sent,
                               datalen - sent,
                               0);
        if (n < 0) {
            return -errno;
        }

        if (n == 0) {
            return -ECONNRESET;
        }

        sent += (uint32_t)n;
    }

    return 0;
}

int mqtt_client_custom_transport_write_msg(struct mqtt_client *client,
                                           const struct net_msghdr *message)
{
    struct mqtt_stcp_transport_data *transport = transport_data(client);

    if (transport == NULL || transport->fd < 0) {
        return -ENOTCONN;
    }

    /*
     * Avoid any POSIX msghdr/iovec assumptions here.  Zephyr MQTT gives us
     * net_msghdr + net_iovec; send each vector through the same STCP stream.
     */
    for (size_t i = 0U; i < message->msg_iovlen; ++i) {
        const uint8_t *buf =
            (const uint8_t *)message->msg_iov[i].iov_base;
        size_t left = message->msg_iov[i].iov_len;

        while (left > 0U) {
            ssize_t n = zsock_send(transport->fd, buf, left, 0);

            if (n < 0) {
                return -errno;
            }

            if (n == 0) {
                return -ECONNRESET;
            }

            buf += (size_t)n;
            left -= (size_t)n;
        }
    }

    return 0;
}

int mqtt_client_custom_transport_read(struct mqtt_client *client,
                                      uint8_t *data,
                                      uint32_t buflen,
                                      bool shall_block)
{
    struct mqtt_stcp_transport_data *transport = transport_data(client);
    int flags = shall_block ? 0 : ZSOCK_MSG_DONTWAIT;
    ssize_t n;

    if (transport == NULL || transport->fd < 0) {
        return -ENOTCONN;
    }

    n = zsock_recv(transport->fd, data, buflen, flags);
    if (n < 0) {
        return -errno;
    }

    return (int)n;
}

int mqtt_client_custom_transport_disconnect(struct mqtt_client *client)
{
    struct mqtt_stcp_transport_data *data = transport_data(client);

    if (data == NULL || data->fd < 0) {
        return 0;
    }

    (void)zsock_close(data->fd);
    data->fd = -1;

    LOG_INF("MQTT custom STCP transport disconnected");
    return 0;
}
```
