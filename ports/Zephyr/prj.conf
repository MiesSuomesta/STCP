## CMakeLists.txt
```
cmake_minimum_required(VERSION 3.20.0)
find_package(Zephyr REQUIRED HINTS $ENV{ZEPHYR_BASE})
project(stcp_demo)

# ------------------------------------------------------------
# STCP version
# ------------------------------------------------------------
set(STCP_VERSION "1.0.0-beta")

# ------------------------------------------------------------
# Build time (UTC, reproducible)
# ------------------------------------------------------------
string(TIMESTAMP STCP_BUILD_TIME "%Y-%m-%d %H:%M:%S UTC")

# ------------------------------------------------------------
# Git SHA (safe fallback)
# ------------------------------------------------------------
execute_process(
    COMMAND git describe --tags --dirty --always
    WORKING_DIRECTORY ${CMAKE_SOURCE_DIR}
    OUTPUT_VARIABLE STCP_GIT_SHA
    OUTPUT_STRIP_TRAILING_WHITESPACE
    ERROR_QUIET
)

if(NOT STCP_GIT_SHA)
    set(STCP_GIT_SHA "nogit")
endif()

# ------------------------------------------------------------
# Debug
# ------------------------------------------------------------

option(STCP_DEBUG "Enable STCP Rust-debug feature" ON)

set(STCP_RUST_FEATURES "")
if(STCP_DEBUG)
    set(STCP_RUST_FEATURES "stcp_debug")
endif()

# ------------------------------------------------------------
# Inject into Zephyr app target
# ------------------------------------------------------------
target_compile_definitions(app PRIVATE
    STCP_VERSION=\"${STCP_VERSION}\"
    STCP_BUILD_TIME=\"${STCP_BUILD_TIME}\"
    STCP_GIT_SHA=\"${STCP_GIT_SHA}\"
)


#if(CONFIG_STCP_TRANSPORT_LTE)
target_sources(app PRIVATE
	micro-ecc/uECC.c
	src/workers.c
	src/utils.c
  src/network_testing.c
	src/fsm.c
	src/ffi_random.c
	src/rust_alloc.c
	src/rust_log_with_printk.c
	src/stcp_alloc_zephyr.c
	src/stcp_bridge.c
	src/stcp_kernel_crypto.c
	src/stcp_lte_fsm.c
	src/stcp_main_lte.c
	src/stcp_net_zephyr.c
	src/stcp_operations_zephyr.c
	src/stcp_platform_init_lte.c
	src/stcp_soft_reset.c
	src/stcp_tcp_recv.c
	src/stcp_tcp_send.c
	src/stcp_transport_lte.c

    )
#endif()

#if(CONFIG_STCP_TRANSPORT_BT)
#    target_sources(app PRIVATE
#        src/stcp_main_bt.c
#        src/stcp_platform_init_bt.c
#        src/stcp_transport_bt.c
#        src/stcp_platform_bt.c
#    )
#endif()

set(STCP_FOR_LTE 1)
set(STCP_SDK_DIR "${CMAKE_CURRENT_LIST_DIR}/../out/")

# OOT: anna SDK-polku ulkoa (cmake -DSTCP_SDK_DIR=...)

# --- polut ---
set(RUST_DIR ${CMAKE_CURRENT_LIST_DIR}/rust)
set(RUST_LIB_SRC
  ${RUST_DIR}/target/thumbv8m.main-none-eabi/release/libthe_stcp_kernel_module.a
)

set(STCP_LIB_DST ${STCP_SDK_DIR}/lib/libstcp.a)
set(STCP_INC_DST ${STCP_SDK_DIR}/include)
set(MICRO_INC_DST ${STCP_SDK_DIR}/include)
set(STCP_HDR_DST ${STCP_INC_DST}/stcp.h)

# --- generoi SDK (lib + header) ---
add_custom_command(
  OUTPUT ${STCP_LIB_DST} ${STCP_HDR_DST}

  COMMAND cargo +nightly build
          --release
          --target thumbv8m.main-none-eabi
          --features stcp_debug

  COMMAND ${CMAKE_COMMAND} -E make_directory ${STCP_SDK_DIR}/lib
  COMMAND ${CMAKE_COMMAND} -E make_directory ${STCP_INC_DST}

  # kopioi Rust staticlib
  COMMAND ${CMAKE_COMMAND} -E copy_if_different
          ${RUST_LIB_SRC}
          ${STCP_LIB_DST}

  # aja cbindgen
  COMMAND cbindgen
          --config ${RUST_DIR}/cbindgen.toml
          --crate the_stcp_kernel_module
          --output ${STCP_HDR_DST}

  WORKING_DIRECTORY ${RUST_DIR}

  DEPENDS
    ${RUST_LIB_SRC}
    ${RUST_DIR}/src/lib.rs
    ${RUST_DIR}/cbindgen.toml

  VERBATIM
)

add_custom_target(stcp_sdk ALL
  DEPENDS ${STCP_LIB_DST} ${STCP_HDR_DST}
)

add_dependencies(app stcp_sdk)

# --- include + link ---

target_include_directories(app PRIVATE
  # netti internaalit näkyviin
  ${ZEPHYR_BASE}/subsys/net/ip
  ${ZEPHYR_BASE}/subsys/net/lib/sockets
  # STCP
  ${MICRO_INC_DST}
  ${STCP_INC_DST}
)

target_link_libraries(app PRIVATE
  ${STCP_LIB_DST}
)

target_include_directories(app PRIVATE
  ${CMAKE_CURRENT_LIST_DIR}/include
  ${CMAKE_CURRENT_LIST_DIR}/micro-ecc
  ${STCP_SDK_DIR}/include
)

target_link_libraries(app PRIVATE
  ${STCP_SDK_DIR}/lib/libstcp.a
)
```

## Kconfig
```
source "Kconfig"

menu "STCP Configuration"

config STCP_ENABLE
    bool "Enable STCP LTE transport"
    default y
    depends on NET_SOCKETS   # esimerkki: riippuvuudet kernelistä
    help
      Enable STCP LTE transport.

config STCP_DEBUG
    bool "Enable STCP debug"
    default n
    depends on STCP_ENABLE   # esimerkki: riippuvuudet kernelistä
    help
      Enable STCP debugs.

config STCP_AES_BYPASS
    bool "Enable STCP AES bypass"
    default n
    depends on STCP_ENABLE   # esimerkki: riippuvuudet kernelistä
    help
      Bypass AES enc/decryption for development purposes.

config STCP_CONNECT_TO_HOST
    string "STCP Connect to hostname"
    default "lja.fi"
    depends on STCP_ENABLE
    help
      STCP Remote endpoint hostname.

config STCP_CONNECT_TO_PORT
    string "STCP Connect to tcp port"
    default "7777"
    depends on STCP_ENABLE
    help
      STCP Remote endpoint tcp port.

config STCP_LTE_APN_NAME
    string "The APN name to connect."
    default "internet"
    depends on STCP_ENABLE
    help
      The APN name to use to connect.

      Ask from your ISP what is the right APN
      name to use.


endmenu
```

## Kconfig.zephyr
```
source "Kconfig"
```

## prj.conf
```kconfig
# =========================
# UART driver
# =========================
CONFIG_SERIAL=y

# =========================
# LOG -> UART (vain yksi backend)
# =========================
CONFIG_LOG=y
CONFIG_LOG_BACKEND_UART=y
CONFIG_LOG_MODE_IMMEDIATE=y
CONFIG_LOG_PRINTK=n

# =========================
# Estä printk + early console
# =========================
CONFIG_PRINTK=n
CONFIG_EARLY_CONSOLE=n
CONFIG_STDOUT_CONSOLE=n

# =========================
# Shell UARTiin (ei Shell-log-backendiä!)
# =========================
CONFIG_CONSOLE=y
CONFIG_UART_CONSOLE=y
CONFIG_SHELL=y
CONFIG_SHELL_BACKEND_SERIAL=y
CONFIG_SHELL_LOG_BACKEND=n   # <<< TÄRKEIN

# =========================
# Tracing (vain trace_backend symboliin, ei UARTiin)
# =========================
CONFIG_TRACING=y
CONFIG_TRACING_BACKEND_UART=n   # EI enää UARTiin
CONFIG_TRACING_SYNC=y

# =========================
# Modem trace RAMiin (ei UARTiin)
# =========================
CONFIG_NRF_MODEM_LIB_TRACE=y
CONFIG_NRF_MODEM_LIB_TRACE_BACKEND_RAM=y
CONFIG_NRF_MODEM_LIB_TRACE_BACKEND_RAM_LENGTH=32768

# =========================
# Estä muut backendit
# =========================
CONFIG_LOG_BACKEND_RTT=n

# -------------------------
# Core networking
# -------------------------
CONFIG_PDN=y
CONFIG_NETWORKING=y
CONFIG_NET_IPV4=y
CONFIG_NET_IPV6=n
CONFIG_DNS_RESOLVER=y
CONFIG_NET_CONFIG_SETTINGS=y
CONFIG_NET_CONFIG_AUTO_INIT=y

# -------------------------
# Sockets (pakollinen zsock_*)
# -------------------------
CONFIG_NET_SOCKETS=y
CONFIG_NET_SOCKETS_POSIX_NAMES=y
CONFIG_NET_BUF_RX_COUNT=8
CONFIG_NET_BUF_TX_COUNT=8
CONFIG_NET_PKT_RX_COUNT=4
CONFIG_NET_PKT_TX_COUNT=4

# File dessejä
CONFIG_ZVFS_OPEN_MAX=32
CONFIG_NET_SOCKETS_POLL_MAX=32

# -------------------------
# Offload (nRF9161 modem sockets)
# -------------------------
CONFIG_NET_SOCKETS_OFFLOAD=y
CONFIG_NET_OFFLOAD=y

# -------------------------
# DNS (zsock_getaddrinfo)
# -------------------------
CONFIG_DNS_RESOLVER=y
CONFIG_NET_CONFIG_SETTINGS=y
CONFIG_NET_CONFIG_INIT_TIMEOUT=30

# -------------------------
# LTE / modem
# -------------------------
CONFIG_NRF_MODEM_LIB=y
CONFIG_LTE_LINK_CONTROL=y
CONFIG_LTE_LINK_CONTROL_LOG_LEVEL_DBG=y

CONFIG_MODEM_KEY_MGMT=y
CONFIG_NET_CONFIG_SETTINGS=y
CONFIG_NET_CONFIG_INIT_TIMEOUT=60

# -------------------------
# POSIX layer (poll, fcntl jne)
# -------------------------
CONFIG_POSIX_API=y
CONFIG_POLL=y
CONFIG_EVENTFD=y

# -------------------------
# Crypto
# -------------------------
# Crypto perusta

# nRF9161 HW crypto (CC3XX)
CONFIG_PSA_CRYPTO_DRIVER_CC3XX=y

# Entropy / RNG
CONFIG_ENTROPY_GENERATOR=y

# Tarvittavat ECC-algoritmit
CONFIG_MBEDTLS_ECP_C=y
CONFIG_MBEDTLS_ECDH_C=y
CONFIG_MBEDTLS_ECDSA_C=y

# (valinnainen) debug
CONFIG_MBEDTLS_DEBUG=y

# HW crypto nRF9161:
CONFIG_NORDIC_SECURITY_BACKEND=y
CONFIG_PSA_CRYPTO_DRIVER_CC3XX=y

# Muisti 24kb stakki ja 32kb heappi 
CONFIG_MAIN_STACK_SIZE=32768
CONFIG_HEAP_MEM_POOL_SIZE=32768
CONFIG_NET_SOCKETS_SERVICE_STACK_SIZE=8192
CONFIG_SYSTEM_WORKQUEUE_STACK_SIZE=4096

# Stack debug
CONFIG_INIT_STACKS=y
CONFIG_STACK_SENTINEL=y
CONFIG_THREAD_STACK_INFO=y
CONFIG_MBEDTLS=y


# --- ÄLÄ vedä mbedTLS debug-init mukaan ---
CONFIG_MBEDTLS=n
CONFIG_MBEDTLS_LIBRARY=n
CONFIG_MBEDTLS_DEBUG=n

# --- Disabloi nrf_security mbedTLS backend ---
CONFIG_NRF_SECURITY=n

# --- Pakota mbedTLS kirjasto ---
#CONFIG_MBEDTLS=y
#CONFIG_MBEDTLS_LIBRARY=y

# --- Nordic HW backend ---
#CONFIG_PSA_CRYPTO_DRIVER_CC3XX=y

# --- Entropy ---
#CONFIG_ENTROPY_GENERATOR=y

# --- ECC ---
#CONFIG_MBEDTLS_ECP_C=y
#CONFIG_MBEDTLS_ECDH_C=y
#CONFIG_MBEDTLS_ECDSA_C=y

#defbuggia
CONFIG_SYS_HEAP_RUNTIME_STATS=y
CONFIG_SYS_HEAP_LISTENER=y
CONFIG_ASSERT=y
CONFIG_DEBUG_OPTIMIZATIONS=y
CONFIG_CBPRINTF_COMPLETE=y

#HEappi
CONFIG_SYS_HEAP_LISTENER=y
CONFIG_SYS_HEAP_RUNTIME_STATS=y
CONFIG_SYS_HEAP_VALIDATE=y

CONFIG_ENTROPY_GENERATOR=y
CONFIG_ENTROPY_NRF5_RNG=y
CONFIG_NRFX_RNG=y


#CONFIG_INIT_STACKS=y
#CONFIG_THREAD_STACK_INFO=y
#CONFIG_THREAD_RUNTIME_STATS=y

#CONFIG_HEAP_MEM_POOL_SIZE=65536
CONFIG_DEBUG_INFO=y
CONFIG_DEBUG_OPTIMIZATIONS=y
CONFIG_NO_OPTIMIZATIONS=y

# Analyysiä
#CONFIG_THREAD_ANALYZER=y
#CONFIG_THREAD_ANALYZER_AUTO=y
#CONFIG_THREAD_ANALYZER_USE_PRINTK=y
```

## include/debug.h
```c
#pragma once
#include <zephyr/logging/log.h>
#include "stcp_bridge.h"

#define LOG_CALLING_SPOT_FIRST  0

#if LOG_CALLING_SPOT_FIRST 
    #define DO_FIRST_ON_LOG do { SDBG("Following log from tagging"); } while(0)
#else
    #define DO_FIRST_ON_LOG do { } while(0)
#endif

#if CONFIG_STCP_DEBUG
# define SDBG(msg, ...) \
    LOG_INF("STCP[%s:%d][LR:%p]: " msg, __FILE__, __LINE__ , __builtin_return_address(0), ##__VA_ARGS__)

# define LDBG(msg, ...) \
    do { \
        DO_FIRST_ON_LOG; \
        LOG_INF("STCP[%s:%d][LR:%p]: " msg, __FILE__, __LINE__, __builtin_return_address(0) , ##__VA_ARGS__ ); \
    } while (0)
# define LWRN(msg, ...) \
    do { \
        DO_FIRST_ON_LOG; \
        LOG_WRN("STCP[%s:%d][LR:%p]: " msg, __FILE__, __LINE__, __builtin_return_address(0) , ##__VA_ARGS__ ); \
    } while (0)

# define LINF(msg, ...) \
    do { \
        DO_FIRST_ON_LOG; \
        LOG_INF("STCP[%s:%d][LR:%p]: " msg, __FILE__, __LINE__, __builtin_return_address(0) , ##__VA_ARGS__ ); \
    } while (0)

# define LERR(msg, ...)  \
    do { \
        DO_FIRST_ON_LOG; \
        LOG_ERR("STCP[%s:%d][LR:%p]: " msg, __FILE__, __LINE__, __builtin_return_address(0) , ##__VA_ARGS__ ); \
    } while (0)
#else
# define SDBG(msg, ...)  do { } while(0)
# define LDBG(msg, ...)  do { } while(0)
# define LWRN(msg, ...)  do { } while(0)
# define LINF(msg, ...)  do { } while(0)
# define LERR(msg, ...)  do { } while(0)
#endif

#define STCP_CLOSE_FD(theFD) \
    do { \
        LERR("Closing fd: %d", theFD); \
        zsock_close(theFD); \
        LERR("Closed: %d", theFD); \
    } while(0)

#define STCP_CONTEXT_GUARD_WITH_RET(theCtx, invalidRet) \
    do { \
        if (stcp_is_context_valid(theCtx) != 1) { \
            LERR("Context %p not valid!", theCtx); \
            return invalidRet; \
        } \
    } while(0)

#define STCP_CONTEXT_GUARD_VOID_RET(theCtx, invalidRet) \
    do { \
        if (stcp_is_context_valid(theCtx) != 1) { \
            LERR("Context %p not valid!", theCtx); \
            return; \
        } \
    } while(0)
```

## include/stcp_bridge.h
```c
#pragma once
#include <zephyr/kernel.h>
#include <zephyr/net/socket.h>

int stcp_exported_rust_ctx_alive_count(void);

void stcp_hexdump_ascii(const char *prefix, const uint8_t *buf, size_t len);

int stcp_is_context_valid(void *vpCtx);
void stcp_sleep_ms(uint32_t ms);
int stcp_get_pending_fd_error(int fd);
int stcp_tcp_timeout_set_to_fd(int fd, int timeout_ms);
```

## include/stcp_net.h
```c
#pragma once
#include <stddef.h>
#include <stdint.h>

#ifdef __cplusplus
extern "C" {
#endif

#ifndef IPPROTO_STCP
#define IPPROTO_STCP 253
#endif

#define STCP_NET_FLAGS_POLL_RX      1

// kutsu mainista kun sock luotu
void stcp_net_set_sock(int sock);
int stcp_net_send(struct stcp_ctx *ctx, const uint8_t *buf, size_t len);
int stcp_net_recv(struct stcp_ctx *ctx, uint8_t *buf, size_t max_len, int flags);



#ifdef __cplusplus
}
#endif
```

## include/stcp_operations_zephyr.h
```c
#pragma once
#include <zephyr/kernel.h>
#include <zephyr/net/socket.h>
#include <zephyr/net/socket_offload.h>
#include <zephyr/sys/fdtable.h>
#include <zephyr/sys/util.h>

#include <errno.h>

#include "stcp.h"
#include "stcp_struct.h"
#include "stcp_net.h"
#include "stcp_operations_zephyr.h"

#ifndef IPPROTO_STCP
#define IPPROTO_STCP 253
#endif

/*

 */
int stcp_close(void *obj);
int stcp_context_connect(struct stcp_ctx *ctx,
                         struct sockaddr *addr,
                         socklen_t addrlen,
                         int timeout_ms);

int stcp_net_close_fd(int *fd);

bool stcp_is_supported(int family, int type, int proto);
int stcp_socket(int family, int type, int proto);
```

## include/stcp_tcp_low_level_operations.h
```c
#pragma once
#include <zephyr/kernel.h>
#include <zephyr/net/socket.h>
#include <zephyr/net/socket_offload.h>
#include <zephyr/sys/fdtable.h>
#include <zephyr/sys/util.h>
#include <stdint.h>
#include <errno.h>

#include "stcp.h"
#include "stcp_struct.h"
```

## include/stcp_transport.h
```c
#pragma once
#include <stddef.h>
#include <stdint.h>

int stcp_transport_set_connected_fd(int fd);
int stcp_transport_init(void);
int stcp_transport_connect(void);
int stcp_transport_wait_until_ready(int seconds);
int stcp_transport_soft_reset(void * vpCtx);

int stcp_lte_is_registered(void);
int stcp_pdn_is_active();
int stcp_is_reset_requested();
int stcp_poll_fd_changes(int fd, int timeout, int events);
int stcp_update_cell_event_wait_until_seen_or_secs_passed(int seconds);
int stcp_pdn_wait_until_active_or_secs_passed(int seconds);


int stcp_transport_send(struct stcp_ctx *ctx, const uint8_t *buf, size_t len);
int stcp_transport_recv(struct stcp_ctx *ctx, uint8_t *buf, size_t maxlen);
void stcp_transport_close(void *vpCtx);
```

## include/utils.h
```c
#pragma once
#include <zephyr/kernel.h>
#include <zephyr/net/socket.h>
#include <zephyr/logging/log.h>
#include <errno.h>
#include <string.h>
#include <stdlib.h>
#include <zephyr/init.h>
#include <modem/lte_lc.h>

#include <zephyr/sys/heap_listener.h>
#include <zephyr/sys/sys_heap.h>
#include <zephyr/kernel.h>

#include <zephyr/net/socket.h>
#include <zephyr/net/net_ip.h>
#include <errno.h>
#include <zephyr/sys/atomic.h>
#include <modem/nrf_modem_lib.h>

#include "stcp_struct.h"
#include "stcp_net.h"
#include "workers.h"
#include "stcp_bridge.h"
#include "stcp_operations_zephyr.h"

#include "stcp_rust_exported_functions.h"

#include <stcp.h>

#define STCP_USE_LTE			1
#include "debug.h"

// LTE / BT kytkin ...
#define TEST_CONNECTON_TO_HOST 	"lja.fi"
#define TEST_CONNECTON_TO_PORT 	"7777"
#define STCP_WAIT_IN_SECONDS    180

#define STCP_HEAP_DEBUG         0

#include "stcp_transport.h"
#include "stcp_net.h"
#include "stcp_operations_zephyr.h"
#include "stcp_platform.h"
#include "stcp_transport.h"

struct addrinfo *resolve_to_connect(const char *host, const char *port);
int              stcp_tcp_resolve_and_make_socket(const char *host, const char *port);

struct stcp_ctx *stcp_tcp_resolve_and_make_context(const char *host, const char *port);
int              stcp_tcp_do_hanshake_with_context(struct stcp_ctx *ctx);

int stcp_tcp_context_connect_and_shake_hands(struct stcp_ctx *ctx, int timeout_ms);


int stcp_config_debug_enabled();
int stcp_config_aes_bypass_enabled();
```

## src/fsm.c
```c
#include <zephyr/logging/log.h>
#include <zephyr/kernel.h>
#include <stdbool.h>
#include "fsm.h"
#include "stcp_lte_fsm.h"

void stcp_fsm_init(struct stcp_fsm *fsm);
void stcp_fsm_start(struct stcp_fsm *fsm);
void stcp_fsm_notify_lte_ready(struct stcp_fsm *fsm);
void stcp_fsm_notify_pdn_ready(struct stcp_fsm *fsm);

LOG_MODULE_REGISTER(stcp_fsm, LOG_LEVEL_INF);

#include "fsm.h"
#include "debug.h"
#include "stcp_alloc.h"
#include "stcp_struct.h"
#include "stcp_bridge.h"
#include "stcp_net.h"
#include "workers.h"
#include "utils.h"
#include "stcp_operations_zephyr.h"

#include "stcp_rust_exported_functions.h"

#define STCP_FSM_REAL_IMPL 1
extern struct stcp_ctx* theStcpContext;

static void stcp_fsm_thread(void *p1, void *p2, void *p3)
{
    struct stcp_fsm *fsm = p1;

    if (p1 == NULL) {
        LDBG("p1 == NULL!");
        return;
    }

    LOG_INF("fsm=%p ctx_ptr=%p", fsm, fsm->ctx);

    while (!fsm->stop) {
        switch (fsm->state) {

        case STCP_FSM_INIT:
            LDBG("[FSM] INIT");
            fsm->state = STCP_FSM_WAIT_LTE;
            break;

        case STCP_FSM_WAIT_LTE:
            LDBG("[FSM] WAIT LTE");
            k_sem_take(&(fsm->lte_ready), K_FOREVER);
            fsm->state = STCP_FSM_WAIT_PDN;
            break;

        case STCP_FSM_WAIT_PDN:
            LDBG("[FSM] WAIT PDN");
            k_sem_take(&(fsm->pdn_ready), K_FOREVER);
            fsm->state = STCP_FSM_WAIT_IP;
            break;

        case STCP_FSM_WAIT_IP:
            LDBG("[FSM] WAIT IP");
            k_sem_take(&(fsm->ip_ready), K_FOREVER);
            fsm->state = STCP_FSM_WAIT_STABLE;
            break;

        case STCP_FSM_WAIT_STABLE:
            LDBG("[FSM] LTE stable settle time...");
            k_sleep(K_SECONDS(3));
            fsm->state = STCP_FSM_TCP_CONNECT;
            break;

        case STCP_FSM_TCP_CONNECT:
            LDBG("[FSM] TCP CONNECT");
#if STCP_FSM_REAL_IMPL
            struct stcp_ctx *ctx = stcp_tcp_resolve_and_make_context("lja.fi", "7777");
            if (!ctx) {
                LWRN("[FSM] ctx alloc failed");
                k_sleep(K_SECONDS(3));
                break;
            }

            if (ctx != NULL) {
                fsm->ctx = ctx;
                theStcpContext = ctx;
                fsm->state = STCP_FSM_STCP_HANDSHAKE;
            } else {
                //stcp_transport_close(ctx);
                //fsm->ctx = NULL;
                k_sleep(K_SECONDS(3));
                fsm->state = STCP_FSM_TCP_RECONNECT;
            }
#endif
            break;

        case STCP_FSM_STCP_HANDSHAKE: {
            LDBG("[FSM] STCP HANDSHAKE");
#if STCP_FSM_REAL_IMPL
            int rc = stcp_tcp_context_connect_and_shake_hands(fsm->ctx, 3*60*1000);
            if (rc == 1) {
                fsm->state = STCP_FSM_RUN;
            } else {
                LWRN("[FSM] HS failed rc=%d", rc);
                stcp_transport_close(theStcpContext);
                fsm->state = STCP_FSM_TCP_RECONNECT;
            }
#endif
            break;
        }

        case STCP_FSM_RUN:
            LDBG("[FSM] RUN");
#if STCP_FSM_REAL_IMPL
            LDBG("[FSM] Starting AES loop....");
            int rc = 0;
            while (!fsm->stop) {
                rc = stcp_run_loop(fsm->ctx);
                if (rc < 0) {
                    LWRN("[FSM] RUN loop error %d", rc);
                    fsm->state = STCP_FSM_TCP_RECONNECT;
                    break;
                }
                k_sleep(K_MSEC(5));
            }
#endif
            LDBG("[FSM] AES loop ended, rc: %d", rc);
            break;

        case STCP_FSM_TCP_RECONNECT:
            LDBG("[FSM] TCP RECONNECT");
#if STCP_FSM_REAL_IMPL
            stcp_transport_close(fsm->ctx);
#endif 
            k_sleep(K_SECONDS(3));
            fsm->state = STCP_FSM_TCP_CONNECT;
            break;

        case STCP_FSM_FATAL:
        default:
            LERR("[FSM] FATAL STATE");
            k_sleep(K_SECONDS(10));
            break;
        }
    }
    LDBG("Found out...");
}


#define STCP_FSM_STACK_SIZE 4096

K_THREAD_STACK_DEFINE(stcp_fsm_stack, 8192);
static struct k_thread stcp_fsm_thread_data;
static k_tid_t stcp_fsm_tid;

void stcp_fsm_init(struct stcp_fsm *fsm)
{
    memset(fsm, 0, sizeof(*fsm));

    k_sem_init(&fsm->lte_ready, 0, 1);
    k_sem_init(&fsm->pdn_ready, 0, 1);
    k_sem_init(&fsm->ip_ready, 0, 1);

    fsm->ctx = NULL;
    fsm->state = STCP_FSM_INIT;

    stcp_fsm_tid = k_thread_create(
        &stcp_fsm_thread_data,
        stcp_fsm_stack,
        K_THREAD_STACK_SIZEOF(stcp_fsm_stack),
        stcp_fsm_thread,
        fsm, NULL, NULL,
        5, 0, K_NO_WAIT
    );
}

void stcp_fsm_reached_ip_network_up(struct stcp_fsm *fsm) 
{
    if (fsm) {
        k_sem_give(&fsm->ip_ready);
    }
}

void stcp_fsm_reached_lte_ready(struct stcp_fsm *fsm) 
{
    if (fsm) {
        k_sem_give(&fsm->lte_ready);
    }
}

void stcp_fsm_reached_pnd_ready(struct stcp_fsm *fsm) 
{
    if (fsm) {
        k_sem_give(&fsm->pdn_ready);
    }
}

void stcp_fsm_start(struct stcp_fsm *fsm)
{
    k_thread_start(stcp_fsm_tid);
}

void stcp_fsm_notify_lte_ready(struct stcp_fsm *fsm)
{
    k_sem_give(&fsm->lte_ready);
}

void stcp_fsm_notify_pdn_ready(struct stcp_fsm *fsm)
{
    k_sem_give(&fsm->pdn_ready);
}
```

## src/network_testing.c
```c
#include <zephyr/kernel.h>
#include <zephyr/net/socket.h>
#include <zephyr/logging/log.h>
#include <errno.h>
#include <string.h>
#include <stdlib.h>
#include <zephyr/init.h>
#include <modem/lte_lc.h>

#include <zephyr/sys/heap_listener.h>
#include <zephyr/sys/sys_heap.h>
#include <zephyr/kernel.h>

#include <zephyr/net/socket.h>
#include <zephyr/net/net_ip.h>
#include <errno.h>
#include <zephyr/sys/atomic.h>
#include <modem/nrf_modem_lib.h>

#include "stcp_struct.h"
#include "stcp_net.h"
#include "workers.h"
#include "utils.h"
#include "fsm.h"
#include "stcp_bridge.h"
#include "stcp_operations_zephyr.h"

#include "stcp_rust_exported_functions.h"

LOG_MODULE_REGISTER(stcp_tcp_tester, LOG_LEVEL_INF);

int stcp_network_test_dns(const char *host, const char *port,
                               struct sockaddr_in *out)
{
    struct addrinfo hints = { 0 };
    struct addrinfo *res = NULL;
    int rc;

    hints.ai_family = AF_INET;
    hints.ai_socktype = SOCK_STREAM;

    LOG_INF("DNS test: resolving %s:%s", host, port);

    rc = zsock_getaddrinfo(host, port, &hints, &res);
    if (rc != 0) {
        LOG_ERR("getaddrinfo failed rc=%d errno=%d", rc, errno);
        return -errno;
    }

    struct sockaddr_in *addr = (struct sockaddr_in *)res->ai_addr;

    char ip[NET_IPV4_ADDR_LEN];
    net_addr_ntop(AF_INET, &addr->sin_addr, ip, sizeof(ip));

    LOG_INF("DNS OK: %s -> %s:%d", host, ip, ntohs(addr->sin_port));

    if (out) {
        memcpy(out, addr, sizeof(*out));
    }

    zsock_freeaddrinfo(res);
    return 0;
}

int stcp_network_ping_ip(const struct sockaddr_in *addr)
{
    int fd = zsock_socket(AF_INET, SOCK_DGRAM, IPPROTO_ICMP);
    if (fd < 0) {
        LERR("ping socket failed errno=%d", errno);
        return -errno;
    }

    char dummy = 0;
    int rc = zsock_sendto(fd, &dummy, 1, 0,
                          (struct sockaddr *)addr, sizeof(*addr));
// pois     zsock_close(fd);

    LDBG("Ping send rc=%d errno=%d", rc, errno);
    return rc;
}

int stcp_network_test_tcp_connect(const struct sockaddr_in *addr)
{
    int fd = zsock_socket(AF_INET, SOCK_STREAM, IPPROTO_TCP);
    if (fd < 0) {
        LERR("socket failed errno=%d", errno);
        return -errno;
    }

    struct timeval tv = {
        .tv_sec = 5,
        .tv_usec = 0,
    };
    zsock_setsockopt(fd, SOL_SOCKET, SO_SNDTIMEO, &tv, sizeof(tv));
    zsock_setsockopt(fd, SOL_SOCKET, SO_RCVTIMEO, &tv, sizeof(tv));

    LDBG("TCP connect test...");

    int rc = zsock_connect(fd, (struct sockaddr *)addr, sizeof(*addr));
    if (rc < 0) {
        LERR("connect failed errno=%d", errno);
// pois         zsock_close(fd);
        return -errno;
    }

    LDBG("TCP connect OK!");
// pois     zsock_close(fd);
    return 0;
}

int stcp_network_test_network_avalability(const char *host, const char *port) {
    struct sockaddr_in theAddr;
    int err = stcp_network_test_dns(host, port, &theAddr);
    if ( err < 0 ) {
        return -1;
    }
    
/* EI LTE verkossa toimi
    err = stcp_network_ping_ip(&theAddr);
    if ( err < 0 ) {
        return -2;
    }
*/
    err = stcp_network_test_tcp_connect(&theAddr);
    if ( err < 0 ) {
        return -3;
    }

    return 0;
}
```

## src/rust_log_with_printk.c
```c
// debug_bridge.c
#include <zephyr/logging/log.h>
#include "debug.h"
LOG_MODULE_REGISTER(stcp_loggin_with_ldbg, LOG_LEVEL_INF);

#include <zephyr/kernel.h>

#include "debug.h"
#include "utils.h"

#define LOG_BUFFER_SIZE_BYTES   (1024*4)
void stcp_rust_log(int level, const uint8_t *buf, uintptr_t len)
{
    if (! stcp_config_debug_enabled() ) {
        return;
    }

    // Check ratelimitter
    static const char *lvl[] = {
        "??",   // 0
        "ERR",  // 1
        "WRN",  // 2
        "INF",  // 3
        "DBG",  // 4
        "TRC",  // 5
    };

    char tmp[LOG_BUFFER_SIZE_BYTES];
    size_t n;

    if (!buf || !len)
        return;

    if (len >= sizeof(tmp))
        n = sizeof(tmp) - 1;
    else
        n = len;

    memcpy(tmp, buf, n);
    tmp[n] = '\0';

    if (level < 0 || level > 5)
        level = 4;

    // Yksinkertainen printk – ei mitään ihmeellistä
    LOG_INF("RUST[%s]: %s", lvl[level], tmp);

}
```

## src/stcp_alloc_zephyr.c
```c
#include <zephyr/kernel.h>
#include <errno.h>
#include <stdint.h>
#include <stddef.h>
#include "debug.h"
LOG_MODULE_REGISTER(stcp_c_memory_allocations, LOG_LEVEL_INF);

#define STCP_MEM_DEBUG 0 

/*
 * Toteutus 1: Zephyr system heap (k_malloc/k_free)
 * -> vaatii CONFIG_HEAP_MEM_POOL_SIZE > 0
 */

void *stcp_alloc(size_t n)
{
    if (n == 0) n = 1;
    void *p = k_malloc(n);
#if STCP_MEM_DEBUG
    SDBG("MEM: Alloc %d => %p", n, p);
#endif
    return p;
}

void stcp_free(void *p)
{
    if (p) {

#if STCP_MEM_DEBUG
        SDBG("MEM: Free %p", p);
#endif
        k_free(p);
    }
}

/*
 * Optionaalinen: aligned alloc.
 * Jos Rust/crypto joskus tarvitsee isompaa alignia.
 * Demossa voi jättää pois ja palata tähän jos tulee alignment-hardfault.
 */
void *stcp_alloc_aligned(size_t align, size_t n)
{
    if (n == 0) n = 1;
#if defined(CONFIG_COMMON_LIBC_MALLOC) || defined(CONFIG_MINIMAL_LIBC_MALLOC) || defined(CONFIG_NEWLIB_LIBC)
    /* jos libc tarjoaa aligned_alloc */
    /* HUOM: C11 aligned_alloc vaatii size multiple of align */
    size_t sz = (n + (align - 1)) & ~(align - 1);
    extern void *aligned_alloc(size_t, size_t);
    return aligned_alloc(align, sz);
#else
    /* fallback: ei toteutettu */
    (void)align;
    return NULL;
#endif
}

void stcp_free_aligned(void *p)
{
    stcp_free(p);
}
```

## src/stcp_bridge.c
```c
#include <zephyr/logging/log.h>
#include "debug.h"
#include <zephyr/kernel.h>
#include <zephyr/net/socket.h>
#include <zephyr/sys/heap_listener.h>
#include <zephyr/kernel.h>
#include <stddef.h>
#include <stdint.h>
#include <zephyr/sys/heap_listener.h>
#include <zephyr/sys/sys_heap.h>
#include <zephyr/kernel.h>

#include "settings.h"
#include "stcp_alloc.h"
#include "stcp_struct.h"
#include "stcp_bridge.h"
#include "stcp_net.h"
#include "utils.h"
#include "stcp_operations_zephyr.h"


#include "stcp_rust_exported_functions.h"

LOG_MODULE_REGISTER(stcp_brige_operations, LOG_LEVEL_INF);

#define STCP_DEBUG_DUMP_ENABLED             1
#define STCP_DEBUG_DUMP_MAX_DUMP_LENGTH     512

#include <zephyr/sys/heap_listener.h>

static void on_heap_alloc(uintptr_t heap_id, void *mem, size_t bytes)
{
    LOG_ERR("HEAP ALLOC: heap=%lu ptr=%p size=%u", heap_id, mem, (unsigned)bytes);
}

static void on_heap_free(uintptr_t heap_id, void *mem, size_t bytes)
{
    LOG_ERR("HEAP FREE: heap=%lu ptr=%p size=%u", heap_id, mem, (unsigned)bytes);
}

static void on_heap_resize(uintptr_t heap_id, void *mem, size_t bytes)
{
    LOG_ERR("HEAP RESIZE: heap=%lu ptr=%p size=%u", heap_id, mem, (unsigned)bytes);
}

HEAP_LISTENER_ALLOC_DEFINE(stcp_alloc_listener, HEAP_ID_LIBC, on_heap_alloc);
HEAP_LISTENER_FREE_DEFINE(stcp_free_listener, HEAP_ID_LIBC, on_heap_free);
HEAP_LISTENER_RESIZE_DEFINE(stcp_resize_listener, HEAP_ID_LIBC, on_heap_resize);

void heap_debug_init(void)
{
    heap_listener_register(&stcp_alloc_listener);
    heap_listener_register(&stcp_free_listener);
    heap_listener_register(&stcp_resize_listener);
}


int stcp_exported_rust_ctx_alive_count(void) 
{
    // Not enabled
    return -1;
}

void stcp_hexdump_ascii(const char *prefix, const uint8_t *buf, size_t len)
{

    if (!stcp_config_debug_enabled()) {
        return ;
    }

#if STCP_DEBUG_DUMP_ENABLED
    const size_t cols = 16;

    if (len > STCP_DEBUG_DUMP_MAX_DUMP_LENGTH) {
        len = STCP_DEBUG_DUMP_MAX_DUMP_LENGTH;
    }

    if (prefix) {
        printk("%s (len=%u):\n", prefix, (unsigned)len);
    }

    for (size_t i = 0; i < len; i += cols) {
        printk("%04x  ", (unsigned)i);
        /* Hex */
        for (size_t j = 0; j < cols; j++) {
            if (i + j < len) {
                printk("%02x ", buf[i + j]);
            } else {
                printk("   ");
            }
        }

        printk(" |");

        /* ASCII */
        for (size_t j = 0; j < cols && i + j < len; j++) {
            uint8_t c = buf[i + j];
            if (c >= 32 && c <= 126) {
                printk("%c", c);
            } else {
                printk(".");
            }
        }

        printk("|\n");
    }
#endif
}

int stcp_is_context_valid(void *vpCtx) {
    struct stcp_ctx * ctx = vpCtx;
    
    if (!ctx) {
        LDBG("STCP Context null");
        return -EINVAL;
    } else {
        LDBG("STCP Context check: ctx ptr ok? %p", ctx);
    }

    if (!ctx->session) {
        LDBG("STCP RUST Session null!\n");
        return -EINVAL;
    } else {
        LDBG("STCP Context check: session ptr ok....");
    }

    if (!ctx->handshake_done) {
        LDBG("Not handshake done, not checking the FD's...");
        return 1;
    }
    
    // Checking FD's
    if (ctx->ks.fd > 0) {
        LDBG("STCP Context check: Transport FD....");
        int rc2 = stcp_is_file_desc_alive(ctx->ks.fd);
        if (rc2 < 0) {
            ctx->ks.fd = -1;
            LDBG("STCP RUST FD for Transport not ok!, RC: %d\n", rc2);
            return -EINVAL;
        }
    } else {
        LDBG("FD for transport is set -1 => NOT checking");
    }

    return 1;
}

int stcp_is_file_desc_alive(int fd) {
    uint8_t tmp;
    int ret = zsock_recv(fd, &tmp, 1, ZSOCK_MSG_PEEK | ZSOCK_MSG_DONTWAIT);

    if (ret == 0) {
        return 0;
    } else if (ret < 0 && errno == EAGAIN) {
        return 1;
    }
    return -1;
}

int stcp_get_pending_fd_error(int fd)
{
    
    if (fd < 0 ) {
        LDBG("STCP Context is destroyed!\n");
        return -EBADFD;
    }

    int err = 0;
    socklen_t len = sizeof(err);

    zsock_getsockopt(fd, SOL_SOCKET, SO_ERROR, &err, &len);


    return err;
}


void stcp_sleep_ms(uint32_t ms)
{
    k_msleep(ms);
}


int stcp_tcp_timeout_set_to_fd(int fd, int timeout_ms) {
    LDBG("Setting timeout of %d seconds for reading from fd: %d",
        timeout_ms / 1000, fd);
    int rc = zsock_setsockopt(fd,
                            SOL_SOCKET,
                            SO_RCVTIMEO,
                            &timeout_ms,
                            sizeof(timeout_ms));
    return rc;
}
```
