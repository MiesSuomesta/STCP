## prj.conf
```kconfig
#
# Console
#
CONFIG_SERIAL=y
CONFIG_CONSOLE=y
CONFIG_UART_CONSOLE=y
CONFIG_PRINTK=y

#
# Logging
#
CONFIG_LOG=y
CONFIG_LOG_MODE_DEFERRED=y
CONFIG_LOG_DEFAULT_LEVEL=3
CONFIG_KERNEL_LOG_LEVEL_WRN=y
CONFIG_LOG_BACKEND_UART=y

#
# Network
#
CONFIG_NETWORKING=y
CONFIG_NET_NATIVE=n
CONFIG_NET_SOCKETS=y
CONFIG_NET_SOCKETS_OFFLOAD=y
CONFIG_NET_IPV4=y
CONFIG_NET_IPV6=y
CONFIG_NET_TCP=y
CONFIG_NET_UDP=y

#
# MQTT
#
CONFIG_MQTT_LIB=y

#
# STCP
#
CONFIG_STCP=y

#
# Memory
#
CONFIG_HEAP_MEM_POOL_SIZE=98304
CONFIG_MAIN_STACK_SIZE=8192
CONFIG_SYSTEM_WORKQUEUE_STACK_SIZE=4096

#
# Utilities
#
CONFIG_RING_BUFFER=y
CONFIG_REBOOT=y
CONFIG_ENTROPY_GENERATOR=y
CONFIG_THREAD_NAME=y
CONFIG_ASSERT=y

#
# Debug
#
CONFIG_SPEED_OPTIMIZATIONS=y
CONFIG_ASSERT_VERBOSE=n

# Echo benchmark (first run: plain TCP)
CONFIG_ECHO_TRANSPORT_TCP=y
CONFIG_ECHO_SERVER_HOST="lja.fi"
CONFIG_ECHO_SERVER_PORT="19000"
CONFIG_ECHO_SOCKET_TIMEOUT_MS=60000

# Streaming throughput benchmark
CONFIG_BENCH_TOTAL_BYTES=1048576
CONFIG_BENCH_MAX_CHUNK_SIZE=65536
CONFIG_BENCH_CHUNK_SIZE=4096
CONFIG_BENCH_PAUSE_SECONDS=5
CONFIG_BENCH_REPORT_INTERVAL_MS=5000
CONFIG_BENCH_SENDER_STACK_SIZE=4096
CONFIG_BENCH_FULL_RX_BUFFER_SIZE=4096

# Optional interactive test bench. Set to n to compile it completely out.
CONFIG_STCP_BENCH_SHELL=y
CONFIG_STCP_BENCH_AUTORUN=n
CONFIG_SHELL_BACKEND_SERIAL=y
CONFIG_SHELL_PROMPT_UART="stcp> "

# STCPv1-style LTE transport initialization
CONFIG_NRF_MODEM_LIB=y
CONFIG_LTE_LINK_CONTROL=y
CONFIG_LTE_LC_PDN_MODULE=y
CONFIG_STCP_LTE_REG_TIMEOUT_SECONDS=300
CONFIG_STCP_LTE_PDN_TIMEOUT_SECONDS=300

# APN handling is opt-in. Normal builds use the SIM/operator defaults.
# CONFIG_STCP_LTE_FORCE_DEFAULT_APN=y
CONFIG_STCP_LTE_CUSTOM_PDN=y

# To force CID 0 APN, enable and configure:
CONFIG_STCP_LTE_FORCE_DEFAULT_APN=y
CONFIG_STCP_LTE_DEFAULT_APN="internet"

# To create a separate PDN and bind benchmark sockets to it:
CONFIG_STCP_LTE_CUSTOM_PDN=y
CONFIG_STCP_LTE_APN="internet"

# STCP AF_STCP offload does not support fcntl O_NONBLOCK yet.
CONFIG_BENCH_STCP_BLOCKING_CONNECT=y
```

## ethernet-v2.conf
```kconfig
# STCPv2 Ethernet build for nRF9151 DK + Seeed W5500

# Console and shell
CONFIG_SERIAL=y
CONFIG_CONSOLE=y
CONFIG_UART_CONSOLE=y
CONFIG_PRINTK=y
CONFIG_SHELL=y
CONFIG_SHELL_BACKEND_SERIAL=y
CONFIG_SHELL_PROMPT_UART="stcp> "

# Logging
CONFIG_LOG=y
CONFIG_LOG_MODE_DEFERRED=y
CONFIG_LOG_DEFAULT_LEVEL=2
CONFIG_KERNEL_LOG_LEVEL_WRN=y
CONFIG_LOG_BACKEND_UART=y
CONFIG_SPI_LOG_LEVEL_WRN=y
CONFIG_ETHERNET_LOG_LEVEL_INF=y
CONFIG_NET_LOG=n

# Native Zephyr network stack
CONFIG_NETWORKING=y
CONFIG_NET_BUF=y
CONFIG_NET_NATIVE=y
CONFIG_NET_IPV4=y
CONFIG_NET_IPV6=n
CONFIG_NET_TCP=y
CONFIG_NET_UDP=y
CONFIG_NET_SOCKETS=y
CONFIG_NET_SOCKETS_OFFLOAD=n
CONFIG_NET_L2_ETHERNET=y
CONFIG_ETH_W5500=y
CONFIG_SPI=y
CONFIG_GPIO=y
CONFIG_NET_ARP=y

# Static LAN configuration
CONFIG_NET_DHCPV4=n
CONFIG_NET_CONFIG_SETTINGS=y
CONFIG_NET_CONFIG_AUTO_INIT=y
CONFIG_NET_CONFIG_NEED_IPV4=y
CONFIG_NET_CONFIG_INIT_TIMEOUT=10
CONFIG_NET_CONFIG_MY_IPV4_ADDR="192.168.1.50"
CONFIG_NET_CONFIG_MY_IPV4_NETMASK="255.255.255.0"
CONFIG_NET_CONFIG_MY_IPV4_GW="192.168.1.111"

# Network management and diagnostics
CONFIG_NET_MGMT=y
CONFIG_NET_MGMT_EVENT=y
CONFIG_NET_CONNECTION_MANAGER=y
CONFIG_NET_SHELL=y
CONFIG_NET_STATISTICS=y

# MQTT and STCP
CONFIG_MQTT_LIB=y

# Memory
#CONFIG_HEAP_MEM_POOL_SIZE=98304
CONFIG_HEAP_MEM_POOL_SIZE=32768
CONFIG_MAIN_STACK_SIZE=4096
CONFIG_SYSTEM_WORKQUEUE_STACK_SIZE=4096

# Utilities
CONFIG_RING_BUFFER=y
CONFIG_REBOOT=y
CONFIG_ENTROPY_GENERATOR=y
CONFIG_THREAD_NAME=y
CONFIG_ASSERT=y
CONFIG_SPEED_OPTIMIZATIONS=y
CONFIG_ASSERT_VERBOSE=n

# Echo benchmark
CONFIG_ECHO_TRANSPORT_STCP=y
CONFIG_ECHO_SERVER_HOST="192.168.1.20"
CONFIG_ECHO_SERVER_PORT="19000"
CONFIG_ECHO_SOCKET_TIMEOUT_MS=60000
CONFIG_BENCH_TOTAL_BYTES=1048576
CONFIG_BENCH_MAX_CHUNK_SIZE=65536
#OLI CONFIG_BENCH_CHUNK_SIZE=16384
CONFIG_BENCH_CHUNK_SIZE=4096
CONFIG_BENCH_PAUSE_SECONDS=5
CONFIG_BENCH_REPORT_INTERVAL_MS=5000
CONFIG_BENCH_SENDER_STACK_SIZE=4096
CONFIG_BENCH_FULL_RX_BUFFER_SIZE=4096
CONFIG_STCP_BENCH_SHELL=y
CONFIG_STCP_BENCH_AUTORUN=n

# Ethernet build: modem/LTE stack disabled
CONFIG_NRF_MODEM_LIB=n
CONFIG_LTE_LINK_CONTROL=n
CONFIG_PDN=n

CONFIG_BENCH_STCP_BLOCKING_CONNECT=y

# PSA_CRYPTO_CLIENT is generated/hidden in NCS 3.3.0; do not assign it directly.
# Client benchmark needs one active STCP socket; keep one spare for recovery.
# The RX stack is embedded in every pool entry, so limiting the pool saves
# 24+ KiB of static RAM compared with the default eight sockets.
CONFIG_MBEDTLS_PSA_CRYPTO_C=y

# Run benchmark and Rust STCP session creation outside shell_uart.
CONFIG_BENCH_WORKER_STACK_SIZE=8192
CONFIG_BENCH_WORKER_PRIORITY=5
CONFIG_THREAD_STACK_INFO=y



# Clean STCPv2 Zephyr adapter: custom AF_STCP provider, not global socket offload.
CONFIG_STCP_V2=y
CONFIG_STCP_V2_SOCKET_PRIORITY=20
CONFIG_STCP_V2_MAX_SOCKETS=2
CONFIG_STCP_V2_CONNECT_TIMEOUT_MS=60000
CONFIG_STCP_V2_LOG_LEVEL=3
CONFIG_STCP_V2_RUST_TOOLCHAIN="nightly"
#CONFIG_STCP_V2_RX_STACK_SIZE=3072
CONFIG_STCP_V2_RX_STACK_SIZE=8192
CONFIG_STCP_V2_RX_PRIORITY=7
CONFIG_STCP_V2_RX_BUFFER_SIZE=2048
CONFIG_STCP_V2_X25519_SOFTWARE=y
CONFIG_STCP_V2_TRACE_WIRE=n
CONFIG_STCP_V2_TRACE_EVENTS=n
CONFIG_STCP_V2_TRACE_ALLOC=n
CONFIG_STCP_V2_TRACE_CRYPTO=n

# AF_STCP connect is deliberately blocking in the benchmark shell for bring-up.
```

## ethernet.conf
```kconfig
# STCPv2 Ethernet build for nRF9151 DK + Seeed W5500

# Console and shell
CONFIG_SERIAL=y
CONFIG_CONSOLE=y
CONFIG_UART_CONSOLE=y
CONFIG_PRINTK=y
CONFIG_SHELL=y
CONFIG_SHELL_BACKEND_SERIAL=y
CONFIG_SHELL_PROMPT_UART="stcp> "

# Logging
CONFIG_LOG=y
CONFIG_LOG_MODE_DEFERRED=y
CONFIG_LOG_DEFAULT_LEVEL=2
CONFIG_KERNEL_LOG_LEVEL_WRN=y
CONFIG_LOG_BACKEND_UART=y
CONFIG_SPI_LOG_LEVEL_WRN=y
CONFIG_ETHERNET_LOG_LEVEL_INF=y
CONFIG_NET_LOG=n

# Native Zephyr network stack
CONFIG_NETWORKING=y
CONFIG_NET_BUF=y
CONFIG_NET_NATIVE=y
CONFIG_NET_IPV4=y
CONFIG_NET_IPV6=n
CONFIG_NET_TCP=y
CONFIG_NET_UDP=y
CONFIG_NET_SOCKETS=y
CONFIG_NET_SOCKETS_OFFLOAD=n
CONFIG_NET_L2_ETHERNET=y
CONFIG_ETH_W5500=y
CONFIG_SPI=y
CONFIG_GPIO=y
CONFIG_NET_ARP=y

# Static LAN configuration
CONFIG_NET_DHCPV4=n
CONFIG_NET_CONFIG_SETTINGS=y
CONFIG_NET_CONFIG_AUTO_INIT=y
CONFIG_NET_CONFIG_NEED_IPV4=y
CONFIG_NET_CONFIG_INIT_TIMEOUT=10
CONFIG_NET_CONFIG_MY_IPV4_ADDR="192.168.1.50"
CONFIG_NET_CONFIG_MY_IPV4_NETMASK="255.255.255.0"
CONFIG_NET_CONFIG_MY_IPV4_GW="192.168.1.111"

# Network management and diagnostics
CONFIG_NET_MGMT=y
CONFIG_NET_MGMT_EVENT=y
CONFIG_NET_CONNECTION_MANAGER=y
CONFIG_NET_SHELL=y
CONFIG_NET_STATISTICS=y

# MQTT and STCP
CONFIG_MQTT_LIB=y
CONFIG_STCP=y

# Memory
CONFIG_HEAP_MEM_POOL_SIZE=98304
CONFIG_MAIN_STACK_SIZE=4096
CONFIG_SYSTEM_WORKQUEUE_STACK_SIZE=4096

# Utilities
CONFIG_RING_BUFFER=y
CONFIG_REBOOT=y
CONFIG_ENTROPY_GENERATOR=y
CONFIG_THREAD_NAME=y
CONFIG_ASSERT=y
CONFIG_SPEED_OPTIMIZATIONS=y
CONFIG_ASSERT_VERBOSE=n

# Echo benchmark
CONFIG_ECHO_TRANSPORT_TCP=y
CONFIG_ECHO_SERVER_HOST="192.168.1.20"
CONFIG_ECHO_SERVER_PORT="19000"
CONFIG_ECHO_SOCKET_TIMEOUT_MS=60000
CONFIG_BENCH_TOTAL_BYTES=1048576
CONFIG_BENCH_MAX_CHUNK_SIZE=65536
CONFIG_BENCH_CHUNK_SIZE=16384
CONFIG_BENCH_PAUSE_SECONDS=5
CONFIG_BENCH_REPORT_INTERVAL_MS=5000
CONFIG_BENCH_SENDER_STACK_SIZE=4096
CONFIG_BENCH_FULL_RX_BUFFER_SIZE=16384
CONFIG_STCP_BENCH_SHELL=y
CONFIG_STCP_BENCH_AUTORUN=n

# Ethernet build: modem/LTE stack disabled
CONFIG_NRF_MODEM_LIB=n
CONFIG_LTE_LINK_CONTROL=n
CONFIG_PDN=n

# STCP AF_STCP offload does not support fcntl O_NONBLOCK yet.
CONFIG_BENCH_STCP_BLOCKING_CONNECT=y

# Shared Raspberry Pi Rust STCP core
# PSA_CRYPTO_CLIENT is generated/hidden in NCS 3.3.0; do not assign it directly.
CONFIG_STCP_RUST_CORE=y
CONFIG_STCP_RUST_X25519_SOFTWARE=y
# Client benchmark needs one active STCP socket; keep one spare for recovery.
# The RX stack is embedded in every pool entry, so limiting the pool saves
# 24+ KiB of static RAM compared with the default eight sockets.
CONFIG_STCP_MAX_SOCKETS=2
CONFIG_STCP_RUST_TOOLCHAIN="nightly"
CONFIG_STCP_RUST_RX_STACK_SIZE=3072
CONFIG_STCP_RUST_RX_PRIORITY=7
CONFIG_STCP_RUST_RX_BUFFER_SIZE=2048
CONFIG_STCP_RUST_TRACE_WIRE=y
CONFIG_STCP_RUST_TRACE_EVENTS=n
CONFIG_STCP_RUST_TRACE_ALLOC=n
CONFIG_MBEDTLS_PSA_CRYPTO_C=y

# Run benchmark and Rust STCP session creation outside shell_uart.
CONFIG_BENCH_WORKER_STACK_SIZE=8192
CONFIG_BENCH_WORKER_PRIORITY=5
CONFIG_THREAD_STACK_INFO=y

CONFIG_STCP_RUST_TRACE_CRYPTO=y
```

## stcp-v2-clean.conf
```kconfig
CONFIG_STCP_V2=y
CONFIG_NET_SOCKETS=y
CONFIG_NET_SOCKETS_OFFLOAD=n
CONFIG_NET_NATIVE=y
CONFIG_NET_NATIVE_IP=y
CONFIG_NET_NATIVE_IPV4=y
CONFIG_NET_NATIVE_TCP=y
CONFIG_NET_NATIVE_UDP=y
CONFIG_NET_ARP=y
CONFIG_STCP_V2_TRACE_WIRE=n
CONFIG_STCP_V2_TRACE_EVENTS=n
CONFIG_STCP_V2_TRACE_ALLOC=n
CONFIG_STCP_V2_TRACE_CRYPTO=n
```

## boards/nrf9151dk_nrf9151_ns.overlay
```dts
&eth_w5500 {
    spi-max-frequency = <8000000>;
    local-mac-address = [02 00 00 00 91 51];
};
```

## src/ethernet_status.h
```c
#ifndef STCP_ETHERNET_STATUS_H
#define STCP_ETHERNET_STATUS_H

#include <zephyr/shell/shell.h>

int ethernet_status_show(const struct shell *shell);
void ethernet_status_log_startup(void);

#endif
```

## src/mqtt_codec.c
```c
#include "mqtt_codec.h"
#include <errno.h>
#include <string.h>
#include <zephyr/net/socket.h>

static int send_all(int fd, const void *buf, size_t len)
{
    const uint8_t *p = buf;

    while (len) {
        ssize_t n = zsock_send(fd, p, len, 0);
        if (n < 0) {
            return -errno;
        }
        if (n == 0) {
            return -ECONNRESET;
        }
        p += (size_t)n;
        len -= (size_t)n;
    }
    return 0;
}

static size_t enc_rem(uint8_t *out, size_t value)
{
    size_t n = 0;

    do {
        uint8_t d = (uint8_t)(value % 128U);
        value /= 128U;
        if (value) {
            d |= 0x80U;
        }
        out[n++] = d;
    } while (value);

    return n;
}

static int send_mqtt_header(int fd, uint8_t type_flags, size_t remaining)
{
    uint8_t hdr[5];
    size_t n;

    hdr[0] = type_flags;
    n = 1U + enc_rem(&hdr[1], remaining);
    return send_all(fd, hdr, n);
}

static int send_mqtt_str(int fd, const char *s)
{
    size_t len = strlen(s);
    uint8_t prefix[2];
    int rc;

    if (len > UINT16_MAX) {
        return -EMSGSIZE;
    }

    prefix[0] = (uint8_t)(len >> 8);
    prefix[1] = (uint8_t)len;

    rc = send_all(fd, prefix, sizeof(prefix));
    if (rc < 0) {
        return rc;
    }
    return send_all(fd, s, len);
}

int mqtt_send_connect(int fd, const char *id, uint16_t ka)
{
    static const uint8_t variable_header[] = {
        0x00, 0x04, 'M', 'Q', 'T', 'T',
        0x04, 0x02, 0x00, 0x00
    };
    uint8_t vh[sizeof(variable_header)];
    size_t id_len = strlen(id);
    size_t remaining;
    int rc;

    if (id_len > UINT16_MAX) {
        return -EMSGSIZE;
    }

    remaining = sizeof(vh) + 2U + id_len;
    rc = send_mqtt_header(fd, 0x10, remaining);
    if (rc < 0) {
        return rc;
    }

    memcpy(vh, variable_header, sizeof(vh));
    vh[8] = (uint8_t)(ka >> 8);
    vh[9] = (uint8_t)ka;

    rc = send_all(fd, vh, sizeof(vh));
    if (rc < 0) {
        return rc;
    }
    return send_mqtt_str(fd, id);
}

int mqtt_send_subscribe(int fd, const char *topic, uint16_t id)
{
    size_t topic_len = strlen(topic);
    size_t remaining;
    uint8_t packet_id[2] = {
        (uint8_t)(id >> 8),
        (uint8_t)id,
    };
    const uint8_t qos = 0;
    int rc;

    if (topic_len > UINT16_MAX) {
        return -EMSGSIZE;
    }

    remaining = sizeof(packet_id) + 2U + topic_len + sizeof(qos);
    rc = send_mqtt_header(fd, 0x82, remaining);
    if (rc < 0) {
        return rc;
    }
    rc = send_all(fd, packet_id, sizeof(packet_id));
    if (rc < 0) {
        return rc;
    }
    rc = send_mqtt_str(fd, topic);
    if (rc < 0) {
        return rc;
    }
    return send_all(fd, &qos, sizeof(qos));
}

int mqtt_send_publish_qos1(int fd, const char *topic, const void *payload,
                           size_t len, uint16_t id)
{
    size_t topic_len = strlen(topic);
    size_t remaining;
    uint8_t packet_id[2] = {
        (uint8_t)(id >> 8),
        (uint8_t)id,
    };
    int rc;

    if (topic_len > UINT16_MAX) {
        return -EMSGSIZE;
    }

    /*
     * KISS / low-stack path:
     * send MQTT's logical packet as header + topic + packet-id + payload.
     * TCP/STCP is a byte stream, so no 768+773 byte assembly buffers are
     * required. Wire bytes remain exactly the same.
     */
    remaining = 2U + topic_len + sizeof(packet_id) + len;

    rc = send_mqtt_header(fd, 0x32, remaining);
    if (rc < 0) {
        return rc;
    }
    rc = send_mqtt_str(fd, topic);
    if (rc < 0) {
        return rc;
    }
    rc = send_all(fd, packet_id, sizeof(packet_id));
    if (rc < 0) {
        return rc;
    }
    return send_all(fd, payload, len);
}
```
