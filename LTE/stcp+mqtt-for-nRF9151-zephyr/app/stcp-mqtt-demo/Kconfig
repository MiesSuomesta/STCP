## STCPv2/zephyr/nordic-3.4.0/build-hello-uart2/hello_world/Kconfig/Kconfig.modules
```kconfig
menu "nrf (/home/pomo/git/STCP/STCPv2/zephyr/nordic/nrf)"
osource "$(ZEPHYR_NRF_KCONFIG)"
config ZEPHYR_NRF_MODULE
	bool
	default y
endmenu
menu "mcuboot (/home/pomo/git/STCP/STCPv2/zephyr/nordic/bootloader/mcuboot)"
osource "$(ZEPHYR_MCUBOOT_KCONFIG)"
config ZEPHYR_MCUBOOT_MODULE
	bool
	default y
endmenu
config ZEPHYR_QCBOR_MODULE
	bool
	default y
config ZEPHYR_T_COSE_MODULE
	bool
	default y
menu "mbedtls (/home/pomo/git/STCP/STCPv2/zephyr/nordic/modules/crypto/mbedtls)"
osource "$(ZEPHYR_MBEDTLS_KCONFIG)"
config ZEPHYR_MBEDTLS_MODULE
	bool
	default y
endmenu
config ZEPHYR_OBERON_PSA_CRYPTO_MODULE
	bool
	default y
menu "trusted-firmware-m (/home/pomo/git/STCP/STCPv2/zephyr/nordic/modules/tee/tf-m/trusted-firmware-m)"
osource "$(ZEPHYR_TRUSTED_FIRMWARE_M_KCONFIG)"
config ZEPHYR_TRUSTED_FIRMWARE_M_MODULE
	bool
	default y
endmenu
config ZEPHYR_PSA_ARCH_TESTS_MODULE
	bool
	default y
menu "cjson (/home/pomo/git/STCP/STCPv2/zephyr/nordic/modules/lib/cjson)"
osource "$(ZEPHYR_CJSON_KCONFIG)"
config ZEPHYR_CJSON_MODULE
	bool
	default y
endmenu
menu "azure-sdk-for-c (/home/pomo/git/STCP/STCPv2/zephyr/nordic/modules/lib/azure-sdk-for-c)"
osource "$(ZEPHYR_AZURE_SDK_FOR_C_KCONFIG)"
config ZEPHYR_AZURE_SDK_FOR_C_MODULE
	bool
	default y
endmenu
menu "cirrus-logic (/home/pomo/git/STCP/STCPv2/zephyr/nordic/modules/hal/cirrus-logic)"
osource "/home/pomo/git/STCP/STCPv2/zephyr/nordic/modules/hal/cirrus-logic/Kconfig"
config ZEPHYR_CIRRUS_LOGIC_MODULE
	bool
	default y
endmenu
menu "openthread (/home/pomo/git/STCP/STCPv2/zephyr/nordic/modules/lib/openthread)"
osource "$(ZEPHYR_OPENTHREAD_KCONFIG)"
config ZEPHYR_OPENTHREAD_MODULE
	bool
	default y
endmenu
menu "nrf_wifi (/home/pomo/git/STCP/STCPv2/zephyr/nordic/modules/lib/nrf_wifi)"
osource "$(ZEPHYR_NRF_WIFI_KCONFIG)"
config ZEPHYR_NRF_WIFI_MODULE
	bool
	default y

config ZEPHYR_NRF_WIFI_MODULE_BLOBS
	bool
endmenu
menu "memfault-firmware-sdk (/home/pomo/git/STCP/STCPv2/zephyr/nordic/modules/lib/memfault-firmware-sdk)"
osource "/home/pomo/git/STCP/STCPv2/zephyr/nordic/modules/lib/memfault-firmware-sdk/ports/zephyr/Kconfig"
config ZEPHYR_MEMFAULT_FIRMWARE_SDK_MODULE
	bool
	default y
endmenu
menu "coremark (/home/pomo/git/STCP/STCPv2/zephyr/nordic/modules/benchmark/coremark)"
osource "$(ZEPHYR_COREMARK_KCONFIG)"
config ZEPHYR_COREMARK_MODULE
	bool
	default y
endmenu
menu "hostap (/home/pomo/git/STCP/STCPv2/zephyr/nordic/modules/lib/hostap)"
osource "$(ZEPHYR_HOSTAP_KCONFIG)"
config ZEPHYR_HOSTAP_MODULE
	bool
	default y
endmenu
menu "canopennode (/home/pomo/git/STCP/STCPv2/zephyr/nordic/modules/lib/canopennode)"
osource "$(ZEPHYR_CANOPENNODE_KCONFIG)"
config ZEPHYR_CANOPENNODE_MODULE
	bool
	default y
endmenu
menu "chre (/home/pomo/git/STCP/STCPv2/zephyr/nordic/modules/lib/chre)"
osource "/home/pomo/git/STCP/STCPv2/zephyr/nordic/modules/lib/chre/platform/zephyr/Kconfig"
config ZEPHYR_CHRE_MODULE
	bool
	default y
endmenu
menu "cmsis (/home/pomo/git/STCP/STCPv2/zephyr/nordic/modules/hal/cmsis)"
osource "$(ZEPHYR_CMSIS_KCONFIG)"
config ZEPHYR_CMSIS_MODULE
	bool
	default y
endmenu
menu "cmsis-dsp (/home/pomo/git/STCP/STCPv2/zephyr/nordic/modules/lib/cmsis-dsp)"
osource "$(ZEPHYR_CMSIS_DSP_KCONFIG)"
config ZEPHYR_CMSIS_DSP_MODULE
	bool
	default y
endmenu
menu "cmsis-nn (/home/pomo/git/STCP/STCPv2/zephyr/nordic/modules/lib/cmsis-nn)"
osource "$(ZEPHYR_CMSIS_NN_KCONFIG)"
config ZEPHYR_CMSIS_NN_MODULE
	bool
	default y
endmenu
menu "cmsis_6 (/home/pomo/git/STCP/STCPv2/zephyr/nordic/modules/hal/cmsis_6)"
osource "$(ZEPHYR_CMSIS_6_KCONFIG)"
config ZEPHYR_CMSIS_6_MODULE
	bool
	default y
endmenu
menu "dhara (/home/pomo/git/STCP/STCPv2/zephyr/nordic/modules/lib/dhara)"
osource "$(ZEPHYR_DHARA_KCONFIG)"
config ZEPHYR_DHARA_MODULE
	bool
	default y
endmenu
menu "fatfs (/home/pomo/git/STCP/STCPv2/zephyr/nordic/modules/fs/fatfs)"
osource "$(ZEPHYR_FATFS_KCONFIG)"
config ZEPHYR_FATFS_MODULE
	bool
	default y
endmenu
menu "hal_nordic (/home/pomo/git/STCP/STCPv2/zephyr/nordic/modules/hal/nordic)"
osource "$(ZEPHYR_HAL_NORDIC_KCONFIG)"
config ZEPHYR_HAL_NORDIC_MODULE
	bool
	default y

config ZEPHYR_HAL_NORDIC_MODULE_BLOBS
	bool
endmenu
menu "hal_st (/home/pomo/git/STCP/STCPv2/zephyr/nordic/modules/hal/st)"
osource "$(ZEPHYR_HAL_ST_KCONFIG)"
config ZEPHYR_HAL_ST_MODULE
	bool
	default y
endmenu
menu "hal_tdk (/home/pomo/git/STCP/STCPv2/zephyr/nordic/modules/hal/tdk)"
osource "$(ZEPHYR_HAL_TDK_KCONFIG)"
config ZEPHYR_HAL_TDK_MODULE
	bool
	default y
endmenu
config ZEPHYR_HAL_WURTHELEKTRONIK_MODULE
	bool
	default y
menu "liblc3 (/home/pomo/git/STCP/STCPv2/zephyr/nordic/modules/lib/liblc3)"
osource "$(ZEPHYR_LIBLC3_KCONFIG)"
config ZEPHYR_LIBLC3_MODULE
	bool
	default y
endmenu
config ZEPHYR_LIBMETAL_MODULE
	bool
	default y
menu "libsbc (/home/pomo/git/STCP/STCPv2/zephyr/nordic/modules/lib/libsbc)"
osource "$(ZEPHYR_LIBSBC_KCONFIG)"
config ZEPHYR_LIBSBC_MODULE
	bool
	default y
endmenu
menu "littlefs (/home/pomo/git/STCP/STCPv2/zephyr/nordic/modules/fs/littlefs)"
osource "$(ZEPHYR_LITTLEFS_KCONFIG)"
config ZEPHYR_LITTLEFS_MODULE
	bool
	default y
endmenu
menu "loramac-node (/home/pomo/git/STCP/STCPv2/zephyr/nordic/modules/lib/loramac-node)"
osource "$(ZEPHYR_LORAMAC_NODE_KCONFIG)"
config ZEPHYR_LORAMAC_NODE_MODULE
	bool
	default y
endmenu
menu "lvgl (/home/pomo/git/STCP/STCPv2/zephyr/nordic/modules/lib/gui/lvgl)"
osource "/home/pomo/git/STCP/STCPv2/zephyr/nordic/modules/lib/gui/lvgl/zephyr/Kconfig"
config ZEPHYR_LVGL_MODULE
	bool
	default y
endmenu
config ZEPHYR_MIPI_SYS_T_MODULE
	bool
	default y
config ZEPHYR_MLDSA_NATIVE_MODULE
	bool
	default y
menu "nanopb (/home/pomo/git/STCP/STCPv2/zephyr/nordic/modules/lib/nanopb)"
osource "$(ZEPHYR_NANOPB_KCONFIG)"
config ZEPHYR_NANOPB_MODULE
	bool
	default y
endmenu
config ZEPHYR_OPEN_AMP_MODULE
	bool
	default y
menu "percepio (/home/pomo/git/STCP/STCPv2/zephyr/nordic/modules/debug/percepio)"
osource "/home/pomo/git/STCP/STCPv2/zephyr/nordic/modules/debug/percepio/zephyr/Kconfig"
config ZEPHYR_PERCEPIO_MODULE
	bool
	default y
endmenu
menu "picolibc (/home/pomo/git/STCP/STCPv2/zephyr/nordic/modules/lib/picolibc)"
osource "/home/pomo/git/STCP/STCPv2/zephyr/nordic/modules/lib/picolibc/zephyr/Kconfig"
config ZEPHYR_PICOLIBC_MODULE
	bool
	default y
endmenu
menu "segger (/home/pomo/git/STCP/STCPv2/zephyr/nordic/modules/debug/segger)"
osource "$(ZEPHYR_SEGGER_KCONFIG)"
config ZEPHYR_SEGGER_MODULE
	bool
	default y
endmenu
config ZEPHYR_TF_M_TESTS_MODULE
	bool
	default y
config ZEPHYR_TF_PSA_CRYPTO_MODULE
	bool
	default y
menu "uoscore-uedhoc (/home/pomo/git/STCP/STCPv2/zephyr/nordic/modules/lib/uoscore-uedhoc)"
osource "$(ZEPHYR_UOSCORE_UEDHOC_KCONFIG)"
config ZEPHYR_UOSCORE_UEDHOC_MODULE
	bool
	default y
endmenu
menu "zcbor (/home/pomo/git/STCP/STCPv2/zephyr/nordic/modules/lib/zcbor)"
osource "$(ZEPHYR_ZCBOR_KCONFIG)"
config ZEPHYR_ZCBOR_MODULE
	bool
	default y
endmenu
menu "nrfxlib (/home/pomo/git/STCP/STCPv2/zephyr/nordic/nrfxlib)"
osource "/home/pomo/git/STCP/STCPv2/zephyr/nordic/nrfxlib/Kconfig.nrfxlib"
config ZEPHYR_NRFXLIB_MODULE
	bool
	default y
endmenu
config ZEPHYR_NRF_HW_MODELS_MODULE
	bool
	default y
menu "connectedhomeip (/home/pomo/git/STCP/STCPv2/zephyr/nordic/modules/lib/matter)"
osource "/home/pomo/git/STCP/STCPv2/zephyr/nordic/modules/lib/matter/config/nrfconnect/chip-module/Kconfig"
config ZEPHYR_CONNECTEDHOMEIP_MODULE
	bool
	default y
endmenu
```
