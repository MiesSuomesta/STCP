## LTE/stcp+mqtt-for-nRF9151-zephyr/app/stcp-mqtt-demo/Kconfig
```kconfig
source "Kconfig.zephyr"
source "$(ZEPHYR_BASE)/../stcp-modeemi/moduuli-tcp/zephyr/Kconfig"
```

## LTE/stcp+mqtt-for-nRF9151-zephyr/app/stcp-mqtt-demo/boards/nrf9161dk_nrf9161_ns.conf
```kconfig
# --- Force mbedTLS features into APP image ---
CONFIG_MBEDTLS=y
CONFIG_MBEDTLS_LIBRARY=y

CONFIG_PSA_CRYPTO_DRIVER_CC3XX=y
CONFIG_ENTROPY_GENERATOR=y

CONFIG_MBEDTLS_ECP_C=y
CONFIG_MBEDTLS_ECDH_C=y
CONFIG_MBEDTLS_ECDSA_C=y
```

## LTE/stcp+mqtt-for-nRF9151-zephyr/app/stcp-mqtt-demo/golden/1.4.2026-build/Kconfig/boards/Kconfig.sysbuild
```kconfig
# Load Sysbuild board Kconfig descriptions.
osource "/home/pomo/ncs/zephyr/boards/nordic/nrf9151dk/Kconfig.sysbuild"
```

## LTE/stcp+mqtt-for-nRF9151-zephyr/app/stcp-mqtt-demo/golden/1.4.2026-build/Kconfig/soc/Kconfig.defconfig
```kconfig
# Load Zephyr SoC defconfig descriptions.
osource "/home/pomo/ncs/zephyr/soc/xlnx/zynqmp/Kconfig.defconfig"
osource "/home/pomo/ncs/zephyr/soc/xlnx/zynq7000/Kconfig.defconfig"
osource "/home/pomo/ncs/zephyr/soc/xlnx/versalnet/Kconfig.defconfig"
osource "/home/pomo/ncs/zephyr/soc/xlnx/versal2/Kconfig.defconfig"
osource "/home/pomo/ncs/zephyr/soc/xlnx/versal/Kconfig.defconfig"
osource "/home/pomo/ncs/zephyr/soc/xen/Kconfig.defconfig"
osource "/home/pomo/ncs/zephyr/soc/wch/ch32v/Kconfig.defconfig"
osource "/home/pomo/ncs/zephyr/soc/ti/simplelink/Kconfig.defconfig"
osource "/home/pomo/ncs/zephyr/soc/ti/mspm0/Kconfig.defconfig"
osource "/home/pomo/ncs/zephyr/soc/ti/lm3s6965/Kconfig.defconfig"
osource "/home/pomo/ncs/zephyr/soc/ti/k3/Kconfig.defconfig"
osource "/home/pomo/ncs/zephyr/soc/telink/tlsr/Kconfig.defconfig"
osource "/home/pomo/ncs/zephyr/soc/starfive/jh71xx/Kconfig.defconfig"
osource "/home/pomo/ncs/zephyr/soc/st/stm32/Kconfig.defconfig"
osource "/home/pomo/ncs/zephyr/soc/snps/qemu_arc/Kconfig.defconfig"
osource "/home/pomo/ncs/zephyr/soc/snps/nsim/arc_v/Kconfig.defconfig"
osource "/home/pomo/ncs/zephyr/soc/snps/nsim/arc_classic/Kconfig.defconfig"
osource "/home/pomo/ncs/zephyr/soc/snps/hsdk4xd/Kconfig.defconfig"
osource "/home/pomo/ncs/zephyr/soc/snps/hsdk/Kconfig.defconfig"
osource "/home/pomo/ncs/zephyr/soc/snps/emsk/Kconfig.defconfig"
osource "/home/pomo/ncs/zephyr/soc/snps/emsdp/Kconfig.defconfig"
osource "/home/pomo/ncs/zephyr/soc/snps/arc_iot/Kconfig.defconfig"
osource "/home/pomo/ncs/zephyr/soc/silabs/Kconfig.defconfig"
osource "/home/pomo/ncs/zephyr/soc/sifli/sf32/Kconfig.defconfig"
osource "/home/pomo/ncs/zephyr/soc/sifive/sifive_freedom/Kconfig.defconfig"
osource "/home/pomo/ncs/zephyr/soc/sensry/Kconfig.defconfig"
osource "/home/pomo/ncs/zephyr/soc/rockchip/Kconfig.defconfig"
osource "/home/pomo/ncs/zephyr/soc/renode/riscv_virtual/Kconfig.defconfig"
osource "/home/pomo/ncs/zephyr/soc/renode/cortex_r8_virtual/Kconfig.defconfig"
osource "/home/pomo/ncs/zephyr/soc/renesas/smartbond/Kconfig.defconfig"
osource "/home/pomo/ncs/zephyr/soc/renesas/rz/Kconfig.defconfig"
osource "/home/pomo/ncs/zephyr/soc/renesas/rx/Kconfig.defconfig"
osource "/home/pomo/ncs/zephyr/soc/renesas/rcar/Kconfig.defconfig"
osource "/home/pomo/ncs/zephyr/soc/renesas/ra/Kconfig.defconfig"
osource "/home/pomo/ncs/zephyr/soc/realtek/ec/Kconfig.defconfig"
osource "/home/pomo/ncs/zephyr/soc/realtek/ameba/Kconfig.defconfig"
osource "/home/pomo/ncs/zephyr/soc/raspberrypi/rpi_pico/Kconfig.defconfig"
osource "/home/pomo/ncs/zephyr/soc/quicklogic/eos_s3/Kconfig.defconfig"
osource "/home/pomo/ncs/zephyr/soc/qemu/virt_riscv/Kconfig.defconfig"
osource "/home/pomo/ncs/zephyr/soc/qemu/malta/Kconfig.defconfig"
osource "/home/pomo/ncs/zephyr/soc/openisa/rv32m1/Kconfig.defconfig"
osource "/home/pomo/ncs/zephyr/soc/openhwgroup/cva6/Kconfig.defconfig"
osource "/home/pomo/ncs/zephyr/soc/oct/osd32mp15x/Kconfig.defconfig"
osource "/home/pomo/ncs/zephyr/soc/nxp/s32/Kconfig.defconfig"
osource "/home/pomo/ncs/zephyr/soc/nxp/rw/Kconfig.defconfig"
osource "/home/pomo/ncs/zephyr/soc/nxp/mcx/Kconfig.defconfig"
osource "/home/pomo/ncs/zephyr/soc/nxp/lpc/Kconfig.defconfig"
osource "/home/pomo/ncs/zephyr/soc/nxp/layerscape/Kconfig.defconfig"
osource "/home/pomo/ncs/zephyr/soc/nxp/kinetis/Kconfig.defconfig"
osource "/home/pomo/ncs/zephyr/soc/nxp/imxrt/Kconfig.defconfig"
osource "/home/pomo/ncs/zephyr/soc/nxp/imx/Kconfig.defconfig"
osource "/home/pomo/ncs/zephyr/soc/nuvoton/numicro/Kconfig.defconfig"
osource "/home/pomo/ncs/zephyr/soc/nuvoton/numaker/Kconfig.defconfig"
osource "/home/pomo/ncs/zephyr/soc/nuvoton/npcx/Kconfig.defconfig"
osource "/home/pomo/ncs/zephyr/soc/nuvoton/npcm/Kconfig.defconfig"
osource "/home/pomo/ncs/zephyr/soc/nordic/Kconfig.defconfig"
osource "/home/pomo/ncs/zephyr/soc/neorv32/Kconfig.defconfig"
osource "/home/pomo/ncs/zephyr/soc/native/inf_clock/Kconfig.defconfig"
osource "/home/pomo/ncs/zephyr/soc/microchip/sam/sama7/Kconfig.defconfig"
osource "/home/pomo/ncs/zephyr/soc/microchip/sam/sam_d5x_e5x/Kconfig.defconfig"
osource "/home/pomo/ncs/zephyr/soc/microchip/pic64/Kconfig.defconfig"
osource "/home/pomo/ncs/zephyr/soc/microchip/pic32c/pic32cz_ca/Kconfig.defconfig"
osource "/home/pomo/ncs/zephyr/soc/microchip/pic32c/pic32cx_sg/Kconfig.defconfig"
osource "/home/pomo/ncs/zephyr/soc/microchip/pic32c/pic32cm_jh/Kconfig.defconfig"
osource "/home/pomo/ncs/zephyr/soc/microchip/miv/Kconfig.defconfig"
osource "/home/pomo/ncs/zephyr/soc/microchip/mec/Kconfig.defconfig"
osource "/home/pomo/ncs/zephyr/soc/mediatek/mt8xxx/Kconfig.defconfig"
osource "/home/pomo/ncs/zephyr/soc/lowrisc/opentitan/Kconfig.defconfig"
osource "/home/pomo/ncs/zephyr/soc/litex/litex_vexriscv/Kconfig.defconfig"
osource "/home/pomo/ncs/zephyr/soc/ite/ec/Kconfig.defconfig"
osource "/home/pomo/ncs/zephyr/soc/intel/wildcat_lake/Kconfig.defconfig"
osource "/home/pomo/ncs/zephyr/soc/intel/raptor_lake/Kconfig.defconfig"
osource "/home/pomo/ncs/zephyr/soc/intel/panther_lake/Kconfig.defconfig"
osource "/home/pomo/ncs/zephyr/soc/intel/lakemont/Kconfig.defconfig"
osource "/home/pomo/ncs/zephyr/soc/intel/intel_socfpga_std/Kconfig.defconfig"
osource "/home/pomo/ncs/zephyr/soc/intel/intel_socfpga/Kconfig.defconfig"
osource "/home/pomo/ncs/zephyr/soc/intel/intel_niosv/Kconfig.defconfig"
osource "/home/pomo/ncs/zephyr/soc/intel/intel_ish/Kconfig.defconfig"
osource "/home/pomo/ncs/zephyr/soc/intel/intel_adsp/Kconfig.defconfig"
osource "/home/pomo/ncs/zephyr/soc/intel/elkhart_lake/Kconfig.defconfig"
osource "/home/pomo/ncs/zephyr/soc/intel/atom/Kconfig.defconfig"
osource "/home/pomo/ncs/zephyr/soc/intel/apollo_lake/Kconfig.defconfig"
osource "/home/pomo/ncs/zephyr/soc/intel/alder_lake/Kconfig.defconfig"
osource "/home/pomo/ncs/zephyr/soc/infineon/psoc4/Kconfig.defconfig"
osource "/home/pomo/ncs/zephyr/soc/infineon/edge/Kconfig.defconfig"
osource "/home/pomo/ncs/zephyr/soc/infineon/cat3/Kconfig.defconfig"
osource "/home/pomo/ncs/zephyr/soc/infineon/cat1c/Kconfig.defconfig"
osource "/home/pomo/ncs/zephyr/soc/infineon/cat1b/Kconfig.defconfig"
osource "/home/pomo/ncs/zephyr/soc/infineon/cat1a/Kconfig.defconfig"
osource "/home/pomo/ncs/zephyr/soc/gd/gd32/Kconfig.defconfig"
osource "/home/pomo/ncs/zephyr/soc/gaisler/leon3/Kconfig.defconfig"
osource "/home/pomo/ncs/zephyr/soc/gaisler/gr716a/Kconfig.defconfig"
osource "/home/pomo/ncs/zephyr/soc/focaltech/Kconfig.defconfig"
osource "/home/pomo/ncs/zephyr/soc/espressif/Kconfig.defconfig"
osource "/home/pomo/ncs/zephyr/soc/ene/kb1200/Kconfig.defconfig"
osource "/home/pomo/ncs/zephyr/soc/ene/kb106x/Kconfig.defconfig"
osource "/home/pomo/ncs/zephyr/soc/elan/em32f967/Kconfig.defconfig"
osource "/home/pomo/ncs/zephyr/soc/egis/Kconfig.defconfig"
osource "/home/pomo/ncs/zephyr/soc/efinix/sapphire/Kconfig.defconfig"
osource "/home/pomo/ncs/zephyr/soc/cdns/xtensa_sample_controller/Kconfig.defconfig"
osource "/home/pomo/ncs/zephyr/soc/cdns/sample_controller32/Kconfig.defconfig"
osource "/home/pomo/ncs/zephyr/soc/cdns/dc233c/Kconfig.defconfig"
osource "/home/pomo/ncs/zephyr/soc/brcm/bcmvk/Kconfig.defconfig"
osource "/home/pomo/ncs/zephyr/soc/brcm/bcm2712/Kconfig.defconfig"
osource "/home/pomo/ncs/zephyr/soc/brcm/bcm2711/Kconfig.defconfig"
osource "/home/pomo/ncs/zephyr/soc/blackberry/qnxhv_vm/Kconfig.defconfig"
osource "/home/pomo/ncs/zephyr/soc/bflb/Kconfig.defconfig"
osource "/home/pomo/ncs/zephyr/soc/atmel/sam0/Kconfig.defconfig"
osource "/home/pomo/ncs/zephyr/soc/atmel/sam/Kconfig.defconfig"
osource "/home/pomo/ncs/zephyr/soc/aspeed/Kconfig.defconfig"
osource "/home/pomo/ncs/zephyr/soc/arm/Kconfig.defconfig"
osource "/home/pomo/ncs/zephyr/soc/arm/beetle/Kconfig.defconfig"
osource "/home/pomo/ncs/zephyr/soc/antmicro/myra/Kconfig.defconfig"
osource "/home/pomo/ncs/zephyr/soc/andestech/Kconfig.defconfig"
osource "/home/pomo/ncs/zephyr/soc/amd/acp_6_0/Kconfig.defconfig"
osource "/home/pomo/ncs/zephyr/soc/ambiq/Kconfig.defconfig"
osource "/home/pomo/ncs/zephyr/soc/allwinner/sun8i_h3/Kconfig.defconfig"
osource "/home/pomo/ncs/zephyr/soc/aesc/Kconfig.defconfig"
osource "/home/pomo/ncs/zephyr/soc/adi/max32/Kconfig.defconfig"
osource "/home/pomo/ncs/nrf/soc/sercomm/nrf91/Kconfig.defconfig"
osource "/home/pomo/ncs/nrf/soc/nordic/Kconfig.defconfig"
```

## LTE/stcp+mqtt-for-nRF9151-zephyr/app/stcp-mqtt-demo/golden/1.4.2026-build/stcp-mqtt-demo/Kconfig/arch/Kconfig
```kconfig
# Load Zephyr Arch Kconfig descriptions.
osource "/home/pomo/ncs/zephyr/arch/rx/Kconfig"
osource "/home/pomo/ncs/zephyr/arch/x86/Kconfig"
osource "/home/pomo/ncs/zephyr/arch/xtensa/Kconfig"
osource "/home/pomo/ncs/zephyr/arch/sparc/Kconfig"
osource "/home/pomo/ncs/zephyr/arch/riscv/Kconfig"
osource "/home/pomo/ncs/zephyr/arch/posix/Kconfig"
osource "/home/pomo/ncs/zephyr/arch/mips/Kconfig"
osource "/home/pomo/ncs/zephyr/arch/arm64/Kconfig"
osource "/home/pomo/ncs/zephyr/arch/arm/Kconfig"
osource "/home/pomo/ncs/zephyr/arch/arc/Kconfig"
```
