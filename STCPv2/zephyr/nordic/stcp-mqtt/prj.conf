## CMakeLists.txt
```
cmake_minimum_required(VERSION 3.20.0)
find_package(Zephyr REQUIRED HINTS $ENV{ZEPHYR_BASE})
project(stcp_mqtt)

target_sources(app PRIVATE
    src/main.c
    src/echo_benchmark.c
    src/mqtt_codec.c
    src/mqtt_proxy.c
)

target_sources_ifdef(CONFIG_STCP_BENCH_SHELL app PRIVATE
    src/bench_shell.c
)

target_sources_ifdef(CONFIG_NRF_MODEM_LIB app PRIVATE
    src/stcp_lte_transport.c
)

if(CONFIG_STCP_BENCH_SHELL AND CONFIG_NRF_MODEM_LIB)
    target_sources(app PRIVATE src/modem_status.c)
endif()

target_sources_ifdef(CONFIG_ETH_W5500 app PRIVATE
    src/ethernet_status.c
)
```

## Kconfig
```
mainmenu "STCP transport benchmark"

source "Kconfig.zephyr"

menu "Echo benchmark"

config ECHO_SERVER_HOST
    string "Echo server hostname or IPv4 address"
    default "lja.fi"

config ECHO_SERVER_PORT
    string "Echo server port"
    default "19000"

choice ECHO_TRANSPORT
    prompt "Echo transport"
    default ECHO_TRANSPORT_TCP

config ECHO_TRANSPORT_TCP
    bool "TCP"

config ECHO_TRANSPORT_STCP
    bool "STCP over current carrier"

endchoice

config ECHO_PAYLOAD_SIZE
    int "Echo payload size"
    default 1024
    range 1 4096

config ECHO_ITERATIONS
    int "Number of echo round trips"
    default 100
    range 1 100000

config ECHO_SOCKET_TIMEOUT_MS
    int "Socket send/receive timeout in milliseconds"
    default 30000
    range 1000 300000

config BENCH_TOTAL_BYTES
    int "Bytes transferred per direction in each throughput test"
    default 1048576
    range 4096 67108864

config BENCH_MAX_CHUNK_SIZE
    int "Maximum runtime streaming chunk size"
    default 65536
    range 4096 65536
    help
      Maximum chunk accepted by the runtime shell and benchmark core. Buffers
      are allocated dynamically for each test. Full duplex needs two buffers.

config BENCH_CHUNK_SIZE
    int "Default streaming I/O chunk size"
    default 4096
    range 256 BENCH_MAX_CHUNK_SIZE

config BENCH_PAUSE_SECONDS
    int "Pause between upload, download and full-duplex tests"
    default 5
    range 0 120

config BENCH_REPORT_INTERVAL_MS
    int "Progress report interval in milliseconds"
    default 5000
    range 0 600000
    help
      Controls how often the modem-side benchmark reports transferred bytes,
      remaining bytes, percentage and average throughput. Set to 0 to disable
      periodic reports; the final 100 percent report is still printed.

config BENCH_SENDER_STACK_SIZE
    int "Full-duplex sender thread stack size"
    default 4096
    range 2048 16384


config BENCH_SOCKET_BUFFER_SIZE
    int "Requested modem socket send/receive buffer size"
    default 32768
    range 4096 131072
    help
      Best-effort SO_SNDBUF/SO_RCVBUF value. The modem offload may clamp or
      reject the value; benchmark startup logs the actual result.

config BENCH_FULL_RX_BUFFER_SIZE
    int "Full-duplex receive scratch buffer size"
    default 4096
    range 1024 16384
    help
      Full-duplex uses the configured chunk size for TX, but a smaller RX
      scratch buffer to avoid reserving two 64 KiB buffers at once. TCP is a
      byte stream, so receive calls do not need to match the peer send size.

endmenu

menu "Interactive benchmark control"

config STCP_BENCH_SHELL
    bool "Enable STCP benchmark shell commands"
    default y
    select SHELL
    help
      Builds the interactive 'stcp config' and 'stcp bench' command tree.
      Disable this option to remove the shell command implementation and its
      command tables from the firmware image.

config STCP_BENCH_AUTORUN
    bool "Run all throughput benchmarks automatically after LTE connects"
    default n if STCP_BENCH_SHELL
    default y if !STCP_BENCH_SHELL
    help
      Automatically runs upload, download and full-duplex benchmarks after
      LTE registration. This can be enabled together with the shell if both
      automatic and interactive testing are desired.

endmenu

menu "LTE transport initialization"

config STCP_LTE_REG_TIMEOUT_SECONDS
    int "LTE registration timeout in seconds"
    default 300
    range 10 1800

config STCP_LTE_PDN_TIMEOUT_SECONDS
    int "PDN activation timeout in seconds"
    default 300
    range 10 1800

config STCP_LTE_FORCE_DEFAULT_APN
    bool "Configure default CID 0 APN before LTE attach"
    default n
    help
      Writes CONFIG_STCP_LTE_DEFAULT_APN to PDP context CID 0 before
      lte_lc_connect(). Benchmark sockets use this default context.

config STCP_LTE_DEFAULT_APN
    string "Default CID 0 APN"
    default "APN internet"
    depends on STCP_LTE_FORCE_DEFAULT_APN

config STCP_LTE_CUSTOM_PDN
    bool "Create, activate and bind sockets to a separate PDN context"
    default n
    depends on LTE_LC_PDN_MODULE
    help
      Reproduces the STCPv1 model by creating and activating an additional
      PDN context after LTE registration. Benchmark TCP sockets are bound to
      the resulting modem PDN ID with SO_BINDTOPDN before connect().

config STCP_LTE_APN
    string "APN for the separate PDN context"
    default "APN internet"
    depends on STCP_LTE_CUSTOM_PDN

endmenu
```

## prj.conf
```kconfig
#
# Console
#
CONFIG_SERIAL=y
CONFIG_CONSOLE=y
CONFIG_UART_CONSOLE=y
CONFIG_PRINTK=y

#
# Logging
#
CONFIG_LOG=y
CONFIG_LOG_MODE_DEFERRED=y
CONFIG_LOG_DEFAULT_LEVEL=3
CONFIG_KERNEL_LOG_LEVEL_WRN=y
CONFIG_LOG_BACKEND_UART=y

#
# Network
#
CONFIG_NETWORKING=y
CONFIG_NET_NATIVE=n
CONFIG_NET_SOCKETS=y
CONFIG_NET_SOCKETS_OFFLOAD=y
CONFIG_NET_IPV4=y
CONFIG_NET_IPV6=y
CONFIG_NET_TCP=y
CONFIG_NET_UDP=y

#
# MQTT
#
CONFIG_MQTT_LIB=y

#
# STCP
#
CONFIG_STCP=y

#
# Memory
#
CONFIG_HEAP_MEM_POOL_SIZE=98304
CONFIG_MAIN_STACK_SIZE=8192
CONFIG_SYSTEM_WORKQUEUE_STACK_SIZE=4096

#
# Utilities
#
CONFIG_RING_BUFFER=y
CONFIG_REBOOT=y
CONFIG_ENTROPY_GENERATOR=y
CONFIG_THREAD_NAME=y
CONFIG_ASSERT=y

#
# Debug
#
CONFIG_SPEED_OPTIMIZATIONS=y
CONFIG_ASSERT_VERBOSE=n

# Echo benchmark (first run: plain TCP)
CONFIG_ECHO_TRANSPORT_TCP=y
CONFIG_ECHO_SERVER_HOST="lja.fi"
CONFIG_ECHO_SERVER_PORT="19000"
CONFIG_ECHO_SOCKET_TIMEOUT_MS=60000

# Streaming throughput benchmark
CONFIG_BENCH_TOTAL_BYTES=1048576
CONFIG_BENCH_MAX_CHUNK_SIZE=65536
CONFIG_BENCH_CHUNK_SIZE=4096
CONFIG_BENCH_PAUSE_SECONDS=5
CONFIG_BENCH_REPORT_INTERVAL_MS=5000
CONFIG_BENCH_SENDER_STACK_SIZE=4096
CONFIG_BENCH_FULL_RX_BUFFER_SIZE=4096

# Optional interactive test bench. Set to n to compile it completely out.
CONFIG_STCP_BENCH_SHELL=y
CONFIG_STCP_BENCH_AUTORUN=n
CONFIG_SHELL_BACKEND_SERIAL=y
CONFIG_SHELL_PROMPT_UART="stcp> "

# STCPv1-style LTE transport initialization
CONFIG_NRF_MODEM_LIB=y
CONFIG_LTE_LINK_CONTROL=y
CONFIG_LTE_LC_PDN_MODULE=y
CONFIG_STCP_LTE_REG_TIMEOUT_SECONDS=300
CONFIG_STCP_LTE_PDN_TIMEOUT_SECONDS=300

# APN handling is opt-in. Normal builds use the SIM/operator defaults.
# CONFIG_STCP_LTE_FORCE_DEFAULT_APN=y
CONFIG_STCP_LTE_CUSTOM_PDN=y

# To force CID 0 APN, enable and configure:
CONFIG_STCP_LTE_FORCE_DEFAULT_APN=y
CONFIG_STCP_LTE_DEFAULT_APN="internet"

# To create a separate PDN and bind benchmark sockets to it:
CONFIG_STCP_LTE_CUSTOM_PDN=y
CONFIG_STCP_LTE_APN="internet"
```

## ethernet.conf
```kconfig
# STCPv2 Ethernet build for nRF9151 DK + Seeed W5500

# Console and shell
CONFIG_SERIAL=y
CONFIG_CONSOLE=y
CONFIG_UART_CONSOLE=y
CONFIG_PRINTK=y
CONFIG_SHELL=y
CONFIG_SHELL_BACKEND_SERIAL=y
CONFIG_SHELL_PROMPT_UART="stcp> "

# Logging
CONFIG_LOG=y
CONFIG_LOG_MODE_DEFERRED=y
CONFIG_LOG_DEFAULT_LEVEL=2
CONFIG_KERNEL_LOG_LEVEL_WRN=y
CONFIG_LOG_BACKEND_UART=y
CONFIG_SPI_LOG_LEVEL_WRN=y
CONFIG_ETHERNET_LOG_LEVEL_INF=y
CONFIG_NET_LOG=n

# Native Zephyr network stack
CONFIG_NETWORKING=y
CONFIG_NET_NATIVE=y
CONFIG_NET_IPV4=y
CONFIG_NET_IPV6=n
CONFIG_NET_TCP=y
CONFIG_NET_UDP=y
CONFIG_NET_SOCKETS=y
CONFIG_NET_SOCKETS_OFFLOAD=n
CONFIG_NET_L2_ETHERNET=y
CONFIG_ETH_W5500=y
CONFIG_SPI=y
CONFIG_GPIO=y
CONFIG_NET_ARP=y

# Static LAN configuration
CONFIG_NET_DHCPV4=n
CONFIG_NET_CONFIG_SETTINGS=y
CONFIG_NET_CONFIG_AUTO_INIT=y
CONFIG_NET_CONFIG_NEED_IPV4=y
CONFIG_NET_CONFIG_INIT_TIMEOUT=10
CONFIG_NET_CONFIG_MY_IPV4_ADDR="192.168.1.50"
CONFIG_NET_CONFIG_MY_IPV4_NETMASK="255.255.255.0"
CONFIG_NET_CONFIG_MY_IPV4_GW="192.168.1.111"

# Network management and diagnostics
CONFIG_NET_MGMT=y
CONFIG_NET_MGMT_EVENT=y
CONFIG_NET_CONNECTION_MANAGER=y
CONFIG_NET_SHELL=y
CONFIG_NET_STATISTICS=y

# MQTT and STCP
CONFIG_MQTT_LIB=y
CONFIG_STCP=y

# Memory
CONFIG_HEAP_MEM_POOL_SIZE=98304
CONFIG_MAIN_STACK_SIZE=4096
CONFIG_SYSTEM_WORKQUEUE_STACK_SIZE=4096

# Utilities
CONFIG_RING_BUFFER=y
CONFIG_REBOOT=y
CONFIG_ENTROPY_GENERATOR=y
CONFIG_THREAD_NAME=y
CONFIG_ASSERT=y
CONFIG_SPEED_OPTIMIZATIONS=y
CONFIG_ASSERT_VERBOSE=n

# Echo benchmark
CONFIG_ECHO_TRANSPORT_TCP=y
CONFIG_ECHO_SERVER_HOST="192.168.1.20"
CONFIG_ECHO_SERVER_PORT="19000"
CONFIG_ECHO_SOCKET_TIMEOUT_MS=60000
CONFIG_BENCH_TOTAL_BYTES=1048576
CONFIG_BENCH_MAX_CHUNK_SIZE=65536
CONFIG_BENCH_CHUNK_SIZE=16384
CONFIG_BENCH_PAUSE_SECONDS=5
CONFIG_BENCH_REPORT_INTERVAL_MS=5000
CONFIG_BENCH_SENDER_STACK_SIZE=4096
CONFIG_BENCH_FULL_RX_BUFFER_SIZE=16384
CONFIG_STCP_BENCH_SHELL=y
CONFIG_STCP_BENCH_AUTORUN=n

# Ethernet build: modem/LTE stack disabled
CONFIG_NRF_MODEM_LIB=n
CONFIG_LTE_LINK_CONTROL=n
CONFIG_PDN=n

# STCP AF_STCP offload does not support fcntl O_NONBLOCK yet.
CONFIG_BENCH_STCP_BLOCKING_CONNECT=y

# Shared Raspberry Pi Rust STCP core
# PSA_CRYPTO_CLIENT is generated/hidden in NCS 3.3.0; do not assign it directly.
CONFIG_STCP_RUST_CORE=y
CONFIG_STCP_RUST_X25519_SOFTWARE=y
# Client benchmark needs one active STCP socket; keep one spare for recovery.
# The RX stack is embedded in every pool entry, so limiting the pool saves
# 24+ KiB of static RAM compared with the default eight sockets.
CONFIG_STCP_MAX_SOCKETS=2
CONFIG_STCP_RUST_TOOLCHAIN="nightly"
CONFIG_STCP_RUST_RX_STACK_SIZE=3072
CONFIG_STCP_RUST_RX_PRIORITY=7
CONFIG_STCP_RUST_RX_BUFFER_SIZE=2048
CONFIG_STCP_RUST_TRACE_WIRE=y
CONFIG_STCP_RUST_TRACE_EVENTS=n
CONFIG_STCP_RUST_TRACE_ALLOC=n
CONFIG_MBEDTLS_PSA_CRYPTO_C=y

# Run benchmark and Rust STCP session creation outside shell_uart.
CONFIG_BENCH_WORKER_STACK_SIZE=8192
CONFIG_BENCH_WORKER_PRIORITY=5
CONFIG_THREAD_STACK_INFO=y

CONFIG_STCP_RUST_TRACE_CRYPTO=y

CONFIG_STCP_RUST_X25519_SOFTWARE=y
```

## boards/nrf9151dk_nrf9151_ns.overlay
```dts
/* W5500 on the Seeed shield. Run SPI at the nRF9151 maximum for throughput testing
 * and provide a valid locally-administered MAC address.
 */
&eth_w5500 {
    spi-max-frequency = <8000000>;
    local-mac-address = [02 00 00 00 91 51];
};
```

## src/main.c
```c
#include <zephyr/kernel.h>
#include <zephyr/logging/log.h>

#include <modem/nrf_modem_lib.h>
#include <modem/lte_lc.h>

#include "echo_benchmark.h"

LOG_MODULE_REGISTER(main, LOG_LEVEL_INF);

int main(void)
{
    int ret;

    LOG_INF("STCP2 transport benchmark starting");

    ret = nrf_modem_lib_init();
    if (ret < 0) {
        LOG_ERR("nrf_modem_lib_init failed: %d", ret);
        return ret;
    }

    LOG_INF("nRF modem library initialized");

    ret = lte_lc_connect();
    if (ret < 0) {
        LOG_ERR("LTE connection failed: %d", ret);
        return ret;
    }

    LOG_INF("LTE connected");

#if defined(CONFIG_STCP_BENCH_AUTORUN)
    ret = echo_benchmark_run();
    if (ret < 0) {
        LOG_ERR("Benchmark failed: %d", ret);
        return ret;
    }
    LOG_INF("Transport test finished successfully");
#endif

#if defined(CONFIG_STCP_BENCH_SHELL)
    LOG_INF("Benchmark shell ready; type: stcp config show");
#endif

    return 0;
}
```

## src/bench_shell.c
```c
#include <errno.h>
#include <stdlib.h>
#include <string.h>

#include <zephyr/kernel.h>
#include <zephyr/shell/shell.h>
#include <zephyr/sys/util.h>
#include <zephyr/sys/printk.h>

#include "echo_benchmark.h"
#if defined(CONFIG_ETH_W5500)
#include "ethernet_status.h"
#endif
#if defined(CONFIG_NRF_MODEM_LIB)
#include "modem_status.h"
#endif

static struct bench_config shell_cfg;
static bool shell_cfg_ready;

static void ensure_config(void)
{
    if (!shell_cfg_ready) {
        bench_config_defaults(&shell_cfg);
        shell_cfg_ready = true;
    }
}

static int parse_u32(const struct shell *sh, const char *text,
                     uint32_t min, uint32_t max, uint32_t *value)
{
    char *end = NULL;
    unsigned long parsed;

    errno = 0;
    parsed = strtoul(text, &end, 0);
    if (errno || !end || *end != '\0' || parsed < min || parsed > max) {
        shell_error(sh, "Invalid value '%s' (range %u..%u)", text, min, max);
        return -EINVAL;
    }

    *value = (uint32_t)parsed;
    return 0;
}

static int cmd_config_show(const struct shell *sh, size_t argc, char **argv)
{
    ARG_UNUSED(argc);
    ARG_UNUSED(argv);
    ensure_config();
    shell_print(sh, "Host      : %s", shell_cfg.host);
    shell_print(sh, "Port      : %s", shell_cfg.port);
    shell_print(sh, "Transport : %s", bench_transport_name(shell_cfg.transport));
    shell_print(sh, "Chunk     : %u bytes", shell_cfg.chunk_size);
    shell_print(sh, "Total     : %u bytes", shell_cfg.total_bytes);
    shell_print(sh, "Timeout   : %u ms", shell_cfg.timeout_ms);
    shell_print(sh, "Report    : %u ms", shell_cfg.report_interval_ms);
    return 0;
}

static int cmd_config_host(const struct shell *sh, size_t argc, char **argv)
{
    ARG_UNUSED(argc);
    ensure_config();
    if (strlen(argv[1]) >= sizeof(shell_cfg.host)) {
        shell_error(sh, "Host is too long");
        return -ENAMETOOLONG;
    }
    strcpy(shell_cfg.host, argv[1]);
    shell_print(sh, "Host = %s", shell_cfg.host);
    return 0;
}

static int cmd_config_port(const struct shell *sh, size_t argc, char **argv)
{
    uint32_t port;
    ARG_UNUSED(argc);
    ensure_config();
    if (parse_u32(sh, argv[1], 1, 65535, &port) < 0) return -EINVAL;
    snprintk(shell_cfg.port, sizeof(shell_cfg.port), "%u", port);
    shell_print(sh, "Port = %s", shell_cfg.port);
    return 0;
}

static int cmd_config_chunk(const struct shell *sh, size_t argc, char **argv)
{
    ARG_UNUSED(argc);
    ensure_config();
    if (parse_u32(sh, argv[1], 1, CONFIG_BENCH_MAX_CHUNK_SIZE, &shell_cfg.chunk_size) < 0) return -EINVAL;
    shell_print(sh, "Chunk = %u", shell_cfg.chunk_size);
    return 0;
}

static int cmd_config_total(const struct shell *sh, size_t argc, char **argv)
{
    ARG_UNUSED(argc);
    ensure_config();
    if (parse_u32(sh, argv[1], 1, 64U * 1024U * 1024U, &shell_cfg.total_bytes) < 0) return -EINVAL;
    shell_print(sh, "Total = %u", shell_cfg.total_bytes);
    return 0;
}

static int cmd_config_timeout(const struct shell *sh, size_t argc, char **argv)
{
    ARG_UNUSED(argc);
    ensure_config();
    if (parse_u32(sh, argv[1], 1000, 600000, &shell_cfg.timeout_ms) < 0) return -EINVAL;
    shell_print(sh, "Timeout = %u ms", shell_cfg.timeout_ms);
    return 0;
}


static int cmd_config_report(const struct shell *sh, size_t argc, char **argv)
{
    ARG_UNUSED(argc);
    ensure_config();
    if (parse_u32(sh, argv[1], 0, 600000, &shell_cfg.report_interval_ms) < 0) return -EINVAL;
    shell_print(sh, "Report interval = %u ms", shell_cfg.report_interval_ms);
    return 0;
}

static int cmd_config_transport(const struct shell *sh, size_t argc, char **argv)
{
    ARG_UNUSED(argc);
    ensure_config();
    if (!strcmp(argv[1], "tcp")) shell_cfg.transport = BENCH_TRANSPORT_TCP;
    else if (!strcmp(argv[1], "stcp")) shell_cfg.transport = BENCH_TRANSPORT_STCP;
    else if (!strcmp(argv[1], "tls")) shell_cfg.transport = BENCH_TRANSPORT_TLS;
    else {
        shell_error(sh, "Transport must be tcp, tls or stcp");
        return -EINVAL;
    }
    shell_print(sh, "Transport = %s", bench_transport_name(shell_cfg.transport));
    return 0;
}

static uint64_t mib_per_second_micro(uint32_t bytes, int64_t elapsed_ms)
{
    if (bytes == 0U || elapsed_ms <= 0) {
        return 0U;
    }
    return ((uint64_t)bytes * 1000ULL * 1000000ULL) /
           ((uint64_t)elapsed_ms * 1048576ULL);
}

static uint64_t operations_per_second_micro(uint32_t operations, int64_t elapsed_ms)
{
    if (operations == 0U || elapsed_ms <= 0) {
        return 0U;
    }
    return ((uint64_t)operations * 1000ULL * 1000000ULL) /
           (uint64_t)elapsed_ms;
}

static const char *bench_carrier_name(void)
{
#if defined(CONFIG_ETH_W5500)
    return "ethernet";
#elif defined(CONFIG_NRF_MODEM_LIB)
    return "lte";
#else
    return "unknown";
#endif
}

static void emit_machine_result(const struct shell *sh, const char *direction, int command_rc)
{
    const struct bench_result *r = bench_last_result(direction);
    uint32_t operations;
    int status;
    unsigned int repeat;

    ARG_UNUSED(sh);

    if (r == NULL) {
        return;
    }

    operations = (shell_cfg.total_bytes + shell_cfg.chunk_size - 1U) /
                 shell_cfg.chunk_size;
    status = command_rc < 0 ? command_rc : r->status;

    /*
     * Keep the machine-readable UART result deliberately short.  Long JSON
     * frames competed with deferred W5500 logs and lost individual lines.
     * The host runner expands this compact record into the infra JSON schema.
     * Repeat it so one dropped UART line does not lose the benchmark result.
     */
    for (repeat = 0U; repeat < 5U; repeat++) {
        printk("STCP_RESULT dir=%s transport=%s payload=%u total=%u "
               "elapsed_ms=%lld operations=%u status=%d errors=%u "
               "tx=%u rx=%u\n",
               direction, bench_transport_name(shell_cfg.transport),
               shell_cfg.chunk_size, shell_cfg.total_bytes,
               (long long)r->elapsed_ms, operations, status,
               status < 0 ? 1U : 0U, r->bytes_tx, r->bytes_rx);
        k_sleep(K_MSEC(20));
    }
}

static int run_and_report(const struct shell *sh, const char *name,
                          int (*fn)(const struct bench_config *))
{
    int rc;
    ensure_config();
    shell_print(sh, "%s: %s://%s:%s, total=%u, chunk=%u", name,
                bench_transport_name(shell_cfg.transport), shell_cfg.host,
                shell_cfg.port, shell_cfg.total_bytes, shell_cfg.chunk_size);
    rc = fn(&shell_cfg);
    emit_machine_result(sh, name, rc);
    if (rc < 0) {
        shell_error(sh, "%s failed: %d", name, rc);
        return rc;
    }
    shell_print(sh, "%s completed successfully", name);
    return 0;
}

static int cmd_bench_upload(const struct shell *sh, size_t argc, char **argv)
{ ARG_UNUSED(argc); ARG_UNUSED(argv); return run_and_report(sh, "upload", bench_run_upload); }
static int cmd_bench_download(const struct shell *sh, size_t argc, char **argv)
{ ARG_UNUSED(argc); ARG_UNUSED(argv); return run_and_report(sh, "download", bench_run_download); }
static int cmd_bench_full(const struct shell *sh, size_t argc, char **argv)
{ ARG_UNUSED(argc); ARG_UNUSED(argv); return run_and_report(sh, "full", bench_run_full); }
static int cmd_bench_all(const struct shell *sh, size_t argc, char **argv)
{ ARG_UNUSED(argc); ARG_UNUSED(argv); return run_and_report(sh, "all", bench_run_all); }

SHELL_STATIC_SUBCMD_SET_CREATE(config_cmds,
    SHELL_CMD(show, NULL, "Show runtime benchmark configuration", cmd_config_show),
    SHELL_CMD_ARG(host, NULL, "Set host: stcp config host <name|ip>", cmd_config_host, 2, 0),
    SHELL_CMD_ARG(port, NULL, "Set port: stcp config port <1..65535>", cmd_config_port, 2, 0),
    SHELL_CMD_ARG(chunk, NULL, "Set chunk bytes: stcp config chunk <1..65536>", cmd_config_chunk, 2, 0),
    SHELL_CMD_ARG(total, NULL, "Set total bytes: stcp config total <bytes>", cmd_config_total, 2, 0),
    SHELL_CMD_ARG(timeout, NULL, "Set inactivity timeout ms", cmd_config_timeout, 2, 0),
    SHELL_CMD_ARG(report, NULL, "Set progress report interval ms (0 disables)", cmd_config_report, 2, 0),
    SHELL_CMD_ARG(transport, NULL, "Set tcp, tls or stcp", cmd_config_transport, 2, 0),
    SHELL_SUBCMD_SET_END
);

#if defined(CONFIG_ETH_W5500)
static int cmd_net_status(const struct shell *sh, size_t argc, char **argv)
{
    ARG_UNUSED(argc);
    ARG_UNUSED(argv);
    return ethernet_status_show(sh);
}

SHELL_STATIC_SUBCMD_SET_CREATE(net_cmds,
    SHELL_CMD(status, NULL, "Show Ethernet interface, MAC, IPv4 and gateway", cmd_net_status),
    SHELL_SUBCMD_SET_END
);
#endif

SHELL_STATIC_SUBCMD_SET_CREATE(bench_cmds,
    SHELL_CMD(upload, NULL, "Run continuous upload benchmark", cmd_bench_upload),
    SHELL_CMD(download, NULL, "Run continuous download benchmark", cmd_bench_download),
    SHELL_CMD(full, NULL, "Run full-duplex benchmark", cmd_bench_full),
    SHELL_CMD(all, NULL, "Run upload, download and full-duplex", cmd_bench_all),
    SHELL_SUBCMD_SET_END
);


#if defined(CONFIG_NRF_MODEM_LIB)
static int cmd_modem_system(const struct shell *sh, size_t argc, char **argv)
{ ARG_UNUSED(argc); ARG_UNUSED(argv); return modem_status_system(sh); }
static int cmd_modem_health(const struct shell *sh, size_t argc, char **argv)
{ ARG_UNUSED(argc); ARG_UNUSED(argv); return modem_status_health(sh); }
static int cmd_modem_signal(const struct shell *sh, size_t argc, char **argv)
{ ARG_UNUSED(argc); ARG_UNUSED(argv); return modem_status_signal(sh); }
static int cmd_modem_network(const struct shell *sh, size_t argc, char **argv)
{ ARG_UNUSED(argc); ARG_UNUSED(argv); return modem_status_network(sh); }
static int cmd_modem_band(const struct shell *sh, size_t argc, char **argv)
{ ARG_UNUSED(argc); ARG_UNUSED(argv); return modem_status_band(sh); }
static int cmd_modem_packet(const struct shell *sh, size_t argc, char **argv)
{ ARG_UNUSED(argc); ARG_UNUSED(argv); return modem_status_packet(sh); }
static int cmd_modem_sleep(const struct shell *sh, size_t argc, char **argv)
{ ARG_UNUSED(argc); ARG_UNUSED(argv); return modem_status_sleep(sh); }
static int cmd_modem_apn(const struct shell *sh, size_t argc, char **argv)
{ ARG_UNUSED(argc); ARG_UNUSED(argv); return modem_status_apn(sh); }
static int cmd_modem_contexts(const struct shell *sh, size_t argc, char **argv)
{ ARG_UNUSED(argc); ARG_UNUSED(argv); return modem_status_contexts(sh); }
static int cmd_modem_all(const struct shell *sh, size_t argc, char **argv)
{ ARG_UNUSED(argc); ARG_UNUSED(argv); return modem_status_all(sh); }
static int cmd_modem_at(const struct shell *sh, size_t argc, char **argv)
{ return modem_status_at(sh, argc, argv); }

SHELL_STATIC_SUBCMD_SET_CREATE(modem_cmds,
    SHELL_CMD(system, NULL, "Show configured and currently attached radio system", cmd_modem_system),
    SHELL_CMD(health, NULL, "Show interpreted modem, radio and PDP summary", cmd_modem_health),
    SHELL_CMD(signal, NULL, "Show CESQ and serving-cell radio metrics", cmd_modem_signal),
    SHELL_CMD(network, NULL, "Show registration, RRC and functional mode", cmd_modem_network),
    SHELL_CMD(band, NULL, "Show current LTE band", cmd_modem_band),
    SHELL_CMD(packet, NULL, "Show packet-domain connection statistics", cmd_modem_packet),
    SHELL_CMD(sleep, NULL, "Show modem sleep, PSM and eDRX settings", cmd_modem_sleep),
    SHELL_CMD(apn, NULL, "Show configured and active PDP/APN contexts", cmd_modem_apn),
    SHELL_CMD(contexts, NULL, "Show PDP contexts and benchmark CID/PDN binding", cmd_modem_contexts),
    SHELL_CMD(all, NULL, "Show all available modem status information", cmd_modem_all),
    SHELL_CMD_ARG(at, NULL, "Run AT command: stcp modem at <AT command>", cmd_modem_at, 2, 15),
    SHELL_SUBCMD_SET_END
);

SHELL_STATIC_SUBCMD_SET_CREATE(stcp_cmds,
    SHELL_CMD(config, &config_cmds, "Runtime benchmark configuration", NULL),
    SHELL_CMD(bench, &bench_cmds, "Transport benchmarks", NULL),
    SHELL_CMD(modem, &modem_cmds, "nRF modem status and radio diagnostics", NULL),
    SHELL_SUBCMD_SET_END
);

#else
SHELL_STATIC_SUBCMD_SET_CREATE(stcp_cmds,
    SHELL_CMD(config, &config_cmds, "Runtime benchmark configuration", NULL),
    SHELL_CMD(bench, &bench_cmds, "Transport benchmarks", NULL),
#if defined(CONFIG_ETH_W5500)
    SHELL_CMD(net, &net_cmds, "Ethernet status and diagnostics", NULL),
#endif
    SHELL_SUBCMD_SET_END
);
#endif

SHELL_CMD_REGISTER(stcp, &stcp_cmds, "STCP transport test bench", NULL);
```

## src/echo_benchmark.c
```c
#include <errno.h>
#include <fcntl.h>
#include <stdint.h>
#include <string.h>

#include <zephyr/kernel.h>
#include <zephyr/logging/log.h>
#include <zephyr/net/socket.h>
#include <zephyr/sys/byteorder.h>

#include <stcp/stcp.h>
#include "echo_benchmark.h"
#if defined(CONFIG_NRF_MODEM_LIB)
#include "stcp_lte_transport.h"
#include "modem_status.h"
#endif

LOG_MODULE_REGISTER(echo_benchmark, LOG_LEVEL_INF);

#define BENCH_MAGIC 0x42454e32U /* BEN2 */
#define BENCH_VERSION 1U
#define BENCH_MODE_UPLOAD 1U
#define BENCH_MODE_DOWNLOAD 2U
#define BENCH_MODE_FULL 3U
#define BENCH_MAX_CHUNK CONFIG_BENCH_MAX_CHUNK_SIZE

struct bench_request {
    uint32_t magic;
    uint32_t version;
    uint32_t mode;
    uint32_t chunk_size;
    uint32_t total_bytes;
} __packed;

struct bench_reply {
    uint32_t magic;
    uint32_t mode;
    uint32_t status;
    uint32_t bytes_received;
    uint32_t bytes_sent;
} __packed;

static const struct bench_config *active_cfg;
static struct bench_summary last_summary;

static int validate_config(const struct bench_config *cfg);

static int wait_socket_ready(int fd, short events, int64_t deadline_ms)
{
    struct zsock_pollfd pfd = {.fd = fd, .events = events};

    while (true) {
        int64_t remaining = deadline_ms - k_uptime_get();
        int rc;
        if (remaining <= 0) return -ETIMEDOUT;
        pfd.revents = 0;
        rc = zsock_poll(&pfd, 1, (int)MIN(remaining, (int64_t)INT32_MAX));
        if (rc < 0) {
            if (errno == EINTR) continue;
            return -errno;
        }
        if (rc == 0) return -ETIMEDOUT;
        if (pfd.revents & ZSOCK_POLLNVAL) return -EBADF;
        if (pfd.revents & ZSOCK_POLLERR) return -EIO;
        if (pfd.revents & (events | ZSOCK_POLLHUP)) return 0;
    }
}

static int send_all(int fd, const void *buf, size_t len)
{
    const uint8_t *p = buf;
    size_t done = 0;
    int64_t deadline = k_uptime_get() + active_cfg->timeout_ms;
    while (done < len) {
        ssize_t n = zsock_send(fd, p + done, len - done, 0);
        if (n > 0) { done += (size_t)n; deadline = k_uptime_get() + active_cfg->timeout_ms; continue; }
        if (n == 0) return -ECONNRESET;
        if (errno == EINTR) continue;
        if (errno == EAGAIN || errno == EWOULDBLOCK) {
            int rc = wait_socket_ready(fd, ZSOCK_POLLOUT, deadline);
            if (rc < 0) return rc;
            continue;
        }
        return -errno;
    }
    return 0;
}

static int recv_all(int fd, void *buf, size_t len)
{
    uint8_t *p = buf;
    size_t done = 0;
    int64_t deadline = k_uptime_get() + active_cfg->timeout_ms;
    while (done < len) {
        ssize_t n = zsock_recv(fd, p + done, len - done, 0);
        if (n > 0) { done += (size_t)n; deadline = k_uptime_get() + active_cfg->timeout_ms; continue; }
        if (n == 0) return -ECONNRESET;
        if (errno == EINTR) continue;
        if (errno == EAGAIN || errno == EWOULDBLOCK) {
            int rc = wait_socket_ready(fd, ZSOCK_POLLIN, deadline);
            if (rc < 0) return rc;
            continue;
        }
        return -errno;
    }
    return 0;
}

static int set_nonblocking(int fd)
{
    int flags = zsock_fcntl(fd, F_GETFL, 0);
    if (flags < 0) return -errno;
    return zsock_fcntl(fd, F_SETFL, flags | O_NONBLOCK) < 0 ? -errno : 0;
}

static int set_blocking(int fd)
{
    int flags = zsock_fcntl(fd, F_GETFL, 0);
    if (flags < 0) return -errno;
    return zsock_fcntl(fd, F_SETFL, flags & ~O_NONBLOCK) < 0 ? -errno : 0;
}

static int connect_server(const struct bench_config *cfg)
{
    struct zsock_addrinfo hints = {.ai_family = AF_INET, .ai_socktype = SOCK_STREAM};
    struct zsock_addrinfo *res = NULL;
    int fd, rc;

    rc = zsock_getaddrinfo(cfg->host, cfg->port, &hints, &res);
    if (rc || !res) return -EHOSTUNREACH;
if (cfg->transport == BENCH_TRANSPORT_STCP) {
        fd = zsock_socket(AF_STCP, SOCK_STREAM, IPPROTO_STCP);
    } else if (cfg->transport == BENCH_TRANSPORT_TCP) {
        fd = zsock_socket(AF_INET, SOCK_STREAM, IPPROTO_TCP);
    } else {
        zsock_freeaddrinfo(res);
        return -ENOTSUP;
    }
    if (fd < 0) { rc = -errno; zsock_freeaddrinfo(res); return rc; }

#if defined(CONFIG_NRF_MODEM_LIB)
    if (cfg->transport == BENCH_TRANSPORT_TCP ||
        cfg->transport == BENCH_TRANSPORT_STCP) {
        rc = stcp_lte_transport_bind_socket(fd);
        if (rc < 0) goto fail;
    }
#endif

    rc = set_nonblocking(fd);
    if (rc < 0) goto fail;
    if (zsock_connect(fd, res->ai_addr, res->ai_addrlen) < 0) {
        if (errno != EINPROGRESS && errno != EAGAIN && errno != EWOULDBLOCK) { rc = -errno; goto fail; }
        rc = wait_socket_ready(fd, ZSOCK_POLLOUT, k_uptime_get() + active_cfg->timeout_ms);
        if (rc < 0) goto fail;
        int err = 0; socklen_t sl = sizeof(err);
        if (zsock_getsockopt(fd, SOL_SOCKET, SO_ERROR, &err, &sl) < 0) { rc = -errno; goto fail; }
        if (err) { rc = -err; goto fail; }
    }
    rc = set_blocking(fd);
    if (rc < 0) goto fail;
    zsock_freeaddrinfo(res);
    return fd;
fail:
    zsock_close(fd); zsock_freeaddrinfo(res); return rc;
}

static void fill_pattern(uint8_t *buf, size_t len, uint32_t offset, uint8_t salt)
{
    for (size_t i = 0; i < len; i++) buf[i] = (uint8_t)(((offset + i) * 31U + salt) & 0xffU);
}

static int verify_pattern(const uint8_t *buf, size_t len, uint32_t offset, uint8_t salt)
{
    for (size_t i = 0; i < len; i++)
        if (buf[i] != (uint8_t)(((offset + i) * 31U + salt) & 0xffU)) return -EBADMSG;
    return 0;
}

static int send_request(int fd, uint32_t mode, const struct bench_config *cfg)
{
    struct bench_request r = {
        .magic = sys_cpu_to_be32(BENCH_MAGIC), .version = sys_cpu_to_be32(BENCH_VERSION),
        .mode = sys_cpu_to_be32(mode), .chunk_size = sys_cpu_to_be32(cfg->chunk_size),
        .total_bytes = sys_cpu_to_be32(cfg->total_bytes),
    };
    return send_all(fd, &r, sizeof(r));
}

static int recv_reply(int fd, uint32_t mode, struct bench_reply *reply)
{
    int rc = recv_all(fd, reply, sizeof(*reply));
    if (rc < 0) return rc;
    if (sys_be32_to_cpu(reply->magic) != BENCH_MAGIC || sys_be32_to_cpu(reply->mode) != mode)
        return -EBADMSG;
    return -(int)sys_be32_to_cpu(reply->status);
}

static uint64_t bps(uint64_t bytes, int64_t elapsed_ms)
{
    return (bytes * 8ULL * 1000ULL) / (uint64_t)MAX(elapsed_ms, 1);
}


static const char *result_status(int status)
{
    return status == 0 ? "OK" : "FAILED";
}

static const char *rat_name(int act)
{
    switch (act) {
    case 7: return "LTE-M";
    case 9: return "NB-IoT";
    default: return "unknown";
    }
}

static void log_rate_line(const char *name, const struct bench_result *r)
{
    LOG_INF("%-10s status=%s(%d) elapsed=%lld ms TX=%llu bit/s RX=%llu bit/s aggregate=%llu bit/s",
            name, result_status(r->status), r->status, r->elapsed_ms,
            r->tx_bps, r->rx_bps, r->aggregate_bps);
}

const struct bench_result *bench_last_result(const char *direction)
{
    if (direction == NULL) {
        return NULL;
    }
    if (strcmp(direction, "upload") == 0) {
        return &last_summary.upload;
    }
    if (strcmp(direction, "download") == 0) {
        return &last_summary.download;
    }
    if (strcmp(direction, "full") == 0) {
        return &last_summary.full;
    }
    return NULL;
}

void bench_print_last_summary(const struct bench_config *cfg)
{
    LOG_INF("================ BENCHMARK SUMMARY ================");
    LOG_INF("Transport=%s server=%s:%s chunk=%u total=%u bytes",
            bench_transport_name(cfg->transport), cfg->host, cfg->port,
            cfg->chunk_size, cfg->total_bytes);
#if defined(CONFIG_NRF_MODEM_LIB)
    {
        struct modem_status_snapshot modem;
        bool modem_ok = modem_status_get_snapshot(&modem) == 0;

        if (modem_ok) {
            LOG_INF("Modem operator=%s RAT=%s band=%d RSRP=%d dBm RSRQ=%d.%d dB SNR_raw=%d APN=%s",
                    modem.monitor_valid ? modem.operator_name : "unknown",
                    rat_name(modem.current_act), modem.band,
                    modem.rsrp_dbm, modem.rsrq_tenths_db / 10,
                    abs(modem.rsrq_tenths_db % 10), modem.snr_raw,
                    modem.pdp_valid ? modem.apn : "unknown");
        } else {
            LOG_WRN("Modem status snapshot unavailable");
        }
    }
#else
    LOG_INF("Network backend=Ethernet/native Zephyr stack");
#endif
    log_rate_line("UPLOAD", &last_summary.upload);
    log_rate_line("DOWNLOAD", &last_summary.download);
    log_rate_line("FULL", &last_summary.full);
    LOG_INF("===================================================");
}

static void report_progress(const char *label, uint32_t done, uint32_t total,
                            int64_t started_ms, int64_t *last_report_ms,
                            bool force)
{
    int64_t now = k_uptime_get();
    uint32_t remaining = total - done;
    uint32_t percent = total ? (uint32_t)(((uint64_t)done * 100ULL) / total) : 100U;
    int64_t elapsed = MAX(now - started_ms, 1);

    if (!force && active_cfg->report_interval_ms == 0) return;
    if (!force && now - *last_report_ms < active_cfg->report_interval_ms) return;

    LOG_INF("%s progress=%u%% transferred=%u/%u bytes remaining=%u rate=%llu bit/s",
            label, percent, done, total, remaining, bps(done, elapsed));
    *last_report_ms = now;
}

static int stream_send(int fd, uint8_t *tx_buf, uint32_t total, uint32_t chunk_size, uint8_t salt,
                       const char *label)
{
    uint32_t off = 0;
    uint32_t send_calls = 0;
    uint32_t partial_calls = 0;
    size_t max_send = 0;
    int64_t started = k_uptime_get();
    int64_t last_report = started;

    while (off < total) {
        size_t chunk_len = MIN(chunk_size, total - off);
        size_t chunk_off = 0;

        fill_pattern(tx_buf, chunk_len, off, salt);

        while (chunk_off < chunk_len) {
            size_t remaining = chunk_len - chunk_off;
            ssize_t n = zsock_send(fd, tx_buf + chunk_off, remaining, 0);
            send_calls++;

            if (n > 0) {
                if ((size_t)n < remaining) partial_calls++;
                if ((size_t)n > max_send) max_send = (size_t)n;
                chunk_off += (size_t)n;
                off += (uint32_t)n;
                report_progress(label, off, total, started, &last_report, off == total);
                continue;
            }
            if (n == 0) return -ECONNRESET;
            if (errno == EINTR) continue;
            return -errno;
        }
    }

    LOG_INF("%s I/O stats calls=%u partial=%u max_send=%u",
            label, send_calls, partial_calls, (uint32_t)max_send);
    return 0;
}

static int stream_recv(int fd, uint8_t *rx_buf, uint32_t total, uint32_t rx_buf_size, uint8_t salt,
                       const char *label)
{
    uint32_t off = 0;
    uint32_t recv_calls = 0;
    size_t max_recv = 0;
    int64_t started = k_uptime_get();
    int64_t last_report = started;

    while (off < total) {
        size_t wanted = MIN(rx_buf_size, total - off);
        ssize_t n = zsock_recv(fd, rx_buf, wanted, 0);
        recv_calls++;

        if (n > 0) {
            int rc = verify_pattern(rx_buf, (size_t)n, off, salt);
            if (rc < 0) return rc;
            if ((size_t)n > max_recv) max_recv = (size_t)n;
            off += (uint32_t)n;
            report_progress(label, off, total, started, &last_report, off == total);
            continue;
        }
        if (n == 0) return -ECONNRESET;
        if (errno == EINTR) continue;
        return -errno;
    }

    LOG_INF("%s I/O stats calls=%u max_recv=%u", label, recv_calls, (uint32_t)max_recv);
    return 0;
}

int bench_run_upload(const struct bench_config *cfg)
{
    memset(&last_summary.upload, 0, sizeof(last_summary.upload));
    last_summary.upload.status = -ECANCELED;
    int valid = validate_config(cfg);
    if (valid < 0) return valid;
    struct bench_reply reply;
    active_cfg = cfg;
    uint8_t *tx_buf = k_malloc(cfg->chunk_size);
    if (!tx_buf) {
        LOG_ERR("UPLOAD buffer allocation failed: %u bytes", cfg->chunk_size);
        return -ENOMEM;
    }
    int fd = connect_server(cfg);
    if (fd < 0) { k_free(tx_buf); return fd; }
    int rc = send_request(fd, BENCH_MODE_UPLOAD, cfg);
    int64_t start = k_uptime_get();
    if (!rc) rc = stream_send(fd, tx_buf, cfg->total_bytes, cfg->chunk_size, 0x17, "UPLOAD TX");
    if (!rc) rc = recv_reply(fd, BENCH_MODE_UPLOAD, &reply);
    int64_t ms = MAX(k_uptime_get() - start, 1);
    zsock_close(fd);
    k_free(tx_buf);
    last_summary.upload.status = rc;
    last_summary.upload.bytes_tx = rc < 0 ? 0 : cfg->total_bytes;
    last_summary.upload.elapsed_ms = ms;
    last_summary.upload.tx_bps = rc < 0 ? 0 : bps(cfg->total_bytes, ms);
    last_summary.upload.aggregate_bps = last_summary.upload.tx_bps;
    if (rc < 0) return rc;
    LOG_INF("UPLOAD bytes=%u elapsed=%lld ms throughput=%llu bit/s", cfg->total_bytes, ms, last_summary.upload.tx_bps);
    return 0;
}

int bench_run_download(const struct bench_config *cfg)
{
    memset(&last_summary.download, 0, sizeof(last_summary.download));
    last_summary.download.status = -ECANCELED;
    int valid = validate_config(cfg);
    if (valid < 0) return valid;
    struct bench_reply reply;
    active_cfg = cfg;
    uint8_t *rx_buf = k_malloc(cfg->chunk_size);
    if (!rx_buf) {
        LOG_ERR("DOWNLOAD buffer allocation failed: %u bytes", cfg->chunk_size);
        return -ENOMEM;
    }
    int fd = connect_server(cfg);
    if (fd < 0) { k_free(rx_buf); return fd; }
    int rc = send_request(fd, BENCH_MODE_DOWNLOAD, cfg);
    int64_t start = k_uptime_get();
    if (!rc) rc = stream_recv(fd, rx_buf, cfg->total_bytes, cfg->chunk_size, 0x53, "DOWNLOAD RX");
    if (!rc) {
        struct bench_reply ack = {.magic=sys_cpu_to_be32(BENCH_MAGIC), .mode=sys_cpu_to_be32(BENCH_MODE_DOWNLOAD), .status=0,
            .bytes_received=sys_cpu_to_be32(cfg->total_bytes), .bytes_sent=0};
        rc = send_all(fd, &ack, sizeof(ack));
    }
    if (!rc) rc = recv_reply(fd, BENCH_MODE_DOWNLOAD, &reply);
    int64_t ms = MAX(k_uptime_get() - start, 1);
    zsock_close(fd);
    k_free(rx_buf);
    last_summary.download.status = rc;
    last_summary.download.bytes_rx = rc < 0 ? 0 : cfg->total_bytes;
    last_summary.download.elapsed_ms = ms;
    last_summary.download.rx_bps = rc < 0 ? 0 : bps(cfg->total_bytes, ms);
    last_summary.download.aggregate_bps = last_summary.download.rx_bps;
    if (rc < 0) return rc;
    LOG_INF("DOWNLOAD bytes=%u elapsed=%lld ms throughput=%llu bit/s", cfg->total_bytes, ms, last_summary.download.rx_bps);
    return 0;
}

struct sender_ctx { int fd; int rc; uint8_t *tx_buf; uint32_t total; uint32_t chunk; struct k_sem done; };
K_THREAD_STACK_DEFINE(sender_stack, CONFIG_BENCH_SENDER_STACK_SIZE);
static struct k_thread sender_thread;

static void sender_entry(void *a, void *b, void *c)
{
    ARG_UNUSED(b); ARG_UNUSED(c);
    struct sender_ctx *ctx = a;
    ctx->rc = stream_send(ctx->fd, ctx->tx_buf, ctx->total, ctx->chunk, 0x17, "FULL TX");
    k_sem_give(&ctx->done);
}

int bench_run_full(const struct bench_config *cfg)
{
    memset(&last_summary.full, 0, sizeof(last_summary.full));
    last_summary.full.status = -ECANCELED;
    int valid = validate_config(cfg);
    if (valid < 0) return valid;
    struct bench_reply reply;
    struct sender_ctx ctx;
    active_cfg = cfg;
    const uint32_t rx_chunk = MIN(cfg->chunk_size, (uint32_t)CONFIG_BENCH_FULL_RX_BUFFER_SIZE);
    uint8_t *tx_buf = k_malloc(cfg->chunk_size);
    uint8_t *rx_buf = k_malloc(rx_chunk);
    if (!tx_buf || !rx_buf) {
        LOG_ERR("FULL buffers allocation failed: TX=%u RX=%u bytes",
                cfg->chunk_size, rx_chunk);
        k_free(tx_buf);
        k_free(rx_buf);
        return -ENOMEM;
    }
    int fd = connect_server(cfg);
    if (fd < 0) { k_free(tx_buf); k_free(rx_buf); return fd; }
    int rc = send_request(fd, BENCH_MODE_FULL, cfg);
    if (rc < 0) { zsock_close(fd); k_free(tx_buf); k_free(rx_buf); return rc; }
    ctx.fd = fd; ctx.rc = 0; ctx.tx_buf = tx_buf; ctx.total = cfg->total_bytes; ctx.chunk = cfg->chunk_size; k_sem_init(&ctx.done, 0, 1);
    int64_t start = k_uptime_get();
    k_thread_create(&sender_thread, sender_stack, K_THREAD_STACK_SIZEOF(sender_stack), sender_entry,
                    &ctx, NULL, NULL, K_PRIO_PREEMPT(5), 0, K_NO_WAIT);
    rc = stream_recv(fd, rx_buf, cfg->total_bytes, rx_chunk, 0x53, "FULL RX");
    k_sem_take(&ctx.done, K_FOREVER);
    if (!rc) rc = ctx.rc;
    if (!rc) {
        struct bench_reply ack = {
            .magic = sys_cpu_to_be32(BENCH_MAGIC),
            .mode = sys_cpu_to_be32(BENCH_MODE_FULL),
            .status = 0,
            .bytes_received = sys_cpu_to_be32(cfg->total_bytes),
            .bytes_sent = sys_cpu_to_be32(cfg->total_bytes),
        };
        rc = send_all(fd, &ack, sizeof(ack));
    }
    if (!rc) rc = recv_reply(fd, BENCH_MODE_FULL, &reply);
    int64_t ms = MAX(k_uptime_get() - start, 1);
    zsock_close(fd);
    k_free(tx_buf);
    k_free(rx_buf);
    last_summary.full.status = rc;
    last_summary.full.bytes_tx = rc < 0 ? 0 : cfg->total_bytes;
    last_summary.full.bytes_rx = rc < 0 ? 0 : cfg->total_bytes;
    last_summary.full.elapsed_ms = ms;
    last_summary.full.tx_bps = rc < 0 ? 0 : bps(cfg->total_bytes, ms);
    last_summary.full.rx_bps = last_summary.full.tx_bps;
    last_summary.full.aggregate_bps = rc < 0 ? 0 : bps((uint64_t)cfg->total_bytes * 2ULL, ms);
    if (rc < 0) return rc;
    LOG_INF("FULL upload=%u download=%u elapsed=%lld ms", cfg->total_bytes, cfg->total_bytes, ms);
    LOG_INF("FULL TX=%llu bit/s RX=%llu bit/s aggregate=%llu bit/s",
            last_summary.full.tx_bps, last_summary.full.rx_bps,
            last_summary.full.aggregate_bps);
    return 0;
}

void bench_config_defaults(struct bench_config *cfg)
{
    memset(cfg, 0, sizeof(*cfg));
    strncpy(cfg->host, CONFIG_ECHO_SERVER_HOST, sizeof(cfg->host) - 1);
    strncpy(cfg->port, CONFIG_ECHO_SERVER_PORT, sizeof(cfg->port) - 1);
    cfg->chunk_size = CONFIG_BENCH_CHUNK_SIZE;
    cfg->total_bytes = CONFIG_BENCH_TOTAL_BYTES;
    cfg->timeout_ms = CONFIG_ECHO_SOCKET_TIMEOUT_MS;
    cfg->report_interval_ms = CONFIG_BENCH_REPORT_INTERVAL_MS;
#if defined(CONFIG_ECHO_TRANSPORT_STCP)
    cfg->transport = BENCH_TRANSPORT_STCP;
#else
    cfg->transport = BENCH_TRANSPORT_TCP;
#endif
}

const char *bench_transport_name(enum bench_transport transport)
{
    switch (transport) {
    case BENCH_TRANSPORT_TCP: return "tcp";
    case BENCH_TRANSPORT_STCP: return "stcp";
    case BENCH_TRANSPORT_TLS: return "tls";
    default: return "unknown";
    }
}

static int validate_config(const struct bench_config *cfg)
{
    if (!cfg || !cfg->host[0] || !cfg->port[0]) return -EINVAL;
    if (cfg->chunk_size < 1 || cfg->chunk_size > BENCH_MAX_CHUNK) return -EINVAL;
    if (cfg->total_bytes < cfg->chunk_size || cfg->timeout_ms < 1000) return -EINVAL;
    if (cfg->report_interval_ms > 600000U) return -EINVAL;
    return 0;
}

int bench_run_all(const struct bench_config *cfg)
{
    int rc = validate_config(cfg);
    memset(&last_summary, 0, sizeof(last_summary));
    last_summary.upload.status = -ECANCELED;
    last_summary.download.status = -ECANCELED;
    last_summary.full.status = -ECANCELED;
    if (rc < 0) return rc;
    LOG_INF("Benchmark transport=%s host=%s port=%s total=%u chunk=%u",
            bench_transport_name(cfg->transport), cfg->host, cfg->port,
            cfg->total_bytes, cfg->chunk_size);
    LOG_INF("Progress report interval=%u ms", cfg->report_interval_ms);
    rc = bench_run_upload(cfg);
    if (rc < 0) { bench_print_last_summary(cfg); return rc; }
    k_sleep(K_SECONDS(CONFIG_BENCH_PAUSE_SECONDS));
    rc = bench_run_download(cfg);
    if (rc < 0) { bench_print_last_summary(cfg); return rc; }
    k_sleep(K_SECONDS(CONFIG_BENCH_PAUSE_SECONDS));
    rc = bench_run_full(cfg);
    bench_print_last_summary(cfg);
    return rc;
}

int echo_benchmark_run(void)
{
    struct bench_config cfg;
    bench_config_defaults(&cfg);
    return bench_run_all(&cfg);
}
```

## src/echo_benchmark.h
```c
#ifndef STCP_ECHO_BENCHMARK_H
#define STCP_ECHO_BENCHMARK_H

#include <stdint.h>

enum bench_transport {
    BENCH_TRANSPORT_TCP = 0,
    BENCH_TRANSPORT_STCP = 1,
    BENCH_TRANSPORT_TLS = 2,
};

struct bench_config {
    char host[128];
    char port[8];
    uint32_t chunk_size;
    uint32_t total_bytes;
    uint32_t timeout_ms;
    uint32_t report_interval_ms;
    enum bench_transport transport;
};

struct bench_result {
    int status;
    uint32_t bytes_tx;
    uint32_t bytes_rx;
    int64_t elapsed_ms;
    uint64_t tx_bps;
    uint64_t rx_bps;
    uint64_t aggregate_bps;
};

struct bench_summary {
    struct bench_result upload;
    struct bench_result download;
    struct bench_result full;
};

void bench_config_defaults(struct bench_config *cfg);
const char *bench_transport_name(enum bench_transport transport);
int bench_run_upload(const struct bench_config *cfg);
int bench_run_download(const struct bench_config *cfg);
int bench_run_full(const struct bench_config *cfg);
int bench_run_all(const struct bench_config *cfg);
void bench_print_last_summary(const struct bench_config *cfg);
const struct bench_result *bench_last_result(const char *direction);
int echo_benchmark_run(void);

#endif
```

## src/ethernet_status.c
```c
#include "ethernet_status.h"

#include <errno.h>
#include <stdbool.h>
#include <stdio.h>

#include <zephyr/logging/log.h>
#include <zephyr/net/net_if.h>
#include <zephyr/net/net_ip.h>
#include <zephyr/sys/printk.h>

LOG_MODULE_REGISTER(ethernet_status, LOG_LEVEL_INF);

static const char *format_mac(const struct net_linkaddr *link, char *buffer,
                              size_t buffer_size)
{
    if (link == NULL || link->addr == NULL || link->len < 6U) {
        snprintf(buffer, buffer_size, "unavailable");
        return buffer;
    }

    snprintf(buffer, buffer_size, "%02x:%02x:%02x:%02x:%02x:%02x",
             link->addr[0], link->addr[1], link->addr[2],
             link->addr[3], link->addr[4], link->addr[5]);
    return buffer;
}

static const char *current_ipv4(struct net_if *iface, char *buffer,
                                size_t buffer_size)
{
    const struct in_addr *address;

    address = net_if_ipv4_get_global_addr(iface, NET_ADDR_PREFERRED);
    if (address == NULL || net_addr_ntop(AF_INET, address, buffer, buffer_size) == NULL) {
        snprintf(buffer, buffer_size, "unassigned");
    }

    return buffer;
}

int ethernet_status_show(const struct shell *shell)
{
    struct net_if *iface = net_if_get_default();
    char mac[24];
    char ipv4[NET_IPV4_ADDR_LEN];

    if (iface == NULL) {
        shell_error(shell, "No default network interface");
        return -ENODEV;
    }

    shell_print(shell, "=== ETHERNET STATUS ===");
    shell_print(shell, "Interface : %d", net_if_get_by_iface(iface));
    shell_print(shell, "Admin up  : %s", net_if_is_up(iface) ? "yes" : "no");
    shell_print(shell, "Carrier   : %s", net_if_is_carrier_ok(iface) ? "up" : "down");
    shell_print(shell, "MAC       : %s",
                format_mac(net_if_get_link_addr(iface), mac, sizeof(mac)));
    shell_print(shell, "IPv4      : %s", current_ipv4(iface, ipv4, sizeof(ipv4)));
    shell_print(shell, "Netmask   : %s", CONFIG_NET_CONFIG_MY_IPV4_NETMASK);
    shell_print(shell, "Gateway   : %s", CONFIG_NET_CONFIG_MY_IPV4_GW);
    shell_print(shell, "DHCP      : disabled");
    shell_print(shell, "SPI limit : 8 MHz");
    shell_print(shell, "=======================");
    return 0;
}

void ethernet_status_log_startup(void)
{
    struct net_if *iface = net_if_get_default();
    char mac[24];
    char ipv4[NET_IPV4_ADDR_LEN];

    if (iface == NULL) {
        LOG_ERR("No default Ethernet interface");
        return;
    }

    LOG_INF("Ethernet iface=%d admin=%s carrier=%s mac=%s",
            net_if_get_by_iface(iface),
            net_if_is_up(iface) ? "up" : "down",
            net_if_is_carrier_ok(iface) ? "up" : "down",
            format_mac(net_if_get_link_addr(iface), mac, sizeof(mac)));
    LOG_INF("Ethernet IPv4=%s netmask=%s gateway=%s DHCP=off SPI=8MHz",
            current_ipv4(iface, ipv4, sizeof(ipv4)),
            CONFIG_NET_CONFIG_MY_IPV4_NETMASK,
            CONFIG_NET_CONFIG_MY_IPV4_GW);
}
```

## src/modem_status.h
```c
#ifndef MODEM_STATUS_H_
#define MODEM_STATUS_H_

#include <stdbool.h>
#include <zephyr/shell/shell.h>

#define MODEM_STATUS_FIELD_SIZE 96

struct modem_status_snapshot {
    bool system_valid;
    bool ltem_enabled;
    bool nbiot_enabled;
    bool gnss_enabled;
    int preference;
    bool signal_valid;
    int rsrq_index;
    int rsrp_index;
    int rsrq_tenths_db;
    int rsrp_dbm;
    bool monitor_valid;
    char operator_name[MODEM_STATUS_FIELD_SIZE];
    int current_act;
    int band;
    int monitor_rsrp_index;
    int snr_raw;
    bool registration_valid;
    int registration_status;
    int registration_act;
    bool rrc_valid;
    int rrc_mode;
    int rrc_state;
    bool psm_valid;
    int psm_enabled;
    bool pdp_valid;
    char pdp_type[MODEM_STATUS_FIELD_SIZE];
    char apn[MODEM_STATUS_FIELD_SIZE];
    char addresses[MODEM_STATUS_FIELD_SIZE];
};

int modem_status_get_snapshot(struct modem_status_snapshot *snapshot);

int modem_status_system(const struct shell *sh);
int modem_status_health(const struct shell *sh);
int modem_status_signal(const struct shell *sh);
int modem_status_network(const struct shell *sh);
int modem_status_band(const struct shell *sh);
int modem_status_packet(const struct shell *sh);
int modem_status_sleep(const struct shell *sh);
int modem_status_apn(const struct shell *sh);
int modem_status_contexts(const struct shell *sh);
int modem_status_all(const struct shell *sh);
int modem_status_at(const struct shell *sh, size_t argc, char **argv);

#endif /* MODEM_STATUS_H_ */
```

## src/stcp_ping.h
```c
#ifndef STCP_PING_H_
#define STCP_PING_H_

#include <stddef.h>
#include <zephyr/shell/shell.h>

int stcp_ping_run(const struct shell *shell, size_t argc, char **argv);

#endif
```
