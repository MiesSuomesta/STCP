## Kconfig
```
mainmenu "STCP C carrier test"

source "Kconfig.zephyr"

menu "STCP test settings"

config STCP_TEST_REMOTE_IPV4
    string "Remote IPv4 address"
    default "192.168.1.100"

config STCP_TEST_REMOTE_PORT
    int "Remote TCP port"
    default 6677
    range 1 65535

config STCP_TEST_MESSAGE
    string "Message sent to echo server"
    default "Hello from STCP on Zephyr"

config STCP_TEST_RECV_TIMEOUT_MS
    int "Receive timeout in milliseconds"
    default 10000
    range 100 120000

endmenu
```

## prj.conf
```kconfig
CONFIG_NETWORKING=y
CONFIG_NET_IPV4=y
CONFIG_NET_TCP=y
CONFIG_NET_UDP=y
CONFIG_NET_SOCKETS=y
CONFIG_NET_SOCKETS_OFFLOAD=y
CONFIG_STCP=y
CONFIG_STCP_LOG_LEVEL=4
CONFIG_LOG=y
CONFIG_PRINTK=y
CONFIG_SERIAL=y
CONFIG_CONSOLE=y
CONFIG_UART_CONSOLE=y
CONFIG_MAIN_STACK_SIZE=4096
CONFIG_HEAP_MEM_POOL_SIZE=16384

# Test target; override with west build -- -DCONFIG_STCP_TEST_REMOTE_IPV4=\"x.x.x.x\"
CONFIG_STCP_TEST_REMOTE_IPV4="192.168.1.100"
CONFIG_STCP_TEST_REMOTE_PORT=6677
CONFIG_STCP_TEST_MESSAGE="Hello from STCP on Zephyr"
CONFIG_STCP_TEST_RECV_TIMEOUT_MS=10000
```

## nrf9151.conf
```kconfig
# nRF9151 modem configuration using the reused STCPv1-style LTE state tracker
CONFIG_NRF_MODEM_LIB=y
CONFIG_LTE_LINK_CONTROL=y
CONFIG_LTE_NETWORK_MODE_LTE_M=y
CONFIG_NRF_MODEM_LIB_ON_FAULT_APPLICATION_SPECIFIC=y
CONFIG_STCP_LTE=y
CONFIG_STCP_LTE_READY_TIMEOUT_SECONDS=300
```

## src/main.c
```c
#include <errno.h>
#include <string.h>
#include <zephyr/kernel.h>
#include <zephyr/net/socket.h>
#include <stcp/stcp.h>

#include <stcp/stcp_lte.h>

static int send_all(int fd, const uint8_t *data, size_t len)
{
    size_t offset = 0;

    while (offset < len) {
        ssize_t ret = zsock_send(fd, data + offset, len - offset, 0);
        if (ret < 0) {
            printk("send failed: errno=%d\n", errno);
            return -errno;
        }
        if (ret == 0) {
            printk("send returned zero\n");
            return -EPIPE;
        }
        offset += (size_t)ret;
    }

    return 0;
}

int main(void)
{
    static const char message[] = CONFIG_STCP_TEST_MESSAGE;
    struct sockaddr_in peer = {0};
    uint8_t reply[256];
    int fd;
    int ret;

    printk("STCP Zephyr C carrier test\n");
    printk("remote=%s:%d protocol=%d\n",
           CONFIG_STCP_TEST_REMOTE_IPV4,
           CONFIG_STCP_TEST_REMOTE_PORT,
           STCP_PROTO_TCP);

#if defined(CONFIG_STCP_LTE)
    printk("initializing STCP LTE transport\n");
    ret = stcp_lte_init_and_connect(CONFIG_STCP_LTE_READY_TIMEOUT_SECONDS);
    if (ret != 0) {
        printk("STCP LTE initialization failed: %d\n", ret);
        (void)stcp_lte_dump_status();
        return 0;
    }
    printk("LTE, PDN and IP data path ready\n");
#endif

    fd = zsock_socket(AF_STCP, SOCK_STREAM, STCP_PROTO_TCP);
    if (fd < 0) {
        printk("socket(AF_STCP) failed: errno=%d\n", errno);
        return 0;
    }
    printk("socket OK, fd=%d\n", fd);

    peer.sin_family = AF_INET;
    peer.sin_port = htons(CONFIG_STCP_TEST_REMOTE_PORT);
    ret = zsock_inet_pton(AF_INET, CONFIG_STCP_TEST_REMOTE_IPV4,
                          &peer.sin_addr);
    if (ret != 1) {
        printk("invalid remote IPv4 address\n");
        goto out;
    }

    ret = zsock_connect(fd, (struct sockaddr *)&peer, sizeof(peer));
    if (ret < 0) {
        printk("connect failed: errno=%d\n", errno);
        goto out;
    }
    printk("connect OK\n");

    ret = send_all(fd, (const uint8_t *)message, strlen(message));
    if (ret < 0) goto out;
    printk("send OK, bytes=%u\n", (unsigned int)strlen(message));

    ssize_t received = zsock_recv(fd, reply, sizeof(reply) - 1, 0);
    if (received < 0) {
        printk("recv failed: errno=%d\n", errno);
        goto out;
    }
    if (received == 0) {
        printk("peer closed connection\n");
        goto out;
    }

    reply[received] = '\0';
    printk("recv OK, bytes=%d, data=\"%s\"\n", (int)received, reply);

    if (zsock_shutdown(fd, ZSOCK_SHUT_RDWR) < 0) {
        printk("shutdown failed: errno=%d\n", errno);
    } else {
        printk("shutdown OK\n");
    }

out:
    if (zsock_close(fd) < 0) {
        printk("close failed: errno=%d\n", errno);
    } else {
        printk("close OK\n");
    }
    return 0;
}
```
