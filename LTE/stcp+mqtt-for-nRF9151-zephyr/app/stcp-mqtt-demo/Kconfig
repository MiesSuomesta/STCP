## STCP_integrations/Zephyr/ncs_v3.3.0-preview-code/moduuli/zephyr/Kconfig
```kconfig
menu "STCP Configuration"

config STCP
    bool "Enable STCP LTE transport"
    default y
    depends on NET_SOCKETS
    help
      Enable STCP LTE transport.

config MQTT_LIB_STCP
    bool "STCP support for socket MQTT Library"
    default y
    depends on STCP && MQTT_LIB
    help
      Enable STCP support for socket MQTT Library

config STCP_DEBUG
    bool "Enable STCP debug"
    default y
    depends on STCP   # esimerkki: riippuvuudet kernelistä
    help
      Enable STCP debugs.

config STCP_STATUS_MONITOR
    bool "Enable STCP modem state monitor"
    default y
    depends on STCP
    help
      Enable status monitor. It gives STCP's
      connectivity information

config STCP_STATUS_MONITOR_LOG_INTERVAL
    int "Enable STCP modem state monitor"
    default 5
    range 5 100000
    depends on STCP_STATUS_MONITOR
    help
      Enable status monitor. It gives STCP's
      connectivity information

config STCP_STATUS_MONITOR_STATISTICS
    bool "Enable STCP modem statistics"
    default y
    depends on STCP_STATUS_MONITOR
    help
      Collect statistics from real-life traffic

config STCP_TESTING
    bool "Enable STCP test support"
    default y
    depends on STCP
    help
      Enables the STCP Echo test server


config STCP_TESTING_LOG
    bool "Enable STCP test-mode logging"
    default y
    depends on STCP
    help
      Enables the STCP test-mode loggin even if
      STCP_DEBUG is not enabled.

      if not set completely off, and this setting 
      is not enabled then logging follows STCP_DEBUG
      setting.

config STCP_TESTING_LOG_COMPLETELY_OFF
    bool "Enable STCP test logging completely off"
    default n
    depends on STCP
    help
      Sets testing logging completely OFF if enabled.

config STCP_TESTING_MODE 
    int "Set STCP testmode, see help"
    default 3
    range 0 3
    depends on STCP_TESTING
    help
      Select which testing mode the modem runs.

      0 - Idle test
          Modem connects to the testing server and stays idle.
          Useful for testing LTE stability and watchdog behaviour.

      1 - TCP max throughput
          Raw TCP throughput test without STCP.

      2 - STCP max throughput
          STCP protocol throughput test running over TCP.

      3 - MQTT max throughput
          MQTT publish throughput test running over STCP.

      The modem connects to the host defined by:

          TESTING_PEER_HOSTNAME_TO_CONNECT
          TESTING_PEER_PORT_TO_CONNECT

      Normally the peer host runs the stcp-torture-server.

config STCP_TESTING_PAYLOAD_FORMAT
    string "Testing payload date format"
    default "TEST PAYLOAD %Y-%m-%d %H:%M:%S"
    depends on STCP_TESTING
    help
      Date format used to generate payload.
      set DATE_TIME define ON, to be able to use
      strftime() formatting rules for dynamic
      messages.

config STCP_TESTING_PEER_HOSTNAME_TO_CONNECT
    string "Host IP to where the test server creates connection to"
    default "lja.fi"
    depends on STCP_TESTING
    help
      Cause the connection has to be from the modem, the hostname
      an port is needed to create test connection to.

config STCP_TESTING_PEER_PORT_TO_CONNECT
    int "Port where the test server creates connection to"
    default 7777
    range 1 65535
    depends on STCP_TESTING
    help
      Cause the connection has to be from the modem, the hostname
      an port is needed to create test connection to.

config STCP_DEBUG_LATENCY
    bool "Enable STCP latency & timing debug"
    default y
    depends on STCP_DEBUG   # esimerkki: riippuvuudet kernelistä
    help
      Enable STCP latency and timing debugs.

config STCP_WATCHDOG_ENABLE
    bool "Enable STCP watchdog"
    default y
    depends on STCP
    help
      Enable STCP watchdog thread that monitors
      STCP activity and network health.

config STCP_WATCHDOG_MAX_TIMEOUT
    int "Watchdog timeout in seconds"
    default 300
    range 30 36000
    depends on STCP_WATCHDOG_ENABLE
    help
      Maximum allowed inactivity time before
      the watchdog triggers a modem reset.

config STCP_WATCHDOG_CHECK_INTERVAL
    int "Watchdog check interval in seconds"
    default 15
    range 5 36000
    depends on STCP_WATCHDOG_ENABLE
    help
      Interval between watchdog health checks.

config STCP_SELFTEST
    bool "Enable STCP self-test"
    default n
    depends on STCP
    help
      Enable STCP self-test support.

config STCP_AES_BYPASS
    bool "Enable STCP AES bypass"
    default n
    depends on STCP   # esimerkki: riippuvuudet kernelistä
    help
      Bypass AES enc/decryption for development purposes.

config STCP_CONNECT_TO_HOST
    string "STCP Connect to hostname"
    default "lja.fi"
    depends on STCP
    help
      STCP Remote endpoint hostname.

config STCP_CONNECT_TO_PORT
    int "STCP Connect to tcp port"
    default 7777
    range 1 65535
    depends on STCP
    help
      STCP Remote endpoint tcp port.

config STCP_LTE_APN_NAME
    string "The APN name to connect."
    default "internet"
    depends on STCP
    help
      The APN name to use to connect.

      Ask from your ISP what is the right APN
      name to use.


endmenu
```

## STCPv1/LTE/stcp+mqtt-for-nRF9151-zephyr/app/stcp-mqtt-demo/golden/1.4.2026-build/Kconfig/soc/Kconfig.sysbuild
```kconfig
# Load Sysbuild SoC Kconfig descriptions.
osource "/home/pomo/ncs/zephyr/soc/xlnx/zynqmp/Kconfig.sysbuild"
osource "/home/pomo/ncs/zephyr/soc/xlnx/zynq7000/Kconfig.sysbuild"
osource "/home/pomo/ncs/zephyr/soc/xlnx/versalnet/Kconfig.sysbuild"
osource "/home/pomo/ncs/zephyr/soc/xlnx/versal2/Kconfig.sysbuild"
osource "/home/pomo/ncs/zephyr/soc/xlnx/versal/Kconfig.sysbuild"
osource "/home/pomo/ncs/zephyr/soc/xen/Kconfig.sysbuild"
osource "/home/pomo/ncs/zephyr/soc/wch/ch32v/Kconfig.sysbuild"
osource "/home/pomo/ncs/zephyr/soc/ti/simplelink/Kconfig.sysbuild"
osource "/home/pomo/ncs/zephyr/soc/ti/mspm0/Kconfig.sysbuild"
osource "/home/pomo/ncs/zephyr/soc/ti/lm3s6965/Kconfig.sysbuild"
osource "/home/pomo/ncs/zephyr/soc/ti/k3/Kconfig.sysbuild"
osource "/home/pomo/ncs/zephyr/soc/telink/tlsr/Kconfig.sysbuild"
osource "/home/pomo/ncs/zephyr/soc/starfive/jh71xx/Kconfig.sysbuild"
osource "/home/pomo/ncs/zephyr/soc/st/stm32/Kconfig.sysbuild"
osource "/home/pomo/ncs/zephyr/soc/snps/qemu_arc/Kconfig.sysbuild"
osource "/home/pomo/ncs/zephyr/soc/snps/nsim/arc_v/Kconfig.sysbuild"
osource "/home/pomo/ncs/zephyr/soc/snps/nsim/arc_classic/Kconfig.sysbuild"
osource "/home/pomo/ncs/zephyr/soc/snps/hsdk4xd/Kconfig.sysbuild"
osource "/home/pomo/ncs/zephyr/soc/snps/hsdk/Kconfig.sysbuild"
osource "/home/pomo/ncs/zephyr/soc/snps/emsk/Kconfig.sysbuild"
osource "/home/pomo/ncs/zephyr/soc/snps/emsdp/Kconfig.sysbuild"
osource "/home/pomo/ncs/zephyr/soc/snps/arc_iot/Kconfig.sysbuild"
osource "/home/pomo/ncs/zephyr/soc/silabs/Kconfig.sysbuild"
osource "/home/pomo/ncs/zephyr/soc/sifli/sf32/Kconfig.sysbuild"
osource "/home/pomo/ncs/zephyr/soc/sifive/sifive_freedom/Kconfig.sysbuild"
osource "/home/pomo/ncs/zephyr/soc/sensry/Kconfig.sysbuild"
osource "/home/pomo/ncs/zephyr/soc/rockchip/Kconfig.sysbuild"
osource "/home/pomo/ncs/zephyr/soc/renode/riscv_virtual/Kconfig.sysbuild"
osource "/home/pomo/ncs/zephyr/soc/renode/cortex_r8_virtual/Kconfig.sysbuild"
osource "/home/pomo/ncs/zephyr/soc/renesas/smartbond/Kconfig.sysbuild"
osource "/home/pomo/ncs/zephyr/soc/renesas/rz/Kconfig.sysbuild"
osource "/home/pomo/ncs/zephyr/soc/renesas/rx/Kconfig.sysbuild"
osource "/home/pomo/ncs/zephyr/soc/renesas/rcar/Kconfig.sysbuild"
osource "/home/pomo/ncs/zephyr/soc/renesas/ra/Kconfig.sysbuild"
osource "/home/pomo/ncs/zephyr/soc/realtek/ec/Kconfig.sysbuild"
osource "/home/pomo/ncs/zephyr/soc/realtek/ameba/Kconfig.sysbuild"
osource "/home/pomo/ncs/zephyr/soc/raspberrypi/rpi_pico/Kconfig.sysbuild"
osource "/home/pomo/ncs/zephyr/soc/quicklogic/eos_s3/Kconfig.sysbuild"
osource "/home/pomo/ncs/zephyr/soc/qemu/virt_riscv/Kconfig.sysbuild"
osource "/home/pomo/ncs/zephyr/soc/qemu/malta/Kconfig.sysbuild"
osource "/home/pomo/ncs/zephyr/soc/openisa/rv32m1/Kconfig.sysbuild"
osource "/home/pomo/ncs/zephyr/soc/openhwgroup/cva6/Kconfig.sysbuild"
osource "/home/pomo/ncs/zephyr/soc/oct/osd32mp15x/Kconfig.sysbuild"
osource "/home/pomo/ncs/zephyr/soc/nxp/s32/Kconfig.sysbuild"
osource "/home/pomo/ncs/zephyr/soc/nxp/rw/Kconfig.sysbuild"
osource "/home/pomo/ncs/zephyr/soc/nxp/mcx/Kconfig.sysbuild"
osource "/home/pomo/ncs/zephyr/soc/nxp/lpc/Kconfig.sysbuild"
osource "/home/pomo/ncs/zephyr/soc/nxp/layerscape/Kconfig.sysbuild"
osource "/home/pomo/ncs/zephyr/soc/nxp/kinetis/Kconfig.sysbuild"
osource "/home/pomo/ncs/zephyr/soc/nxp/imxrt/Kconfig.sysbuild"
osource "/home/pomo/ncs/zephyr/soc/nxp/imx/Kconfig.sysbuild"
osource "/home/pomo/ncs/zephyr/soc/nuvoton/numicro/Kconfig.sysbuild"
osource "/home/pomo/ncs/zephyr/soc/nuvoton/numaker/Kconfig.sysbuild"
osource "/home/pomo/ncs/zephyr/soc/nuvoton/npcx/Kconfig.sysbuild"
osource "/home/pomo/ncs/zephyr/soc/nuvoton/npcm/Kconfig.sysbuild"
osource "/home/pomo/ncs/zephyr/soc/nordic/Kconfig.sysbuild"
osource "/home/pomo/ncs/zephyr/soc/neorv32/Kconfig.sysbuild"
osource "/home/pomo/ncs/zephyr/soc/native/inf_clock/Kconfig.sysbuild"
osource "/home/pomo/ncs/zephyr/soc/microchip/sam/sama7/Kconfig.sysbuild"
osource "/home/pomo/ncs/zephyr/soc/microchip/sam/sam_d5x_e5x/Kconfig.sysbuild"
osource "/home/pomo/ncs/zephyr/soc/microchip/pic64/Kconfig.sysbuild"
osource "/home/pomo/ncs/zephyr/soc/microchip/pic32c/pic32cz_ca/Kconfig.sysbuild"
osource "/home/pomo/ncs/zephyr/soc/microchip/pic32c/pic32cx_sg/Kconfig.sysbuild"
osource "/home/pomo/ncs/zephyr/soc/microchip/pic32c/pic32cm_jh/Kconfig.sysbuild"
osource "/home/pomo/ncs/zephyr/soc/microchip/miv/Kconfig.sysbuild"
osource "/home/pomo/ncs/zephyr/soc/microchip/mec/Kconfig.sysbuild"
osource "/home/pomo/ncs/zephyr/soc/mediatek/mt8xxx/Kconfig.sysbuild"
osource "/home/pomo/ncs/zephyr/soc/lowrisc/opentitan/Kconfig.sysbuild"
osource "/home/pomo/ncs/zephyr/soc/litex/litex_vexriscv/Kconfig.sysbuild"
osource "/home/pomo/ncs/zephyr/soc/ite/ec/Kconfig.sysbuild"
osource "/home/pomo/ncs/zephyr/soc/intel/wildcat_lake/Kconfig.sysbuild"
osource "/home/pomo/ncs/zephyr/soc/intel/raptor_lake/Kconfig.sysbuild"
osource "/home/pomo/ncs/zephyr/soc/intel/panther_lake/Kconfig.sysbuild"
osource "/home/pomo/ncs/zephyr/soc/intel/lakemont/Kconfig.sysbuild"
osource "/home/pomo/ncs/zephyr/soc/intel/intel_socfpga_std/Kconfig.sysbuild"
osource "/home/pomo/ncs/zephyr/soc/intel/intel_socfpga/Kconfig.sysbuild"
osource "/home/pomo/ncs/zephyr/soc/intel/intel_niosv/Kconfig.sysbuild"
osource "/home/pomo/ncs/zephyr/soc/intel/intel_ish/Kconfig.sysbuild"
osource "/home/pomo/ncs/zephyr/soc/intel/intel_adsp/Kconfig.sysbuild"
osource "/home/pomo/ncs/zephyr/soc/intel/elkhart_lake/Kconfig.sysbuild"
osource "/home/pomo/ncs/zephyr/soc/intel/atom/Kconfig.sysbuild"
osource "/home/pomo/ncs/zephyr/soc/intel/apollo_lake/Kconfig.sysbuild"
osource "/home/pomo/ncs/zephyr/soc/intel/alder_lake/Kconfig.sysbuild"
osource "/home/pomo/ncs/zephyr/soc/infineon/psoc4/Kconfig.sysbuild"
osource "/home/pomo/ncs/zephyr/soc/infineon/edge/Kconfig.sysbuild"
osource "/home/pomo/ncs/zephyr/soc/infineon/cat3/Kconfig.sysbuild"
osource "/home/pomo/ncs/zephyr/soc/infineon/cat1c/Kconfig.sysbuild"
osource "/home/pomo/ncs/zephyr/soc/infineon/cat1b/Kconfig.sysbuild"
osource "/home/pomo/ncs/zephyr/soc/infineon/cat1a/Kconfig.sysbuild"
osource "/home/pomo/ncs/zephyr/soc/gd/gd32/Kconfig.sysbuild"
osource "/home/pomo/ncs/zephyr/soc/gaisler/leon3/Kconfig.sysbuild"
osource "/home/pomo/ncs/zephyr/soc/gaisler/gr716a/Kconfig.sysbuild"
osource "/home/pomo/ncs/zephyr/soc/focaltech/Kconfig.sysbuild"
osource "/home/pomo/ncs/zephyr/soc/espressif/Kconfig.sysbuild"
osource "/home/pomo/ncs/zephyr/soc/ene/kb1200/Kconfig.sysbuild"
osource "/home/pomo/ncs/zephyr/soc/ene/kb106x/Kconfig.sysbuild"
osource "/home/pomo/ncs/zephyr/soc/elan/em32f967/Kconfig.sysbuild"
osource "/home/pomo/ncs/zephyr/soc/egis/Kconfig.sysbuild"
osource "/home/pomo/ncs/zephyr/soc/efinix/sapphire/Kconfig.sysbuild"
osource "/home/pomo/ncs/zephyr/soc/cdns/xtensa_sample_controller/Kconfig.sysbuild"
osource "/home/pomo/ncs/zephyr/soc/cdns/sample_controller32/Kconfig.sysbuild"
osource "/home/pomo/ncs/zephyr/soc/cdns/dc233c/Kconfig.sysbuild"
osource "/home/pomo/ncs/zephyr/soc/brcm/bcmvk/Kconfig.sysbuild"
osource "/home/pomo/ncs/zephyr/soc/brcm/bcm2712/Kconfig.sysbuild"
osource "/home/pomo/ncs/zephyr/soc/brcm/bcm2711/Kconfig.sysbuild"
osource "/home/pomo/ncs/zephyr/soc/blackberry/qnxhv_vm/Kconfig.sysbuild"
osource "/home/pomo/ncs/zephyr/soc/bflb/Kconfig.sysbuild"
osource "/home/pomo/ncs/zephyr/soc/atmel/sam0/Kconfig.sysbuild"
osource "/home/pomo/ncs/zephyr/soc/atmel/sam/Kconfig.sysbuild"
osource "/home/pomo/ncs/zephyr/soc/aspeed/Kconfig.sysbuild"
osource "/home/pomo/ncs/zephyr/soc/arm/Kconfig.sysbuild"
osource "/home/pomo/ncs/zephyr/soc/arm/beetle/Kconfig.sysbuild"
osource "/home/pomo/ncs/zephyr/soc/antmicro/myra/Kconfig.sysbuild"
osource "/home/pomo/ncs/zephyr/soc/andestech/Kconfig.sysbuild"
osource "/home/pomo/ncs/zephyr/soc/amd/acp_6_0/Kconfig.sysbuild"
osource "/home/pomo/ncs/zephyr/soc/ambiq/Kconfig.sysbuild"
osource "/home/pomo/ncs/zephyr/soc/allwinner/sun8i_h3/Kconfig.sysbuild"
osource "/home/pomo/ncs/zephyr/soc/aesc/Kconfig.sysbuild"
osource "/home/pomo/ncs/zephyr/soc/adi/max32/Kconfig.sysbuild"
osource "/home/pomo/ncs/nrf/soc/sercomm/nrf91/Kconfig.sysbuild"
osource "/home/pomo/ncs/nrf/soc/nordic/Kconfig.sysbuild"
```

## STCPv1/LTE/stcp+mqtt-for-nRF9151-zephyr/app/stcp-mqtt-demo/golden/1.4.2026-build/stcp-mqtt-demo/Kconfig/boards/Kconfig.defconfig
```kconfig
# Load Zephyr board defconfig descriptions.
osource "/home/pomo/ncs/zephyr/boards/nordic/nrf9151dk/Kconfig.defconfig"
```

## STCPv2/kernel-module/stcp-module/Kconfig
```kconfig
menuconfig STCP
    bool "STCP2 socket offload"
    depends on NET_SOCKETS
    select NET_SOCKETS_OFFLOAD
    default n

if STCP
config STCP_SOCKET_PRIORITY
    int "Socket provider priority"
    default 20
config STCP_MAX_SOCKETS
    int "Maximum STCP sockets"
    default 16
    range 2 64
config STCP_CONNECT_TIMEOUT_MS
    int "Carrier connect timeout"
    default 60000
    range 1000 300000
config STCP_LOG_LEVEL
    int "STCP log level"
    default 3
    range 0 4
endif
```

## STCPv2/zephyr/nordic-3.4.0/POIS/stcp-module/Kconfig
```kconfig
menuconfig STCP
    bool "STCP socket offload (C carrier port)"
    depends on NET_SOCKETS
    select NET_SOCKETS_OFFLOAD
    default n

if STCP

config STCP_SOCKET_PRIORITY
    int "Socket provider priority"
    default 20

config STCP_MAX_SOCKETS
    int "Maximum STCP sockets"
    default 16
    range 2 64

config STCP_IO_TIMEOUT_MS
    int "Blocking carrier I/O timeout (milliseconds)"
    default 5000
    range 1 60000

config STCP_CONNECT_TIMEOUT_MS
    int "Carrier connect timeout (milliseconds)"
    default 60000
    range 1000 300000

config STCP_LOG_LEVEL
    int "STCP log level"
    default 3
    range 0 4

endif

config STCP_LTE
    bool "STCP nRF91 LTE transport initialization"
    depends on STCP
    depends on NRF_MODEM_LIB
    depends on LTE_LINK_CONTROL
    default y if SOC_NRF9151_LACA
    help
      Reuse the event-driven LTE, PDN and IP readiness logic from STCPv1.

config STCP_LTE_READY_TIMEOUT_SECONDS
    int "LTE/PDN/IP readiness timeout"
    depends on STCP_LTE
    default 300
    range 10 1800
```
