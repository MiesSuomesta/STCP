## STCPv2/zephyr/nordic-3.4.0/build-hello/Kconfig/soc/Kconfig
```kconfig
# Load Zephyr SoC Kconfig descriptions.
osource "/home/pomo/git/STCP/STCPv2/zephyr/nordic/zephyr/soc/xlnx/zynqmp/Kconfig"
osource "/home/pomo/git/STCP/STCPv2/zephyr/nordic/zephyr/soc/xlnx/zynq7000/Kconfig"
osource "/home/pomo/git/STCP/STCPv2/zephyr/nordic/zephyr/soc/xlnx/versalnet/Kconfig"
osource "/home/pomo/git/STCP/STCPv2/zephyr/nordic/zephyr/soc/xlnx/versal2/Kconfig"
osource "/home/pomo/git/STCP/STCPv2/zephyr/nordic/zephyr/soc/xlnx/versal/Kconfig"
osource "/home/pomo/git/STCP/STCPv2/zephyr/nordic/zephyr/soc/xen/Kconfig"
osource "/home/pomo/git/STCP/STCPv2/zephyr/nordic/zephyr/soc/wch/ch32v/Kconfig"
osource "/home/pomo/git/STCP/STCPv2/zephyr/nordic/zephyr/soc/ti/simplelink/Kconfig"
osource "/home/pomo/git/STCP/STCPv2/zephyr/nordic/zephyr/soc/ti/mspm0/Kconfig"
osource "/home/pomo/git/STCP/STCPv2/zephyr/nordic/zephyr/soc/ti/lm3s6965/Kconfig"
osource "/home/pomo/git/STCP/STCPv2/zephyr/nordic/zephyr/soc/ti/k3/Kconfig"
osource "/home/pomo/git/STCP/STCPv2/zephyr/nordic/zephyr/soc/telink/tlsr/Kconfig"
osource "/home/pomo/git/STCP/STCPv2/zephyr/nordic/zephyr/soc/syna/sr100/Kconfig"
osource "/home/pomo/git/STCP/STCPv2/zephyr/nordic/zephyr/soc/starfive/jh71xx/Kconfig"
osource "/home/pomo/git/STCP/STCPv2/zephyr/nordic/zephyr/soc/st/stm32/Kconfig"
osource "/home/pomo/git/STCP/STCPv2/zephyr/nordic/zephyr/soc/snps/qemu_arc/Kconfig"
osource "/home/pomo/git/STCP/STCPv2/zephyr/nordic/zephyr/soc/snps/nsim/arc_v/Kconfig"
osource "/home/pomo/git/STCP/STCPv2/zephyr/nordic/zephyr/soc/snps/nsim/arc_classic/Kconfig"
osource "/home/pomo/git/STCP/STCPv2/zephyr/nordic/zephyr/soc/snps/hsdk4xd/Kconfig"
osource "/home/pomo/git/STCP/STCPv2/zephyr/nordic/zephyr/soc/snps/hsdk/Kconfig"
osource "/home/pomo/git/STCP/STCPv2/zephyr/nordic/zephyr/soc/snps/emsk/Kconfig"
osource "/home/pomo/git/STCP/STCPv2/zephyr/nordic/zephyr/soc/snps/emsdp/Kconfig"
osource "/home/pomo/git/STCP/STCPv2/zephyr/nordic/zephyr/soc/snps/arc_iot/Kconfig"
osource "/home/pomo/git/STCP/STCPv2/zephyr/nordic/zephyr/soc/silabs/Kconfig"
osource "/home/pomo/git/STCP/STCPv2/zephyr/nordic/zephyr/soc/sifli/sf32/Kconfig"
osource "/home/pomo/git/STCP/STCPv2/zephyr/nordic/zephyr/soc/sifive/sifive_freedom/Kconfig"
osource "/home/pomo/git/STCP/STCPv2/zephyr/nordic/zephyr/soc/sensry/Kconfig"
osource "/home/pomo/git/STCP/STCPv2/zephyr/nordic/zephyr/soc/rockchip/Kconfig"
osource "/home/pomo/git/STCP/STCPv2/zephyr/nordic/zephyr/soc/renode/riscv_virtual/Kconfig"
osource "/home/pomo/git/STCP/STCPv2/zephyr/nordic/zephyr/soc/renode/cortex_r8_virtual/Kconfig"
osource "/home/pomo/git/STCP/STCPv2/zephyr/nordic/zephyr/soc/renesas/smartbond/Kconfig"
osource "/home/pomo/git/STCP/STCPv2/zephyr/nordic/zephyr/soc/renesas/rz/Kconfig"
osource "/home/pomo/git/STCP/STCPv2/zephyr/nordic/zephyr/soc/renesas/rx/Kconfig"
osource "/home/pomo/git/STCP/STCPv2/zephyr/nordic/zephyr/soc/renesas/rcar/Kconfig"
osource "/home/pomo/git/STCP/STCPv2/zephyr/nordic/zephyr/soc/renesas/ra/Kconfig"
osource "/home/pomo/git/STCP/STCPv2/zephyr/nordic/zephyr/soc/realtek/fingerprint/Kconfig"
osource "/home/pomo/git/STCP/STCPv2/zephyr/nordic/zephyr/soc/realtek/ec/Kconfig"
osource "/home/pomo/git/STCP/STCPv2/zephyr/nordic/zephyr/soc/realtek/bee/Kconfig"
osource "/home/pomo/git/STCP/STCPv2/zephyr/nordic/zephyr/soc/realtek/ameba/Kconfig"
osource "/home/pomo/git/STCP/STCPv2/zephyr/nordic/zephyr/soc/raspberrypi/rpi_pico/Kconfig"
osource "/home/pomo/git/STCP/STCPv2/zephyr/nordic/zephyr/soc/quicklogic/eos_s3/Kconfig"
osource "/home/pomo/git/STCP/STCPv2/zephyr/nordic/zephyr/soc/qemu/virt_riscv/Kconfig"
osource "/home/pomo/git/STCP/STCPv2/zephyr/nordic/zephyr/soc/qemu/or1k/Kconfig"
osource "/home/pomo/git/STCP/STCPv2/zephyr/nordic/zephyr/soc/qemu/malta/Kconfig"
osource "/home/pomo/git/STCP/STCPv2/zephyr/nordic/zephyr/soc/openisa/rv32m1/Kconfig"
osource "/home/pomo/git/STCP/STCPv2/zephyr/nordic/zephyr/soc/openhwgroup/cva6/Kconfig"
osource "/home/pomo/git/STCP/STCPv2/zephyr/nordic/zephyr/soc/oct/osd32mp15x/Kconfig"
osource "/home/pomo/git/STCP/STCPv2/zephyr/nordic/zephyr/soc/nxp/s32/Kconfig"
osource "/home/pomo/git/STCP/STCPv2/zephyr/nordic/zephyr/soc/nxp/rw/Kconfig"
osource "/home/pomo/git/STCP/STCPv2/zephyr/nordic/zephyr/soc/nxp/mcx/Kconfig"
osource "/home/pomo/git/STCP/STCPv2/zephyr/nordic/zephyr/soc/nxp/lpc/Kconfig"
osource "/home/pomo/git/STCP/STCPv2/zephyr/nordic/zephyr/soc/nxp/layerscape/Kconfig"
osource "/home/pomo/git/STCP/STCPv2/zephyr/nordic/zephyr/soc/nxp/kinetis/Kconfig"
osource "/home/pomo/git/STCP/STCPv2/zephyr/nordic/zephyr/soc/nxp/imxrt/Kconfig"
osource "/home/pomo/git/STCP/STCPv2/zephyr/nordic/zephyr/soc/nxp/imx/Kconfig"
osource "/home/pomo/git/STCP/STCPv2/zephyr/nordic/zephyr/soc/nuvoton/numicro/Kconfig"
osource "/home/pomo/git/STCP/STCPv2/zephyr/nordic/zephyr/soc/nuvoton/numaker/Kconfig"
osource "/home/pomo/git/STCP/STCPv2/zephyr/nordic/zephyr/soc/nuvoton/npcx/Kconfig"
osource "/home/pomo/git/STCP/STCPv2/zephyr/nordic/zephyr/soc/nuvoton/npcm/Kconfig"
osource "/home/pomo/git/STCP/STCPv2/zephyr/nordic/zephyr/soc/nordic/Kconfig"
osource "/home/pomo/git/STCP/STCPv2/zephyr/nordic/zephyr/soc/neorv32/Kconfig"
osource "/home/pomo/git/STCP/STCPv2/zephyr/nordic/zephyr/soc/native/inf_clock/Kconfig"
osource "/home/pomo/git/STCP/STCPv2/zephyr/nordic/zephyr/soc/microchip/sam/sama7/Kconfig"
osource "/home/pomo/git/STCP/STCPv2/zephyr/nordic/zephyr/soc/microchip/sam/sam_d5x_e5x/Kconfig"
osource "/home/pomo/git/STCP/STCPv2/zephyr/nordic/zephyr/soc/microchip/pic64/Kconfig"
osource "/home/pomo/git/STCP/STCPv2/zephyr/nordic/zephyr/soc/microchip/pic32c/pic32cz_ca/Kconfig"
osource "/home/pomo/git/STCP/STCPv2/zephyr/nordic/zephyr/soc/microchip/pic32c/pic32cx_sg/Kconfig"
osource "/home/pomo/git/STCP/STCPv2/zephyr/nordic/zephyr/soc/microchip/pic32c/pic32cm_pl/Kconfig"
osource "/home/pomo/git/STCP/STCPv2/zephyr/nordic/zephyr/soc/microchip/pic32c/pic32cm_jh/Kconfig"
osource "/home/pomo/git/STCP/STCPv2/zephyr/nordic/zephyr/soc/microchip/miv/Kconfig"
osource "/home/pomo/git/STCP/STCPv2/zephyr/nordic/zephyr/soc/microchip/mec/Kconfig"
osource "/home/pomo/git/STCP/STCPv2/zephyr/nordic/zephyr/soc/mediatek/mt8xxx/Kconfig"
osource "/home/pomo/git/STCP/STCPv2/zephyr/nordic/zephyr/soc/lowrisc/opentitan/Kconfig"
osource "/home/pomo/git/STCP/STCPv2/zephyr/nordic/zephyr/soc/litex/litex_vexriscv/Kconfig"
osource "/home/pomo/git/STCP/STCPv2/zephyr/nordic/zephyr/soc/ite/ec/Kconfig"
osource "/home/pomo/git/STCP/STCPv2/zephyr/nordic/zephyr/soc/intel/wildcat_lake/Kconfig"
osource "/home/pomo/git/STCP/STCPv2/zephyr/nordic/zephyr/soc/intel/raptor_lake/Kconfig"
osource "/home/pomo/git/STCP/STCPv2/zephyr/nordic/zephyr/soc/intel/panther_lake/Kconfig"
osource "/home/pomo/git/STCP/STCPv2/zephyr/nordic/zephyr/soc/intel/lakemont/Kconfig"
osource "/home/pomo/git/STCP/STCPv2/zephyr/nordic/zephyr/soc/intel/intel_socfpga_std/Kconfig"
osource "/home/pomo/git/STCP/STCPv2/zephyr/nordic/zephyr/soc/intel/intel_socfpga/Kconfig"
osource "/home/pomo/git/STCP/STCPv2/zephyr/nordic/zephyr/soc/intel/intel_niosv/Kconfig"
osource "/home/pomo/git/STCP/STCPv2/zephyr/nordic/zephyr/soc/intel/intel_ish/Kconfig"
osource "/home/pomo/git/STCP/STCPv2/zephyr/nordic/zephyr/soc/intel/intel_adsp/Kconfig"
osource "/home/pomo/git/STCP/STCPv2/zephyr/nordic/zephyr/soc/intel/elkhart_lake/Kconfig"
osource "/home/pomo/git/STCP/STCPv2/zephyr/nordic/zephyr/soc/intel/atom/Kconfig"
osource "/home/pomo/git/STCP/STCPv2/zephyr/nordic/zephyr/soc/intel/apollo_lake/Kconfig"
osource "/home/pomo/git/STCP/STCPv2/zephyr/nordic/zephyr/soc/intel/alder_lake/Kconfig"
osource "/home/pomo/git/STCP/STCPv2/zephyr/nordic/zephyr/soc/infineon/psoc4/Kconfig"
osource "/home/pomo/git/STCP/STCPv2/zephyr/nordic/zephyr/soc/infineon/edge/Kconfig"
osource "/home/pomo/git/STCP/STCPv2/zephyr/nordic/zephyr/soc/infineon/cat3/Kconfig"
osource "/home/pomo/git/STCP/STCPv2/zephyr/nordic/zephyr/soc/infineon/cat1c/Kconfig"
osource "/home/pomo/git/STCP/STCPv2/zephyr/nordic/zephyr/soc/infineon/cat1b/Kconfig"
osource "/home/pomo/git/STCP/STCPv2/zephyr/nordic/zephyr/soc/infineon/cat1a/Kconfig"
osource "/home/pomo/git/STCP/STCPv2/zephyr/nordic/zephyr/soc/gd/gd32/Kconfig"
osource "/home/pomo/git/STCP/STCPv2/zephyr/nordic/zephyr/soc/gaisler/leon3/Kconfig"
osource "/home/pomo/git/STCP/STCPv2/zephyr/nordic/zephyr/soc/gaisler/gr716a/Kconfig"
osource "/home/pomo/git/STCP/STCPv2/zephyr/nordic/zephyr/soc/focaltech/Kconfig"
osource "/home/pomo/git/STCP/STCPv2/zephyr/nordic/zephyr/soc/espressif/Kconfig"
osource "/home/pomo/git/STCP/STCPv2/zephyr/nordic/zephyr/soc/ene/kb1200/Kconfig"
osource "/home/pomo/git/STCP/STCPv2/zephyr/nordic/zephyr/soc/ene/kb106x/Kconfig"
osource "/home/pomo/git/STCP/STCPv2/zephyr/nordic/zephyr/soc/elan/em32f967/Kconfig"
osource "/home/pomo/git/STCP/STCPv2/zephyr/nordic/zephyr/soc/egis/Kconfig"
osource "/home/pomo/git/STCP/STCPv2/zephyr/nordic/zephyr/soc/efinix/sapphire/Kconfig"
osource "/home/pomo/git/STCP/STCPv2/zephyr/nordic/zephyr/soc/cdns/xtensa_sample_controller/Kconfig"
osource "/home/pomo/git/STCP/STCPv2/zephyr/nordic/zephyr/soc/cdns/swerv/Kconfig"
osource "/home/pomo/git/STCP/STCPv2/zephyr/nordic/zephyr/soc/cdns/sample_controller32/Kconfig"
osource "/home/pomo/git/STCP/STCPv2/zephyr/nordic/zephyr/soc/cdns/dc233c/Kconfig"
osource "/home/pomo/git/STCP/STCPv2/zephyr/nordic/zephyr/soc/brcm/bcmvk/Kconfig"
osource "/home/pomo/git/STCP/STCPv2/zephyr/nordic/zephyr/soc/brcm/bcm2712/Kconfig"
osource "/home/pomo/git/STCP/STCPv2/zephyr/nordic/zephyr/soc/brcm/bcm2711/Kconfig"
osource "/home/pomo/git/STCP/STCPv2/zephyr/nordic/zephyr/soc/blackberry/qnxhv_vm/Kconfig"
osource "/home/pomo/git/STCP/STCPv2/zephyr/nordic/zephyr/soc/bflb/Kconfig"
osource "/home/pomo/git/STCP/STCPv2/zephyr/nordic/zephyr/soc/atmel/sam0/Kconfig"
osource "/home/pomo/git/STCP/STCPv2/zephyr/nordic/zephyr/soc/atmel/sam/Kconfig"
osource "/home/pomo/git/STCP/STCPv2/zephyr/nordic/zephyr/soc/aspeed/Kconfig"
osource "/home/pomo/git/STCP/STCPv2/zephyr/nordic/zephyr/soc/arm/Kconfig"
osource "/home/pomo/git/STCP/STCPv2/zephyr/nordic/zephyr/soc/arm/beetle/Kconfig"
osource "/home/pomo/git/STCP/STCPv2/zephyr/nordic/zephyr/soc/antmicro/myra/Kconfig"
osource "/home/pomo/git/STCP/STCPv2/zephyr/nordic/zephyr/soc/andestech/Kconfig"
osource "/home/pomo/git/STCP/STCPv2/zephyr/nordic/zephyr/soc/amd/acp_6_0/Kconfig"
osource "/home/pomo/git/STCP/STCPv2/zephyr/nordic/zephyr/soc/ambiq/Kconfig"
osource "/home/pomo/git/STCP/STCPv2/zephyr/nordic/zephyr/soc/allwinner/sun8i_h3/Kconfig"
osource "/home/pomo/git/STCP/STCPv2/zephyr/nordic/zephyr/soc/alif/ensemble/Kconfig"
osource "/home/pomo/git/STCP/STCPv2/zephyr/nordic/zephyr/soc/aesc/Kconfig"
osource "/home/pomo/git/STCP/STCPv2/zephyr/nordic/zephyr/soc/adi/max32/Kconfig"
osource "/home/pomo/git/STCP/STCPv2/zephyr/nordic/nrf/soc/sercomm/nrf91/Kconfig"
osource "/home/pomo/git/STCP/STCPv2/zephyr/nordic/nrf/soc/nordic/Kconfig"
```

## STCPv2/zephyr/nordic-3.4.0/stcp-mqtt/build-nrf9151/Kconfig/Kconfig.shield.defconfig
```kconfig
osource "/home/pomo/git/STCP/STCPv2/zephyr/nordic/nrf/boards/shields/*/Kconfig.defconfig"
```

## STCPv2/zephyr/nordic-3.4.0/stcp-mqtt/build-nrf9151/stcp-mqtt/Kconfig/arch/Kconfig.tmp
```kconfig
# Load Zephyr Arch Kconfig descriptions.
osource "/home/pomo/git/STCP/STCPv2/zephyr/nordic/zephyr/arch/rx/Kconfig"
osource "/home/pomo/git/STCP/STCPv2/zephyr/nordic/zephyr/arch/x86/Kconfig"
osource "/home/pomo/git/STCP/STCPv2/zephyr/nordic/zephyr/arch/xtensa/Kconfig"
osource "/home/pomo/git/STCP/STCPv2/zephyr/nordic/zephyr/arch/sparc/Kconfig"
osource "/home/pomo/git/STCP/STCPv2/zephyr/nordic/zephyr/arch/riscv/Kconfig"
osource "/home/pomo/git/STCP/STCPv2/zephyr/nordic/zephyr/arch/posix/Kconfig"
osource "/home/pomo/git/STCP/STCPv2/zephyr/nordic/zephyr/arch/openrisc/Kconfig"
osource "/home/pomo/git/STCP/STCPv2/zephyr/nordic/zephyr/arch/mips/Kconfig"
osource "/home/pomo/git/STCP/STCPv2/zephyr/nordic/zephyr/arch/arm64/Kconfig"
osource "/home/pomo/git/STCP/STCPv2/zephyr/nordic/zephyr/arch/arm/Kconfig"
osource "/home/pomo/git/STCP/STCPv2/zephyr/nordic/zephyr/arch/arc/Kconfig"
```

## STCPv2/zephyr/nordic-3.4.0/stcp-mqtt/build-nrf9151/stcp-mqtt/Kconfig/boards/Kconfig.defconfig
```kconfig
# Load Zephyr board defconfig descriptions.
osource "/home/pomo/git/STCP/STCPv2/zephyr/nordic/zephyr/boards/nordic/nrf9151dk/Kconfig.defconfig"
```

## STCPv2/zephyr/nordic-3.4.0/stcp-mqtt/build-nrf9151/stcp-mqtt/Kconfig/boards/Kconfig.tmp
```kconfig
# Load Zephyr board Kconfig descriptions.
osource "/home/pomo/git/STCP/STCPv2/zephyr/nordic/zephyr/boards/nordic/nrf9151dk/Kconfig"
```
