## prj.conf
```kconfig
CONFIG_NETWORKING=y
CONFIG_NET_SOCKETS=y
CONFIG_NET_SOCKETS_OFFLOAD=y
CONFIG_STCP=y
CONFIG_LOG=y
CONFIG_LOG_DEFAULT_LEVEL=3
CONFIG_MAIN_STACK_SIZE=8192
CONFIG_HEAP_MEM_POOL_SIZE=32768
CONFIG_POSIX_API=y
CONFIG_DNS_RESOLVER=y
```

## nrf9151.conf
```kconfig
CONFIG_NRF_MODEM_LIB=y
CONFIG_NRF_MODEM_LIB_SYS_INIT=y
CONFIG_LTE_LINK_CONTROL=y
```

## src/main.c
```c
#include <zephyr/kernel.h>
#include <zephyr/logging/log.h>
#include <modem/lte_lc.h>
LOG_MODULE_REGISTER(main,3);
int mqtt_proxy_run(void);
int main(void){LOG_INF("STCP2 MQTT proxy starting");int rc=lte_lc_connect();if(rc){LOG_ERR("LTE connect failed: %d",rc);return 0;}LOG_INF("LTE ready");return mqtt_proxy_run();}
```
