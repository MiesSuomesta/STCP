## STCPv2/zephyr/nordic-3.4.0/build-hello-uart2/Kconfig/soc/Kconfig.soc.tmp
```kconfig
# Load SoC Kconfig descriptions.
osource "/home/pomo/git/STCP/STCPv2/zephyr/nordic/zephyr/soc/xlnx/zynqmp/Kconfig.soc"
osource "/home/pomo/git/STCP/STCPv2/zephyr/nordic/zephyr/soc/xlnx/zynq7000/Kconfig.soc"
osource "/home/pomo/git/STCP/STCPv2/zephyr/nordic/zephyr/soc/xlnx/versalnet/Kconfig.soc"
osource "/home/pomo/git/STCP/STCPv2/zephyr/nordic/zephyr/soc/xlnx/versal2/Kconfig.soc"
osource "/home/pomo/git/STCP/STCPv2/zephyr/nordic/zephyr/soc/xlnx/versal/Kconfig.soc"
osource "/home/pomo/git/STCP/STCPv2/zephyr/nordic/zephyr/soc/xen/Kconfig.soc"
osource "/home/pomo/git/STCP/STCPv2/zephyr/nordic/zephyr/soc/wch/ch32v/Kconfig.soc"
osource "/home/pomo/git/STCP/STCPv2/zephyr/nordic/zephyr/soc/ti/simplelink/Kconfig.soc"
osource "/home/pomo/git/STCP/STCPv2/zephyr/nordic/zephyr/soc/ti/mspm0/Kconfig.soc"
osource "/home/pomo/git/STCP/STCPv2/zephyr/nordic/zephyr/soc/ti/lm3s6965/Kconfig.soc"
osource "/home/pomo/git/STCP/STCPv2/zephyr/nordic/zephyr/soc/ti/k3/Kconfig.soc"
osource "/home/pomo/git/STCP/STCPv2/zephyr/nordic/zephyr/soc/telink/tlsr/Kconfig.soc"
osource "/home/pomo/git/STCP/STCPv2/zephyr/nordic/zephyr/soc/syna/sr100/Kconfig.soc"
osource "/home/pomo/git/STCP/STCPv2/zephyr/nordic/zephyr/soc/starfive/jh71xx/Kconfig.soc"
osource "/home/pomo/git/STCP/STCPv2/zephyr/nordic/zephyr/soc/st/stm32/Kconfig.soc"
osource "/home/pomo/git/STCP/STCPv2/zephyr/nordic/zephyr/soc/snps/qemu_arc/Kconfig.soc"
osource "/home/pomo/git/STCP/STCPv2/zephyr/nordic/zephyr/soc/snps/nsim/arc_v/Kconfig.soc"
osource "/home/pomo/git/STCP/STCPv2/zephyr/nordic/zephyr/soc/snps/nsim/arc_classic/Kconfig.soc"
osource "/home/pomo/git/STCP/STCPv2/zephyr/nordic/zephyr/soc/snps/hsdk4xd/Kconfig.soc"
osource "/home/pomo/git/STCP/STCPv2/zephyr/nordic/zephyr/soc/snps/hsdk/Kconfig.soc"
osource "/home/pomo/git/STCP/STCPv2/zephyr/nordic/zephyr/soc/snps/emsk/Kconfig.soc"
osource "/home/pomo/git/STCP/STCPv2/zephyr/nordic/zephyr/soc/snps/emsdp/Kconfig.soc"
osource "/home/pomo/git/STCP/STCPv2/zephyr/nordic/zephyr/soc/snps/arc_iot/Kconfig.soc"
osource "/home/pomo/git/STCP/STCPv2/zephyr/nordic/zephyr/soc/silabs/Kconfig.soc"
osource "/home/pomo/git/STCP/STCPv2/zephyr/nordic/zephyr/soc/sifli/sf32/Kconfig.soc"
osource "/home/pomo/git/STCP/STCPv2/zephyr/nordic/zephyr/soc/sifive/sifive_freedom/Kconfig.soc"
osource "/home/pomo/git/STCP/STCPv2/zephyr/nordic/zephyr/soc/sensry/Kconfig.soc"
osource "/home/pomo/git/STCP/STCPv2/zephyr/nordic/zephyr/soc/rockchip/Kconfig.soc"
osource "/home/pomo/git/STCP/STCPv2/zephyr/nordic/zephyr/soc/renode/riscv_virtual/Kconfig.soc"
osource "/home/pomo/git/STCP/STCPv2/zephyr/nordic/zephyr/soc/renode/cortex_r8_virtual/Kconfig.soc"
osource "/home/pomo/git/STCP/STCPv2/zephyr/nordic/zephyr/soc/renesas/smartbond/Kconfig.soc"
osource "/home/pomo/git/STCP/STCPv2/zephyr/nordic/zephyr/soc/renesas/rz/Kconfig.soc"
osource "/home/pomo/git/STCP/STCPv2/zephyr/nordic/zephyr/soc/renesas/rx/Kconfig.soc"
osource "/home/pomo/git/STCP/STCPv2/zephyr/nordic/zephyr/soc/renesas/rcar/Kconfig.soc"
osource "/home/pomo/git/STCP/STCPv2/zephyr/nordic/zephyr/soc/renesas/ra/Kconfig.soc"
osource "/home/pomo/git/STCP/STCPv2/zephyr/nordic/zephyr/soc/realtek/fingerprint/Kconfig.soc"
osource "/home/pomo/git/STCP/STCPv2/zephyr/nordic/zephyr/soc/realtek/ec/Kconfig.soc"
osource "/home/pomo/git/STCP/STCPv2/zephyr/nordic/zephyr/soc/realtek/bee/Kconfig.soc"
osource "/home/pomo/git/STCP/STCPv2/zephyr/nordic/zephyr/soc/realtek/ameba/Kconfig.soc"
osource "/home/pomo/git/STCP/STCPv2/zephyr/nordic/zephyr/soc/raspberrypi/rpi_pico/Kconfig.soc"
osource "/home/pomo/git/STCP/STCPv2/zephyr/nordic/zephyr/soc/quicklogic/eos_s3/Kconfig.soc"
osource "/home/pomo/git/STCP/STCPv2/zephyr/nordic/zephyr/soc/qemu/virt_riscv/Kconfig.soc"
osource "/home/pomo/git/STCP/STCPv2/zephyr/nordic/zephyr/soc/qemu/or1k/Kconfig.soc"
osource "/home/pomo/git/STCP/STCPv2/zephyr/nordic/zephyr/soc/qemu/malta/Kconfig.soc"
osource "/home/pomo/git/STCP/STCPv2/zephyr/nordic/zephyr/soc/openisa/rv32m1/Kconfig.soc"
osource "/home/pomo/git/STCP/STCPv2/zephyr/nordic/zephyr/soc/openhwgroup/cva6/Kconfig.soc"
osource "/home/pomo/git/STCP/STCPv2/zephyr/nordic/zephyr/soc/oct/osd32mp15x/Kconfig.soc"
osource "/home/pomo/git/STCP/STCPv2/zephyr/nordic/zephyr/soc/nxp/s32/Kconfig.soc"
osource "/home/pomo/git/STCP/STCPv2/zephyr/nordic/zephyr/soc/nxp/rw/Kconfig.soc"
osource "/home/pomo/git/STCP/STCPv2/zephyr/nordic/zephyr/soc/nxp/mcx/Kconfig.soc"
osource "/home/pomo/git/STCP/STCPv2/zephyr/nordic/zephyr/soc/nxp/lpc/Kconfig.soc"
osource "/home/pomo/git/STCP/STCPv2/zephyr/nordic/zephyr/soc/nxp/layerscape/Kconfig.soc"
osource "/home/pomo/git/STCP/STCPv2/zephyr/nordic/zephyr/soc/nxp/kinetis/Kconfig.soc"
osource "/home/pomo/git/STCP/STCPv2/zephyr/nordic/zephyr/soc/nxp/imxrt/Kconfig.soc"
osource "/home/pomo/git/STCP/STCPv2/zephyr/nordic/zephyr/soc/nxp/imx/Kconfig.soc"
osource "/home/pomo/git/STCP/STCPv2/zephyr/nordic/zephyr/soc/nuvoton/numicro/Kconfig.soc"
osource "/home/pomo/git/STCP/STCPv2/zephyr/nordic/zephyr/soc/nuvoton/numaker/Kconfig.soc"
osource "/home/pomo/git/STCP/STCPv2/zephyr/nordic/zephyr/soc/nuvoton/npcx/Kconfig.soc"
osource "/home/pomo/git/STCP/STCPv2/zephyr/nordic/zephyr/soc/nuvoton/npcm/Kconfig.soc"
osource "/home/pomo/git/STCP/STCPv2/zephyr/nordic/zephyr/soc/nordic/Kconfig.soc"
osource "/home/pomo/git/STCP/STCPv2/zephyr/nordic/zephyr/soc/neorv32/Kconfig.soc"
osource "/home/pomo/git/STCP/STCPv2/zephyr/nordic/zephyr/soc/native/inf_clock/Kconfig.soc"
osource "/home/pomo/git/STCP/STCPv2/zephyr/nordic/zephyr/soc/microchip/sam/sama7/Kconfig.soc"
osource "/home/pomo/git/STCP/STCPv2/zephyr/nordic/zephyr/soc/microchip/sam/sam_d5x_e5x/Kconfig.soc"
osource "/home/pomo/git/STCP/STCPv2/zephyr/nordic/zephyr/soc/microchip/pic64/Kconfig.soc"
osource "/home/pomo/git/STCP/STCPv2/zephyr/nordic/zephyr/soc/microchip/pic32c/pic32cz_ca/Kconfig.soc"
osource "/home/pomo/git/STCP/STCPv2/zephyr/nordic/zephyr/soc/microchip/pic32c/pic32cx_sg/Kconfig.soc"
osource "/home/pomo/git/STCP/STCPv2/zephyr/nordic/zephyr/soc/microchip/pic32c/pic32cm_pl/Kconfig.soc"
osource "/home/pomo/git/STCP/STCPv2/zephyr/nordic/zephyr/soc/microchip/pic32c/pic32cm_jh/Kconfig.soc"
osource "/home/pomo/git/STCP/STCPv2/zephyr/nordic/zephyr/soc/microchip/miv/Kconfig.soc"
osource "/home/pomo/git/STCP/STCPv2/zephyr/nordic/zephyr/soc/microchip/mec/Kconfig.soc"
osource "/home/pomo/git/STCP/STCPv2/zephyr/nordic/zephyr/soc/mediatek/mt8xxx/Kconfig.soc"
osource "/home/pomo/git/STCP/STCPv2/zephyr/nordic/zephyr/soc/lowrisc/opentitan/Kconfig.soc"
osource "/home/pomo/git/STCP/STCPv2/zephyr/nordic/zephyr/soc/litex/litex_vexriscv/Kconfig.soc"
osource "/home/pomo/git/STCP/STCPv2/zephyr/nordic/zephyr/soc/ite/ec/Kconfig.soc"
osource "/home/pomo/git/STCP/STCPv2/zephyr/nordic/zephyr/soc/intel/wildcat_lake/Kconfig.soc"
osource "/home/pomo/git/STCP/STCPv2/zephyr/nordic/zephyr/soc/intel/raptor_lake/Kconfig.soc"
osource "/home/pomo/git/STCP/STCPv2/zephyr/nordic/zephyr/soc/intel/panther_lake/Kconfig.soc"
osource "/home/pomo/git/STCP/STCPv2/zephyr/nordic/zephyr/soc/intel/lakemont/Kconfig.soc"
osource "/home/pomo/git/STCP/STCPv2/zephyr/nordic/zephyr/soc/intel/intel_socfpga_std/Kconfig.soc"
osource "/home/pomo/git/STCP/STCPv2/zephyr/nordic/zephyr/soc/intel/intel_socfpga/Kconfig.soc"
osource "/home/pomo/git/STCP/STCPv2/zephyr/nordic/zephyr/soc/intel/intel_niosv/Kconfig.soc"
osource "/home/pomo/git/STCP/STCPv2/zephyr/nordic/zephyr/soc/intel/intel_ish/Kconfig.soc"
osource "/home/pomo/git/STCP/STCPv2/zephyr/nordic/zephyr/soc/intel/intel_adsp/Kconfig.soc"
osource "/home/pomo/git/STCP/STCPv2/zephyr/nordic/zephyr/soc/intel/elkhart_lake/Kconfig.soc"
osource "/home/pomo/git/STCP/STCPv2/zephyr/nordic/zephyr/soc/intel/atom/Kconfig.soc"
osource "/home/pomo/git/STCP/STCPv2/zephyr/nordic/zephyr/soc/intel/apollo_lake/Kconfig.soc"
osource "/home/pomo/git/STCP/STCPv2/zephyr/nordic/zephyr/soc/intel/alder_lake/Kconfig.soc"
osource "/home/pomo/git/STCP/STCPv2/zephyr/nordic/zephyr/soc/infineon/psoc4/Kconfig.soc"
osource "/home/pomo/git/STCP/STCPv2/zephyr/nordic/zephyr/soc/infineon/edge/Kconfig.soc"
osource "/home/pomo/git/STCP/STCPv2/zephyr/nordic/zephyr/soc/infineon/cat3/Kconfig.soc"
osource "/home/pomo/git/STCP/STCPv2/zephyr/nordic/zephyr/soc/infineon/cat1c/Kconfig.soc"
osource "/home/pomo/git/STCP/STCPv2/zephyr/nordic/zephyr/soc/infineon/cat1b/Kconfig.soc"
osource "/home/pomo/git/STCP/STCPv2/zephyr/nordic/zephyr/soc/infineon/cat1a/Kconfig.soc"
osource "/home/pomo/git/STCP/STCPv2/zephyr/nordic/zephyr/soc/gd/gd32/Kconfig.soc"
osource "/home/pomo/git/STCP/STCPv2/zephyr/nordic/zephyr/soc/gaisler/leon3/Kconfig.soc"
osource "/home/pomo/git/STCP/STCPv2/zephyr/nordic/zephyr/soc/gaisler/gr716a/Kconfig.soc"
osource "/home/pomo/git/STCP/STCPv2/zephyr/nordic/zephyr/soc/focaltech/Kconfig.soc"
osource "/home/pomo/git/STCP/STCPv2/zephyr/nordic/zephyr/soc/espressif/Kconfig.soc"
osource "/home/pomo/git/STCP/STCPv2/zephyr/nordic/zephyr/soc/ene/kb1200/Kconfig.soc"
osource "/home/pomo/git/STCP/STCPv2/zephyr/nordic/zephyr/soc/ene/kb106x/Kconfig.soc"
osource "/home/pomo/git/STCP/STCPv2/zephyr/nordic/zephyr/soc/elan/em32f967/Kconfig.soc"
osource "/home/pomo/git/STCP/STCPv2/zephyr/nordic/zephyr/soc/egis/Kconfig.soc"
osource "/home/pomo/git/STCP/STCPv2/zephyr/nordic/zephyr/soc/efinix/sapphire/Kconfig.soc"
osource "/home/pomo/git/STCP/STCPv2/zephyr/nordic/zephyr/soc/cdns/xtensa_sample_controller/Kconfig.soc"
osource "/home/pomo/git/STCP/STCPv2/zephyr/nordic/zephyr/soc/cdns/swerv/Kconfig.soc"
osource "/home/pomo/git/STCP/STCPv2/zephyr/nordic/zephyr/soc/cdns/sample_controller32/Kconfig.soc"
osource "/home/pomo/git/STCP/STCPv2/zephyr/nordic/zephyr/soc/cdns/dc233c/Kconfig.soc"
osource "/home/pomo/git/STCP/STCPv2/zephyr/nordic/zephyr/soc/brcm/bcmvk/Kconfig.soc"
osource "/home/pomo/git/STCP/STCPv2/zephyr/nordic/zephyr/soc/brcm/bcm2712/Kconfig.soc"
osource "/home/pomo/git/STCP/STCPv2/zephyr/nordic/zephyr/soc/brcm/bcm2711/Kconfig.soc"
osource "/home/pomo/git/STCP/STCPv2/zephyr/nordic/zephyr/soc/blackberry/qnxhv_vm/Kconfig.soc"
osource "/home/pomo/git/STCP/STCPv2/zephyr/nordic/zephyr/soc/bflb/Kconfig.soc"
osource "/home/pomo/git/STCP/STCPv2/zephyr/nordic/zephyr/soc/atmel/sam0/Kconfig.soc"
osource "/home/pomo/git/STCP/STCPv2/zephyr/nordic/zephyr/soc/atmel/sam/Kconfig.soc"
osource "/home/pomo/git/STCP/STCPv2/zephyr/nordic/zephyr/soc/aspeed/Kconfig.soc"
osource "/home/pomo/git/STCP/STCPv2/zephyr/nordic/zephyr/soc/arm/Kconfig.soc"
osource "/home/pomo/git/STCP/STCPv2/zephyr/nordic/zephyr/soc/arm/beetle/Kconfig.soc"
osource "/home/pomo/git/STCP/STCPv2/zephyr/nordic/zephyr/soc/antmicro/myra/Kconfig.soc"
osource "/home/pomo/git/STCP/STCPv2/zephyr/nordic/zephyr/soc/andestech/Kconfig.soc"
osource "/home/pomo/git/STCP/STCPv2/zephyr/nordic/zephyr/soc/amd/acp_6_0/Kconfig.soc"
osource "/home/pomo/git/STCP/STCPv2/zephyr/nordic/zephyr/soc/ambiq/Kconfig.soc"
osource "/home/pomo/git/STCP/STCPv2/zephyr/nordic/zephyr/soc/allwinner/sun8i_h3/Kconfig.soc"
osource "/home/pomo/git/STCP/STCPv2/zephyr/nordic/zephyr/soc/alif/ensemble/Kconfig.soc"
osource "/home/pomo/git/STCP/STCPv2/zephyr/nordic/zephyr/soc/aesc/Kconfig.soc"
osource "/home/pomo/git/STCP/STCPv2/zephyr/nordic/zephyr/soc/adi/max32/Kconfig.soc"
osource "/home/pomo/git/STCP/STCPv2/zephyr/nordic/nrf/soc/sercomm/nrf91/Kconfig.soc"
osource "/home/pomo/git/STCP/STCPv2/zephyr/nordic/nrf/soc/nordic/Kconfig.soc"
```
