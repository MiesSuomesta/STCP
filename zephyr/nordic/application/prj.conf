## CMakeLists.txt
```
cmake_minimum_required(VERSION 3.20.0)
find_package(Zephyr REQUIRED HINTS $ENV{ZEPHYR_BASE})
project(stcp_mqtt)

# Reject mixed carriers before building firmware.
if(CONFIG_STCP_TRANSPORT_ETHERNET)
    if(NOT CONFIG_ETH_W5500 OR CONFIG_NRF_MODEM_LIB)
        message(FATAL_ERROR "Ethernet transport requires W5500 and modem disabled")
    endif()
else()
    if(CONFIG_ETH_W5500 OR CONFIG_NET_L2_ETHERNET OR CONFIG_NET_CONFIG_AUTO_INIT)
        message(FATAL_ERROR "LTE transport must disable W5500, Ethernet L2 and automatic LAN configuration")
    endif()
    if(NOT CONFIG_NRF_MODEM_LIB)
        message(FATAL_ERROR "LTE transport requires CONFIG_NRF_MODEM_LIB=y")
    endif()
endif()

# Fail before compilation if the Ethernet pool fragment was omitted/overridden.
if(CONFIG_ETH_W5500)
    if(NOT "${CONFIG_NET_BUF_DATA_SIZE}" STREQUAL "1536")
        message(FATAL_ERROR "Ethernet RX pool configuration mismatch: CONFIG_NET_BUF_DATA_SIZE=${CONFIG_NET_BUF_DATA_SIZE}; expected 1536. Include application's ethernet.conf after other configuration fragments and run pristine build.")
    endif()
    if(NOT "${CONFIG_NET_BUF_RX_COUNT}" STREQUAL "10")
        message(FATAL_ERROR "Ethernet RX pool configuration mismatch: CONFIG_NET_BUF_RX_COUNT=${CONFIG_NET_BUF_RX_COUNT}; expected 10. Include application's ethernet.conf after other configuration fragments and run pristine build.")
    endif()
    if(NOT "${CONFIG_NET_BUF_TX_COUNT}" STREQUAL "6")
        message(FATAL_ERROR "Ethernet RX pool configuration mismatch: CONFIG_NET_BUF_TX_COUNT=${CONFIG_NET_BUF_TX_COUNT}; expected 6. Include application's ethernet.conf after other configuration fragments and run pristine build.")
    endif()
    if(NOT "${CONFIG_NET_PKT_RX_COUNT}" STREQUAL "16")
        message(FATAL_ERROR "Ethernet RX pool configuration mismatch: CONFIG_NET_PKT_RX_COUNT=${CONFIG_NET_PKT_RX_COUNT}; expected 16. Include application's ethernet.conf after other configuration fragments and run pristine build.")
    endif()
    if(NOT "${CONFIG_NET_PKT_TX_COUNT}" STREQUAL "8")
        message(FATAL_ERROR "Ethernet RX pool configuration mismatch: CONFIG_NET_PKT_TX_COUNT=${CONFIG_NET_PKT_TX_COUNT}; expected 8. Include application's ethernet.conf after other configuration fragments and run pristine build.")
    endif()
    message(STATUS "W5500 net pools: data=1536 RX=10 TX=6 packets RX=16 TX=8")
endif()


target_sources(app PRIVATE
    src/main.c
    src/echo_benchmark.c
    src/mqtt_codec.c
    src/mqtt_proxy.c
)

target_sources_ifdef(CONFIG_STCP_BENCH_SHELL app PRIVATE
    src/bench_shell.c
)

if(CONFIG_STCP_BENCH_SHELL AND CONFIG_NET_NATIVE)
    target_sources(app PRIVATE
        src/stcp_ping.c
    )
endif()

target_sources_ifdef(CONFIG_NRF_MODEM_LIB app PRIVATE
    src/stcp_lte_transport.c
)

if(CONFIG_STCP_BENCH_SHELL AND CONFIG_NRF_MODEM_LIB)
    target_sources(app PRIVATE src/modem_status.c)
endif()

target_sources_ifdef(CONFIG_ETH_W5500 app PRIVATE
    src/ethernet_status.c
)
```

## Kconfig
```
mainmenu "STCP transport benchmark"

source "Kconfig.zephyr"

menu "Echo benchmark"

config ECHO_SERVER_HOST
    string "Echo server hostname or IPv4 address"
    default "lja.fi"

config ECHO_SERVER_PORT
    string "Echo server port"
    default "19000"

choice ECHO_TRANSPORT
    prompt "Echo transport"
    default ECHO_TRANSPORT_TCP

config ECHO_TRANSPORT_TCP
    bool "TCP"

config ECHO_TRANSPORT_STCP
    bool "STCP over current carrier"

endchoice

config ECHO_PAYLOAD_SIZE
    int "Echo payload size"
    default 1024
    range 1 40960

config ECHO_ITERATIONS
    int "Number of echo round trips"
    default 100
    range 1 100000

config ECHO_SOCKET_TIMEOUT_MS
    int "Socket send/receive timeout in milliseconds"
    default 30000
    range 1000 300000

config BENCH_TOTAL_BYTES
    int "Bytes transferred per direction in each throughput test"
    default 1048576
    range 4096 67108864

config BENCH_MAX_CHUNK_SIZE
    int "Maximum runtime streaming chunk size"
    default 65536
    range 4096 65536
    help
      Maximum chunk accepted by the runtime shell and benchmark core. Buffers
      are allocated dynamically for each test. Full duplex needs two buffers.

config BENCH_CHUNK_SIZE
    int "Default streaming I/O chunk size"
    default 4096
    range 256 BENCH_MAX_CHUNK_SIZE

config BENCH_PAUSE_SECONDS
    int "Pause between upload, download and full-duplex tests"
    default 5
    range 0 120

config BENCH_REPORT_INTERVAL_MS
    int "Progress report interval in milliseconds"
    default 5000
    range 0 600000
    help
      Controls how often the modem-side benchmark reports transferred bytes,
      remaining bytes, percentage and average throughput. Set to 0 to disable
      periodic reports; the final 100 percent report is still printed.

config BENCH_SENDER_STACK_SIZE
    int "Full-duplex sender thread stack size"
    default 4096
    range 2048 16384

config BENCH_WORKER_STACK_SIZE
    int "Benchmark worker thread stack size"
    default 8192
    range 4096 24576
    help
      Stack reserved for the dedicated benchmark worker. AF_STCP socket and
      Rust session creation run in this thread instead of the shell UART
      thread, preventing shell stack overflow.

config BENCH_WORKER_PRIORITY
    int "Benchmark worker thread priority"
    default 5
    range 0 15
    help
      Cooperative/preemptible Zephyr priority used by the benchmark worker.


config BENCH_STCP_BLOCKING_CONNECT
    bool "Use blocking connect for STCP benchmark sockets"
    default y
    help
      STCP socket offload currently does not implement F_GETFL/F_SETFL.
      Enable this option to skip unsupported O_NONBLOCK setup for AF_STCP
      sockets and call connect() in blocking mode. Native TCP continues to
      use the existing non-blocking connect and poll path.


config BENCH_SOCKET_BUFFER_SIZE
    int "Requested modem socket send/receive buffer size"
    default 32768
    range 4096 131072
    help
      Best-effort SO_SNDBUF/SO_RCVBUF value. The modem offload may clamp or
      reject the value; benchmark startup logs the actual result.

config BENCH_FULL_RX_BUFFER_SIZE
    int "Full-duplex receive scratch buffer size"
    default 4096
    range 1024 16384
    help
      Full-duplex uses the configured chunk size for TX, but a smaller RX
      scratch buffer to avoid reserving two 64 KiB buffers at once. TCP is a
      byte stream, so receive calls do not need to match the peer send size.

endmenu

menu "Interactive benchmark control"

config STCP_BENCH_SHELL
    bool "Enable STCP benchmark shell commands"
    default y
    select SHELL
    help
      Builds the interactive 'stcp config' and 'stcp bench' command tree.
      Disable this option to remove the shell command implementation and its
      command tables from the firmware image.

config STCP_BENCH_AUTORUN
    bool "Run all throughput benchmarks automatically after LTE connects"
    default n if STCP_BENCH_SHELL
    default y if !STCP_BENCH_SHELL
    help
      Automatically runs upload, download and full-duplex benchmarks after
      LTE registration. This can be enabled together with the shell if both
      automatic and interactive testing are desired.

endmenu

menu "LTE/ETH transport initialization"

config STCP_TRANSPORT_ETHERNET
    bool "STCP over Ethernet (via W5500-shield)"
    default y
    help
      Select Ethernet as the physical STCP transport with
      a W5500-ethernet-shield.

      Disable LTE-specific initialization and PDN binding.

config STCP_LTE_REG_TIMEOUT_SECONDS
    int "LTE registration timeout in seconds"
    default 300
    range 10 1800

config STCP_LTE_PDN_TIMEOUT_SECONDS
    int "PDN activation timeout in seconds"
    default 300
    range 10 1800

config STCP_LTE_FORCE_DEFAULT_APN
    bool "Configure default CID 0 APN before LTE attach"
    default n
    help
      Writes CONFIG_STCP_LTE_DEFAULT_APN to PDP context CID 0 before
      lte_lc_connect(). Benchmark sockets use this default context.

config STCP_LTE_DEFAULT_APN
    string "Default CID 0 APN"
    default "APN internet"
    depends on STCP_LTE_FORCE_DEFAULT_APN

config STCP_LTE_CUSTOM_PDN
    bool "Create, activate and bind sockets to a separate PDN context"
    default n
    depends on LTE_LC_PDN_MODULE
    help
      Reproduces the STCPv1 model by creating and activating an additional
      PDN context after LTE registration. Benchmark TCP sockets are bound to
      the resulting modem PDN ID with SO_BINDTOPDN before connect().

config STCP_LTE_APN
    string "APN for the separate PDN context"
    default "APN internet"
    depends on STCP_LTE_CUSTOM_PDN

endmenu
```

## prj.conf
```kconfig
# STCP benchmark/MQTT application only.

CONFIG_STCP_TRANSPORT_ETHERNET=n

# Shell / application logging
CONFIG_SHELL=y
CONFIG_SHELL_BACKEND_SERIAL=y
CONFIG_SHELL_PROMPT_UART="stcp> "
CONFIG_SHELL_STACK_SIZE=8192
CONFIG_LOG_RUNTIME_FILTERING=n
CONFIG_LOG_MODE_IMMEDIATE=y
CONFIG_LOG_MODE_DEFERRED=n
CONFIG_LOG_PRINTK=n
CONFIG_LOG_DEFAULT_LEVEL=2

# MQTT
CONFIG_MQTT_LIB=y

# Application memory
CONFIG_MAIN_STACK_SIZE=4096
CONFIG_SYSTEM_WORKQUEUE_STACK_SIZE=4096

# Echo benchmark
CONFIG_ECHO_TRANSPORT_STCP=y
CONFIG_ECHO_SERVER_HOST="192.168.1.20"
CONFIG_ECHO_SERVER_PORT="19000"
CONFIG_ECHO_SOCKET_TIMEOUT_MS=60000
CONFIG_BENCH_TOTAL_BYTES=1048576
CONFIG_BENCH_MAX_CHUNK_SIZE=65536
CONFIG_BENCH_CHUNK_SIZE=4096
CONFIG_BENCH_PAUSE_SECONDS=5
CONFIG_BENCH_REPORT_INTERVAL_MS=5000
CONFIG_BENCH_SENDER_STACK_SIZE=4096
CONFIG_BENCH_FULL_RX_BUFFER_SIZE=4096
CONFIG_STCP_BENCH_SHELL=y
CONFIG_STCP_BENCH_AUTORUN=n
CONFIG_BENCH_STCP_BLOCKING_CONNECT=y
CONFIG_BENCH_WORKER_STACK_SIZE=4096
CONFIG_BENCH_WORKER_PRIORITY=5
CONFIG_THREAD_STACK_INFO=y

# Ethernet is opt-in through ethernet.conf; LTE builds must not probe W5500.
CONFIG_NET_L2_ETHERNET=n
CONFIG_ETH_W5500=n

# Crypto
CONFIG_PSA_WANT_ALG_GCM=y
```

## ethernet.conf
```kconfig
# STCP Ethernet build for nRF9151 DK + Seeed W5500

# DBG heap, Y/N
CONFIG_SYS_HEAP_INFO=y
CONFIG_SYS_HEAP_VALIDATE=y
CONFIG_LOG_PRINTK=n

CONFIG_STCP_TRANSPORT_ETHERNET=y

# Optimoinita
CONFIG_LOG_RUNTIME_FILTERING=n
CONFIG_SHELL_STACK_SIZE=8192

# Console and shell
CONFIG_SERIAL=y
CONFIG_CONSOLE=y
CONFIG_UART_CONSOLE=y
CONFIG_PRINTK=y
CONFIG_SHELL=y
CONFIG_SHELL_BACKEND_SERIAL=y
CONFIG_SHELL_PROMPT_UART="stcp> "

# Logging
CONFIG_LOG=y
CONFIG_LOG_MODE_IMMEDIATE=y
CONFIG_LOG_MODE_DEFERRED=n

# Älä ohjaa printk:iä deferred loggerin kautta.
CONFIG_LOG_PRINTK=n

CONFIG_LOG_DEFAULT_LEVEL=2
CONFIG_KERNEL_LOG_LEVEL_WRN=y
CONFIG_LOG_BACKEND_UART=y
CONFIG_SPI_LOG_LEVEL_WRN=y
CONFIG_ETHERNET_LOG_LEVEL_INF=y
CONFIG_NET_LOG=n

# Native Zephyr network stack
CONFIG_NETWORKING=y
CONFIG_NET_BUF=y
CONFIG_NET_NATIVE=y
CONFIG_NET_IPV4=y
CONFIG_NET_IPV6=n
CONFIG_NET_TCP=y
CONFIG_NET_UDP=y
CONFIG_NET_SOCKETS=y
CONFIG_NET_SOCKETS_OFFLOAD=n
CONFIG_NET_L2_ETHERNET=y
CONFIG_ETH_W5500=y
CONFIG_SPI=y
CONFIG_GPIO=y
CONFIG_NET_ARP=y

# Static LAN configuration
CONFIG_NET_DHCPV4=n
CONFIG_NET_CONFIG_SETTINGS=y
CONFIG_NET_CONFIG_AUTO_INIT=y
CONFIG_NET_CONFIG_NEED_IPV4=y
CONFIG_NET_CONFIG_INIT_TIMEOUT=10
CONFIG_NET_CONFIG_MY_IPV4_ADDR="192.168.1.55"
CONFIG_NET_CONFIG_MY_IPV4_NETMASK="255.255.0.0"
CONFIG_NET_CONFIG_MY_IPV4_GW="192.168.1.2"

# Network management and diagnostics
CONFIG_NET_MGMT=y
CONFIG_NET_MGMT_EVENT=y
CONFIG_NET_CONNECTION_MANAGER=y
CONFIG_NET_SHELL=y
CONFIG_NET_STATISTICS=y

# MQTT and STCP
CONFIG_MQTT_LIB=y

# Memory
#CONFIG_HEAP_MEM_POOL_SIZE=98304
CONFIG_HEAP_MEM_POOL_SIZE=32768
CONFIG_MAIN_STACK_SIZE=4096
CONFIG_SYSTEM_WORKQUEUE_STACK_SIZE=4096
CONFIG_ETH_W5500_RX_THREAD_STACK_SIZE=6144

# Utilities
CONFIG_RING_BUFFER=y
CONFIG_REBOOT=y
CONFIG_ENTROPY_GENERATOR=y
CONFIG_THREAD_NAME=y
CONFIG_ASSERT=y
CONFIG_SPEED_OPTIMIZATIONS=y
CONFIG_ASSERT_VERBOSE=n

# Echo benchmark
CONFIG_ECHO_TRANSPORT_STCP=y
CONFIG_ECHO_SERVER_HOST="192.168.1.20"
CONFIG_ECHO_SERVER_PORT="19000"
CONFIG_ECHO_SOCKET_TIMEOUT_MS=60000
CONFIG_BENCH_TOTAL_BYTES=1048576
#CONFIG_BENCH_TOTAL_BYTES=1048
CONFIG_BENCH_MAX_CHUNK_SIZE=65536
#OLI CONFIG_BENCH_CHUNK_SIZE=16384
CONFIG_BENCH_CHUNK_SIZE=4096
CONFIG_BENCH_PAUSE_SECONDS=5
CONFIG_BENCH_REPORT_INTERVAL_MS=5000
CONFIG_BENCH_SENDER_STACK_SIZE=4096
CONFIG_BENCH_FULL_RX_BUFFER_SIZE=4096
CONFIG_STCP_BENCH_SHELL=y
CONFIG_STCP_BENCH_AUTORUN=n

# Ethernet build: modem/LTE stack disabled
CONFIG_NRF_MODEM_LIB=n
CONFIG_LTE_LINK_CONTROL=n
CONFIG_PDN=n

CONFIG_BENCH_STCP_BLOCKING_CONNECT=y

# PSA_CRYPTO_CLIENT is generated/hidden in NCS 3.3.0; do not assign it directly.
# Client benchmark needs one active STCP socket; keep one spare for recovery.
# The RX stack is embedded in every pool entry, so limiting the pool saves
# 24+ KiB of static RAM compared with the default eight sockets.
CONFIG_MBEDTLS_PSA_CRYPTO_C=y

# Run benchmark and Rust STCP session creation outside shell_uart.
CONFIG_BENCH_WORKER_STACK_SIZE=4096
CONFIG_BENCH_WORKER_PRIORITY=5
CONFIG_THREAD_STACK_INFO=y



# Clean STCP Zephyr adapter: custom AF_STCP provider, not global socket offload.
CONFIG_STCP=y
CONFIG_STCP_SOCKET_PRIORITY=20
CONFIG_STCP_MAX_SOCKETS=2
CONFIG_STCP_CONNECT_TIMEOUT_MS=60000
CONFIG_STCP_LOG_LEVEL=3
CONFIG_STCP_RUST_TOOLCHAIN="nightly"
#CONFIG_STCP_RUST_RX_STACK_SIZE=3072
CONFIG_STCP_RUST_RX_STACK_SIZE=8192
CONFIG_STCP_RUST_RX_PRIORITY=7
CONFIG_STCP_RUST_RX_BUFFER_SIZE=2048
CONFIG_STCP_RUST_X25519_SOFTWARE=y
CONFIG_STCP_RUST_TRACE_WIRE=n
CONFIG_STCP_RUST_TRACE_EVENTS=n
CONFIG_STCP_RUST_TRACE_ALLOC=n
CONFIG_STCP_RUST_TRACE_CRYPTO=n

# AF_STCP connect is deliberately blocking in the benchmark shell for bring-up.
CONFIG_PSA_WANT_ALG_GCM=y

# W5500 MACRAW: one net_buf per ordinary Ethernet frame.
# Data storage: (12 RX + 6 TX) * 1536 = 27648 bytes.
CONFIG_NET_BUF_DATA_SIZE=1536
CONFIG_NET_BUF_RX_COUNT=10

CONFIG_NET_PKT_RX_COUNT=16

CONFIG_NET_BUF_TX_COUNT=6

CONFIG_NET_PKT_TX_COUNT=8
```

## lte.conf
```kconfig
CONFIG_STCP=y
CONFIG_NET_SOCKETS=y
CONFIG_NET_SOCKETS_OFFLOAD=y
CONFIG_NET_NATIVE=n
CONFIG_STCP_RUST_TRACE_WIRE=n
CONFIG_STCP_RUST_TRACE_EVENTS=n
CONFIG_STCP_RUST_TRACE_ALLOC=n
CONFIG_STCP_RUST_TRACE_CRYPTO=n
CONFIG_LTE_LINK_CONTROL=y

# LTE-only build: no Ethernet device or automatic LAN setup.
CONFIG_STCP_TRANSPORT_ETHERNET=n
CONFIG_NET_L2_ETHERNET=n
CONFIG_ETH_W5500=n
CONFIG_NET_CONFIG_AUTO_INIT=n
```

## memory.conf
```kconfig
CONFIG_HEAP_MEM_POOL_SIZE=32768

CONFIG_NET_BUF_RX_COUNT=32
CONFIG_NET_BUF_TX_COUNT=32

CONFIG_NET_PKT_RX_COUNT=32
CONFIG_NET_PKT_TX_COUNT=32

CONFIG_NET_BUF_DATA_SIZE=1536

CONFIG_NET_TCP_RECV_QUEUE_TIMEOUT=100
```

## nrf9151.conf
```kconfig
#
# LTE / nRF91 network
#
CONFIG_NETWORKING=y
CONFIG_NET_NATIVE=n
CONFIG_NET_SOCKETS=y
CONFIG_NET_SOCKETS_OFFLOAD=y
CONFIG_NET_IPV4=y
CONFIG_NET_IPV6=y
CONFIG_NET_TCP=y
CONFIG_NET_UDP=y

#
# nRF91 modem
#
CONFIG_NRF_MODEM_LIB=y
CONFIG_LTE_LINK_CONTROL=y
CONFIG_LTE_LC_PDN_MODULE=y

CONFIG_LTE_NETWORK_MODE_LTE_M=y
CONFIG_LTE_PSM_REQ=n
CONFIG_LTE_EDRX_REQ=n

#
# Console / logging
#
CONFIG_SERIAL=y
CONFIG_CONSOLE=y
CONFIG_UART_CONSOLE=y
CONFIG_PRINTK=y
CONFIG_UART_NRFX=y

#
# LTE transport
#
CONFIG_STCP_LTE_REG_TIMEOUT_SECONDS=300
CONFIG_STCP_LTE_PDN_TIMEOUT_SECONDS=300

CONFIG_STCP_LTE_CUSTOM_PDN=y
CONFIG_STCP_LTE_FORCE_DEFAULT_APN=y
CONFIG_STCP_LTE_DEFAULT_APN="internet"
CONFIG_STCP_LTE_APN="internet"
```

## src/main.c
```c
#include <zephyr/kernel.h>
#include <zephyr/logging/log.h>

#include "echo_benchmark.h"
#if defined(CONFIG_STCP_TRANSPORT_ETHERNET) && defined(CONFIG_ETH_W5500)
#include "ethernet_status.h"
#endif
#if !defined(CONFIG_STCP_TRANSPORT_ETHERNET) && defined(CONFIG_NRF_MODEM_LIB)
#include "stcp_lte_transport.h"
#endif

LOG_MODULE_REGISTER(main, LOG_LEVEL_INF);

extern size_t stcp_rust_wire_header_len(void);

int main(void)
{
    int ret;

    LOG_INF("STCP transport benchmark starting");

#if !defined(CONFIG_STCP_TRANSPORT_ETHERNET) && defined(CONFIG_NRF_MODEM_LIB)
    ret = stcp_lte_transport_init();
    if (ret < 0) {
        LOG_ERR("LTE transport initialization failed: %d", ret);
        return ret;
    }

    LOG_INF("LTE transport connected and data path ready");
#else
    LOG_INF("Ethernet transport build; LTE initialization skipped");
#if defined(CONFIG_STCP_TRANSPORT_ETHERNET) && defined(CONFIG_ETH_W5500)
    k_sleep(K_MSEC(1200));
    ethernet_status_log_startup();
#endif
#endif

#if defined(CONFIG_STCP_BENCH_AUTORUN)
    ret = echo_benchmark_run();
    if (ret < 0) {
        LOG_ERR("Benchmark failed: %d", ret);
        return ret;
    }
    LOG_INF("Transport test finished successfully");
#endif

#if defined(CONFIG_STCP_BENCH_SHELL)
    LOG_INF("Benchmark shell ready; type: stcp config show");
#endif

    LOG_INF("STCP wire header: %u bytes",
        (unsigned int)stcp_rust_wire_header_len());

    return 0;
}
```

## src/ben2_metrics.h
```c
#ifndef BEN2_METRICS_H
#define BEN2_METRICS_H
#include <stdint.h>
#include <stddef.h>
#define BEN2_VERSION 2u
#define BEN2_METRICS_SIZE 112u
#define BEN2_CARRIER_UNKNOWN 0u
#define BEN2_CARRIER_ETHERNET 1u
#define BEN2_CARRIER_LTE 2u
/* All quantities are raw. Times in microseconds. Bytes exclude control frames.
 * Zero means unavailable for times and stack counters. Connect is measured
 * locally, before the data window. Count actual socket calls, not app chunks. */
struct ben2_metrics {
    uint32_t carrier;
    uint64_t tx_bytes, rx_bytes, tx_us, rx_us;
    uint64_t send_calls, recv_calls, eagain, errors;
    uint64_t stack_used_bytes, stack_free_bytes, connect_us, elapsed_us;
};
static inline void ben2_put32(uint8_t *p, uint32_t v) {
    for (int i=3;i>=0;i--) {p[i]=(uint8_t)v;v>>=8;}
}
static inline void ben2_put64(uint8_t *p,uint64_t v) {
    ben2_put32(p,(uint32_t)(v>>32));ben2_put32(p+4,(uint32_t)v);
}
static inline void ben2_request_encode(uint8_t out[20],uint32_t mode,uint32_t chunk,uint32_t total) {
    ben2_put32(out,0x42454e32);ben2_put32(out+4,BEN2_VERSION);
    ben2_put32(out+8,mode);ben2_put32(out+12,chunk);ben2_put32(out+16,total);
}
static inline void ben2_metrics_encode(uint8_t out[BEN2_METRICS_SIZE],const struct ben2_metrics *m) {
    ben2_put32(out,0x4d545232);ben2_put32(out+4,1);ben2_put32(out+8,BEN2_METRICS_SIZE);ben2_put32(out+12,m->carrier);
    const uint64_t values[12]={m->tx_bytes,m->rx_bytes,m->tx_us,m->rx_us,m->send_calls,m->recv_calls,m->eagain,m->errors,m->stack_used_bytes,m->stack_free_bytes,m->connect_us,m->elapsed_us};
    for (size_t i=0;i<12;i++) ben2_put64(out+16+i*8,values[i]);
}
#endif
```

## src/bench_shell.c
```c
#include <errno.h>
#include <stdlib.h>
#include <string.h>

#include <zephyr/kernel.h>
#include <zephyr/shell/shell.h>
#include <zephyr/sys/util.h>

#include "echo_benchmark.h"
#if defined(CONFIG_NET_NATIVE)
#include "stcp_ping.h"
#endif
#if defined(CONFIG_ETH_W5500)
#include "ethernet_status.h"
#endif
#if defined(CONFIG_NRF_MODEM_LIB)
#include "modem_status.h"
#endif


#if defined(CONFIG_NET_NATIVE)
static int cmd_stcp_ping(const struct shell *sh, size_t argc, char **argv)
{
    return stcp_ping_run(sh, argc, argv);
}
#endif

static struct bench_config shell_cfg;
static bool shell_cfg_ready;

static void ensure_config(void)
{
    if (!shell_cfg_ready) {
        bench_config_defaults(&shell_cfg);
        shell_cfg_ready = true;
    }
}

static int parse_u32(const struct shell *sh, const char *text,
                     uint32_t min, uint32_t max, uint32_t *value)
{
    char *end = NULL;
    unsigned long parsed;

    errno = 0;
    parsed = strtoul(text, &end, 0);
    if (errno || !end || *end != '\0' || parsed < min || parsed > max) {
        shell_error(sh, "Invalid value '%s' (range %u..%u)", text, min, max);
        return -EINVAL;
    }

    *value = (uint32_t)parsed;
    return 0;
}

static int cmd_config_show(const struct shell *sh, size_t argc, char **argv)
{
    ARG_UNUSED(argc);
    ARG_UNUSED(argv);
    ensure_config();
    shell_print(sh, "Host      : %s", shell_cfg.host);
    shell_print(sh, "Port      : %s", shell_cfg.port);
    shell_print(sh, "Transport : %s", bench_transport_name(shell_cfg.transport));
    shell_print(sh, "Chunk     : %u bytes", shell_cfg.chunk_size);
    shell_print(sh, "Total     : %u bytes", shell_cfg.total_bytes);
    shell_print(sh, "Timeout   : %u ms", shell_cfg.timeout_ms);
    shell_print(sh, "Report    : %u ms", shell_cfg.report_interval_ms);
    return 0;
}

static int cmd_config_host(const struct shell *sh, size_t argc, char **argv)
{
    ARG_UNUSED(argc);
    ensure_config();
    if (strlen(argv[1]) >= sizeof(shell_cfg.host)) {
        shell_error(sh, "Host is too long");
        return -ENAMETOOLONG;
    }
    strcpy(shell_cfg.host, argv[1]);
    shell_print(sh, "Host = %s", shell_cfg.host);
    return 0;
}

static int cmd_config_port(const struct shell *sh, size_t argc, char **argv)
{
    uint32_t port;
    ARG_UNUSED(argc);
    ensure_config();
    if (parse_u32(sh, argv[1], 1, 65535, &port) < 0) return -EINVAL;
    snprintk(shell_cfg.port, sizeof(shell_cfg.port), "%u", port);
    shell_print(sh, "Port = %s", shell_cfg.port);
    return 0;
}

static int cmd_config_chunk(const struct shell *sh, size_t argc, char **argv)
{
    ARG_UNUSED(argc);
    ensure_config();
    if (parse_u32(sh, argv[1], 1, CONFIG_BENCH_MAX_CHUNK_SIZE, &shell_cfg.chunk_size) < 0) return -EINVAL;
    shell_print(sh, "Chunk = %u", shell_cfg.chunk_size);
    return 0;
}

static int cmd_config_total(const struct shell *sh, size_t argc, char **argv)
{
    ARG_UNUSED(argc);
    ensure_config();
    if (parse_u32(sh, argv[1], 1, 64U * 1024U * 1024U, &shell_cfg.total_bytes) < 0) return -EINVAL;
    shell_print(sh, "Total = %u", shell_cfg.total_bytes);
    return 0;
}

static int cmd_config_timeout(const struct shell *sh, size_t argc, char **argv)
{
    ARG_UNUSED(argc);
    ensure_config();
    if (parse_u32(sh, argv[1], 1000, 600000, &shell_cfg.timeout_ms) < 0) return -EINVAL;
    shell_print(sh, "Timeout = %u ms", shell_cfg.timeout_ms);
    return 0;
}


static int cmd_config_report(const struct shell *sh, size_t argc, char **argv)
{
    ARG_UNUSED(argc);
    ensure_config();
    if (parse_u32(sh, argv[1], 0, 600000, &shell_cfg.report_interval_ms) < 0) return -EINVAL;
    shell_print(sh, "Report interval = %u ms", shell_cfg.report_interval_ms);
    return 0;
}

static int cmd_config_transport(const struct shell *sh, size_t argc, char **argv)
{
    ARG_UNUSED(argc);
    ensure_config();
    if (!strcmp(argv[1], "tcp")) shell_cfg.transport = BENCH_TRANSPORT_TCP;
    else if (!strcmp(argv[1], "stcp") || !strcmp(argv[1], "stcp-tcp")) shell_cfg.transport = BENCH_TRANSPORT_STCP;
    else if (!strcmp(argv[1], "stcp-udp")) shell_cfg.transport = BENCH_TRANSPORT_STCP_UDP;
    else if (!strcmp(argv[1], "udp")) shell_cfg.transport = BENCH_TRANSPORT_UDP;
    else {
        shell_error(sh, "Transport must be tcp, udp, stcp-tcp or stcp-udp");
        return -EINVAL;
    }
    shell_print(sh, "Transport = %s", bench_transport_name(shell_cfg.transport));
    return 0;
}


static void emit_json_parts(const struct shell *sh, const char *json, int length)
{
    enum { PART = 88 };
    shell_print(sh, "STCP_BENCH_JSON_BEGIN %d", length);
    for (int off = 0; off < length; off += PART) {
        int n = MIN(PART, length - off);
        shell_print(sh, "STCP_BENCH_JSON_PART %.*s", n, json + off);
    }
    shell_print(sh, "STCP_BENCH_JSON_END");
}

static void emit_machine_result(const struct shell *sh,
                                const struct bench_config *cfg,
                                const char *direction, int rc)
{
    static char json[1024];
    const struct bench_result *r = bench_get_last_result(direction);
    int written;
    if (!r || !cfg) return;
    written = snprintk(json, sizeof(json),
        "{\"schema_version\":3,\"platform\":\"zephyr-nrf9151\","
        "\"carrier\":\"%s\",\"transport\":\"%s\",\"direction\":\"%s\","
        "\"payload_bytes\":%u,\"total_bytes\":%u,\"elapsed_ms\":%lld,"
        "\"status\":%d,\"bytes_tx\":%u,\"bytes_rx\":%u,\"rates_on_server\":true}",
#if defined(CONFIG_STCP_TRANSPORT_ETHERNET)
        "ethernet",
#else
        "lte",
#endif
        bench_transport_name(cfg->transport), direction, cfg->chunk_size,
        cfg->total_bytes, (long long)r->elapsed_ms, rc, r->bytes_tx, r->bytes_rx);

    if (written < 0 || written >= (int)sizeof(json)) {
        shell_error(sh, "Benchmark JSON formatting failed/truncated: %d", written);
        return;
    }
    emit_json_parts(sh, json, written);
}

enum bench_job_kind {
    BENCH_JOB_UPLOAD,
    BENCH_JOB_DOWNLOAD,
    BENCH_JOB_FULL,
    BENCH_JOB_ALL,
    BENCH_JOB_MATRIX,
};

struct bench_job {
    const struct shell *sh;
    struct bench_config cfg;
    enum bench_job_kind kind;
};

K_THREAD_STACK_DEFINE(bench_worker_stack, CONFIG_BENCH_WORKER_STACK_SIZE);
static struct k_thread bench_worker_thread;
static struct k_sem bench_job_sem;
static struct k_mutex bench_job_lock;
static struct bench_job pending_job;
static atomic_t bench_worker_started;
static atomic_t bench_job_pending;

static const char *bench_job_name(enum bench_job_kind kind)
{
    switch (kind) {
    case BENCH_JOB_UPLOAD: return "upload";
    case BENCH_JOB_DOWNLOAD: return "download";
    case BENCH_JOB_FULL: return "full";
    case BENCH_JOB_ALL: return "all";
    case BENCH_JOB_MATRIX: return "matrix";
    default: return "unknown";
    }
}

static int run_job(const struct bench_job *job)
{
    switch (job->kind) {
    case BENCH_JOB_UPLOAD: return bench_run_upload(&job->cfg);
    case BENCH_JOB_DOWNLOAD: return bench_run_download(&job->cfg);
    case BENCH_JOB_FULL: return bench_run_full(&job->cfg);
    case BENCH_JOB_ALL: return bench_run_all(&job->cfg);
    case BENCH_JOB_MATRIX: return bench_run_matrix(&job->cfg);
    default: return -EINVAL;
    }
}

static void bench_worker_main(void *arg1, void *arg2, void *arg3)
{
    ARG_UNUSED(arg1);
    ARG_UNUSED(arg2);
    ARG_UNUSED(arg3);

    for (;;) {
        struct bench_job job;
        const char *name;
        int rc;

        k_sem_take(&bench_job_sem, K_FOREVER);

        k_mutex_lock(&bench_job_lock, K_FOREVER);
        job = pending_job;
        k_mutex_unlock(&bench_job_lock);

        name = bench_job_name(job.kind);
        shell_print(job.sh,
                    "%s: %s://%s:%s, total=%u, chunk=%u",
                    name, bench_transport_name(job.cfg.transport),
                    job.cfg.host, job.cfg.port,
                    job.cfg.total_bytes, job.cfg.chunk_size);
        shell_print(job.sh,
                    "Benchmark worker: thread=stcp_bench stack=%u bytes",
                    (unsigned int)CONFIG_BENCH_WORKER_STACK_SIZE);

        rc = run_job(&job);
        if (job.kind != BENCH_JOB_ALL && job.kind != BENCH_JOB_MATRIX) {
            emit_machine_result(job.sh, &job.cfg, name, rc);
        }

#if defined(CONFIG_THREAD_STACK_INFO)
        {
            size_t unused = 0U;
            if (k_thread_stack_space_get(&bench_worker_thread, &unused) == 0) {
                shell_print(job.sh,
                            "Benchmark worker stack: used=%u unused=%u bytes",
                            (unsigned int)(CONFIG_BENCH_WORKER_STACK_SIZE - unused),
                            (unsigned int)unused);
            }
        }
#endif

        if (rc < 0) {
            shell_error(job.sh, "%s failed: %d", name, rc);
        } else {
            shell_print(job.sh, "%s completed successfully", name);
        }

        atomic_clear(&bench_job_pending);
    }
}

static void ensure_bench_worker(void)
{
    if (atomic_cas(&bench_worker_started, 0, 1)) {
        k_sem_init(&bench_job_sem, 0, 1);
        k_mutex_init(&bench_job_lock);
        k_thread_create(&bench_worker_thread,
                        bench_worker_stack,
                        K_THREAD_STACK_SIZEOF(bench_worker_stack),
                        bench_worker_main,
                        NULL, NULL, NULL,
                        CONFIG_BENCH_WORKER_PRIORITY,
                        0, K_NO_WAIT);
        k_thread_name_set(&bench_worker_thread, "stcp_bench");
    }
}

static int queue_benchmark(const struct shell *sh, enum bench_job_kind kind)
{
    const char *name = bench_job_name(kind);

    ensure_config();
    ensure_bench_worker();

    if (!atomic_cas(&bench_job_pending, 0, 1)) {
        shell_error(sh, "Benchmark already running");
        return -EBUSY;
    }

    k_mutex_lock(&bench_job_lock, K_FOREVER);
    pending_job.sh = sh;
    pending_job.cfg = shell_cfg;
    pending_job.kind = kind;
    k_mutex_unlock(&bench_job_lock);

    shell_print(sh,
                "%s benchmark queued: %s://%s:%s, total=%u, chunk=%u",
                name, bench_transport_name(shell_cfg.transport),
                shell_cfg.host, shell_cfg.port,
                shell_cfg.total_bytes, shell_cfg.chunk_size);
    k_sem_give(&bench_job_sem);
    return 0;
}

static int cmd_bench_upload(const struct shell *sh, size_t argc, char **argv)
{ ARG_UNUSED(argc); ARG_UNUSED(argv); return queue_benchmark(sh, BENCH_JOB_UPLOAD); }
static int cmd_bench_download(const struct shell *sh, size_t argc, char **argv)
{ ARG_UNUSED(argc); ARG_UNUSED(argv); return queue_benchmark(sh, BENCH_JOB_DOWNLOAD); }
static int cmd_bench_full(const struct shell *sh, size_t argc, char **argv)
{ ARG_UNUSED(argc); ARG_UNUSED(argv); return queue_benchmark(sh, BENCH_JOB_FULL); }
static int cmd_bench_all(const struct shell *sh, size_t argc, char **argv)
{ ARG_UNUSED(argc); ARG_UNUSED(argv); return queue_benchmark(sh, BENCH_JOB_ALL); }

static int cmd_bench_matrix(const struct shell *sh, size_t argc, char **argv)
{ ARG_UNUSED(argc); ARG_UNUSED(argv); return queue_benchmark(sh, BENCH_JOB_MATRIX); }

SHELL_STATIC_SUBCMD_SET_CREATE(config_cmds,
    SHELL_CMD(show, NULL, "Show runtime benchmark configuration", cmd_config_show),
    SHELL_CMD_ARG(host, NULL, "Set host: stcp config host <name|ip>", cmd_config_host, 2, 0),
    SHELL_CMD_ARG(port, NULL, "Set port: stcp config port <1..65535>", cmd_config_port, 2, 0),
    SHELL_CMD_ARG(chunk, NULL, "Set chunk bytes: stcp config chunk <1..65536>", cmd_config_chunk, 2, 0),
    SHELL_CMD_ARG(total, NULL, "Set total bytes: stcp config total <bytes>", cmd_config_total, 2, 0),
    SHELL_CMD_ARG(timeout, NULL, "Set inactivity timeout ms", cmd_config_timeout, 2, 0),
    SHELL_CMD_ARG(report, NULL, "Set progress report interval ms (0 disables)", cmd_config_report, 2, 0),
    SHELL_CMD_ARG(transport, NULL, "Set tcp, udp, stcp-tcp or stcp-udp", cmd_config_transport, 2, 0),
    SHELL_SUBCMD_SET_END
);

#if defined(CONFIG_ETH_W5500)
static int cmd_net_status(const struct shell *sh, size_t argc, char **argv)
{
    ARG_UNUSED(argc);
    ARG_UNUSED(argv);
    return ethernet_status_show(sh);
}

SHELL_STATIC_SUBCMD_SET_CREATE(net_cmds,
    SHELL_CMD(status, NULL, "Show Ethernet interface, MAC, IPv4 and gateway", cmd_net_status),
    SHELL_SUBCMD_SET_END
);
#endif

SHELL_STATIC_SUBCMD_SET_CREATE(bench_cmds,
    SHELL_CMD(matrix, NULL, "Run all transport/direction combinations; port is matrix base", cmd_bench_matrix),
    SHELL_CMD(upload, NULL, "Run continuous upload benchmark", cmd_bench_upload),
    SHELL_CMD(download, NULL, "Run continuous download benchmark", cmd_bench_download),
    SHELL_CMD(full, NULL, "Run full-duplex benchmark", cmd_bench_full),
    SHELL_CMD(all, NULL, "Run upload, download and full-duplex", cmd_bench_all),
    SHELL_SUBCMD_SET_END
);






#if defined(CONFIG_NRF_MODEM_LIB)
static int cmd_modem_system(const struct shell *sh, size_t argc, char **argv)
{ ARG_UNUSED(argc); ARG_UNUSED(argv); return modem_status_system(sh); }
static int cmd_modem_health(const struct shell *sh, size_t argc, char **argv)
{ ARG_UNUSED(argc); ARG_UNUSED(argv); return modem_status_health(sh); }
static int cmd_modem_signal(const struct shell *sh, size_t argc, char **argv)
{ ARG_UNUSED(argc); ARG_UNUSED(argv); return modem_status_signal(sh); }
static int cmd_modem_network(const struct shell *sh, size_t argc, char **argv)
{ ARG_UNUSED(argc); ARG_UNUSED(argv); return modem_status_network(sh); }
static int cmd_modem_band(const struct shell *sh, size_t argc, char **argv)
{ ARG_UNUSED(argc); ARG_UNUSED(argv); return modem_status_band(sh); }
static int cmd_modem_packet(const struct shell *sh, size_t argc, char **argv)
{ ARG_UNUSED(argc); ARG_UNUSED(argv); return modem_status_packet(sh); }
static int cmd_modem_sleep(const struct shell *sh, size_t argc, char **argv)
{ ARG_UNUSED(argc); ARG_UNUSED(argv); return modem_status_sleep(sh); }
static int cmd_modem_apn(const struct shell *sh, size_t argc, char **argv)
{ ARG_UNUSED(argc); ARG_UNUSED(argv); return modem_status_apn(sh); }
static int cmd_modem_contexts(const struct shell *sh, size_t argc, char **argv)
{ ARG_UNUSED(argc); ARG_UNUSED(argv); return modem_status_contexts(sh); }
static int cmd_modem_all(const struct shell *sh, size_t argc, char **argv)
{ ARG_UNUSED(argc); ARG_UNUSED(argv); return modem_status_all(sh); }
static int cmd_modem_at(const struct shell *sh, size_t argc, char **argv)
{ return modem_status_at(sh, argc, argv); }

SHELL_STATIC_SUBCMD_SET_CREATE(modem_cmds,
    SHELL_CMD(system, NULL, "Show configured and currently attached radio system", cmd_modem_system),
    SHELL_CMD(health, NULL, "Show interpreted modem, radio and PDP summary", cmd_modem_health),
    SHELL_CMD(signal, NULL, "Show CESQ and serving-cell radio metrics", cmd_modem_signal),
    SHELL_CMD(network, NULL, "Show registration, RRC and functional mode", cmd_modem_network),
    SHELL_CMD(band, NULL, "Show current LTE band", cmd_modem_band),
    SHELL_CMD(packet, NULL, "Show packet-domain connection statistics", cmd_modem_packet),
    SHELL_CMD(sleep, NULL, "Show modem sleep, PSM and eDRX settings", cmd_modem_sleep),
    SHELL_CMD(apn, NULL, "Show configured and active PDP/APN contexts", cmd_modem_apn),
    SHELL_CMD(contexts, NULL, "Show PDP contexts and benchmark CID/PDN binding", cmd_modem_contexts),
    SHELL_CMD(all, NULL, "Show all available modem status information", cmd_modem_all),
    SHELL_CMD_ARG(at, NULL, "Run AT command: stcp modem at <AT command>", cmd_modem_at, 2, 15),
    SHELL_SUBCMD_SET_END
);

SHELL_STATIC_SUBCMD_SET_CREATE(stcp_cmds,
    SHELL_CMD(config, &config_cmds, "Runtime benchmark configuration", NULL),
    SHELL_CMD(bench, &bench_cmds, "Transport benchmarks", NULL),
#if defined(CONFIG_NET_NATIVE)
    SHELL_CMD_ARG(ping, NULL, "Ping IPv4 host: stcp ping <ip|name> [count] [timeout_ms]",
                  cmd_stcp_ping, 2, 2),
#endif
    SHELL_CMD(modem, &modem_cmds, "nRF modem status and radio diagnostics", NULL),
    SHELL_SUBCMD_SET_END
);

#else
SHELL_STATIC_SUBCMD_SET_CREATE(stcp_cmds,
    SHELL_CMD(config, &config_cmds, "Runtime benchmark configuration", NULL),
    SHELL_CMD(bench, &bench_cmds, "Transport benchmarks", NULL),
#if defined(CONFIG_NET_NATIVE)
    SHELL_CMD_ARG(ping, NULL, "Ping IPv4 host: stcp ping <ip|name> [count] [timeout_ms]",
                  cmd_stcp_ping, 2, 2),
#endif
#if defined(CONFIG_ETH_W5500)
    SHELL_CMD(net, &net_cmds, "Ethernet status and diagnostics", NULL),
#endif
    SHELL_SUBCMD_SET_END
);
#endif

SHELL_CMD_REGISTER(stcp, &stcp_cmds, "STCP transport test bench", NULL);
```

## src/echo_benchmark.h
```c
#ifndef STCP_ECHO_BENCHMARK_H
#define STCP_ECHO_BENCHMARK_H

#include <stdint.h>

enum bench_transport {
    BENCH_TRANSPORT_TCP = 0,
    BENCH_TRANSPORT_STCP = 1,
    BENCH_TRANSPORT_TLS = 2,
    BENCH_TRANSPORT_UDP = 3,
    BENCH_TRANSPORT_STCP_UDP = 4,
};

struct bench_config {
    char host[128];
    char port[8];
    uint32_t chunk_size;
    uint32_t total_bytes;
    uint32_t timeout_ms;
    uint32_t report_interval_ms;
    enum bench_transport transport;
};

struct bench_result {
    int status;
    uint32_t bytes_tx;
    uint32_t bytes_rx;
    int64_t elapsed_ms;
};

struct bench_summary {
    struct bench_result upload;
    struct bench_result download;
    struct bench_result full;
};

void bench_config_defaults(struct bench_config *cfg);
const char *bench_transport_name(enum bench_transport transport);
int bench_run_upload(const struct bench_config *cfg);
int bench_run_download(const struct bench_config *cfg);
int bench_run_full(const struct bench_config *cfg);
int bench_run_all(const struct bench_config *cfg);
int bench_run_matrix(const struct bench_config *cfg);
void bench_print_last_summary(const struct bench_config *cfg);
const struct bench_result *bench_get_last_result(const char *direction);
int echo_benchmark_run(void);

#endif
```

## src/ethernet_status.c
```c
#include "ethernet_status.h"

#include <errno.h>
#include <stdbool.h>
#include <stdio.h>

#include <zephyr/logging/log.h>
#include <zephyr/net/net_if.h>
#include <zephyr/net/net_ip.h>
#include <zephyr/sys/printk.h>

LOG_MODULE_REGISTER(ethernet_status, LOG_LEVEL_INF);

static const char *format_mac(const struct net_linkaddr *link, char *buffer,
                              size_t buffer_size)
{
    if (link == NULL || link->addr == NULL || link->len < 6U) {
        snprintf(buffer, buffer_size, "unavailable");
        return buffer;
    }

    snprintf(buffer, buffer_size, "%02x:%02x:%02x:%02x:%02x:%02x",
             link->addr[0], link->addr[1], link->addr[2],
             link->addr[3], link->addr[4], link->addr[5]);
    return buffer;
}

static const struct net_in_addr *current_ipv4_addr(struct net_if *iface)
{
    return net_if_ipv4_get_global_addr(iface, NET_ADDR_PREFERRED);
}

static void format_ipv4_runtime(struct net_if *iface,
                                char *address_buffer,
                                size_t address_buffer_size,
                                char *netmask_buffer,
                                size_t netmask_buffer_size,
                                char *gateway_buffer,
                                size_t gateway_buffer_size)
{
    const struct net_in_addr *address;
    struct net_in_addr netmask;
    struct net_in_addr gateway;

    snprintf(address_buffer, address_buffer_size, "unassigned");
    snprintf(netmask_buffer, netmask_buffer_size, "unavailable");
    snprintf(gateway_buffer, gateway_buffer_size, "unavailable");

    address = current_ipv4_addr(iface);
    if (address != NULL) {
        if (net_addr_ntop(AF_INET, address,
                          address_buffer, address_buffer_size) == NULL) {
            snprintf(address_buffer, address_buffer_size, "unassigned");
        }

        netmask = net_if_ipv4_get_netmask_by_addr(iface, address);
        if (net_addr_ntop(AF_INET, &netmask,
                          netmask_buffer, netmask_buffer_size) == NULL) {
            snprintf(netmask_buffer, netmask_buffer_size, "unavailable");
        }
    }

    gateway = net_if_ipv4_get_gw(iface);
    if (net_addr_ntop(AF_INET, &gateway,
                      gateway_buffer, gateway_buffer_size) == NULL) {
        snprintf(gateway_buffer, gateway_buffer_size, "unavailable");
    }
}

int ethernet_status_show(const struct shell *shell)
{
    struct net_if *iface = net_if_get_default();
    char mac[24];
    char ipv4[NET_IPV4_ADDR_LEN];
    char netmask[NET_IPV4_ADDR_LEN];
    char gateway[NET_IPV4_ADDR_LEN];

    if (iface == NULL) {
        shell_error(shell, "No default network interface");
        return -ENODEV;
    }

    format_mac(net_if_get_link_addr(iface), mac, sizeof(mac));
    format_ipv4_runtime(iface,
                        ipv4, sizeof(ipv4),
                        netmask, sizeof(netmask),
                        gateway, sizeof(gateway));

    shell_print(shell, "=== ETHERNET STATUS ===");
    shell_print(shell, "Interface : %d", net_if_get_by_iface(iface));
    shell_print(shell, "Admin up  : %s", net_if_is_up(iface) ? "yes" : "no");
    shell_print(shell, "Carrier   : %s", net_if_is_carrier_ok(iface) ? "up" : "down");
    shell_print(shell, "MAC       : %s", mac);
    shell_print(shell, "IPv4      : %s", ipv4);
    shell_print(shell, "Netmask   : %s", netmask);
    shell_print(shell, "Gateway   : %s", gateway);
    shell_print(shell, "DHCP      : disabled");
    shell_print(shell, "SPI limit : 8 MHz");
    shell_print(shell, "=======================");
    return 0;
}

void ethernet_status_log_startup(void)
{
    struct net_if *iface = net_if_get_default();
    char mac[24];
    char ipv4[NET_IPV4_ADDR_LEN];
    char netmask[NET_IPV4_ADDR_LEN];
    char gateway[NET_IPV4_ADDR_LEN];

    if (iface == NULL) {
        LOG_ERR("No default Ethernet interface");
        return;
    }

    format_mac(net_if_get_link_addr(iface), mac, sizeof(mac));
    format_ipv4_runtime(iface,
                        ipv4, sizeof(ipv4),
                        netmask, sizeof(netmask),
                        gateway, sizeof(gateway));

    LOG_INF("Ethernet iface=%d admin=%s carrier=%s mac=%s",
            net_if_get_by_iface(iface),
            net_if_is_up(iface) ? "up" : "down",
            net_if_is_carrier_ok(iface) ? "up" : "down",
            mac);
    LOG_INF("Ethernet IPv4=%s netmask=%s gateway=%s DHCP=off SPI=8MHz",
            ipv4, netmask, gateway);
}
```

## src/mqtt_codec.h
```c
#ifndef MQTT_CODEC_H
#define MQTT_CODEC_H
#include <stddef.h>
#include <stdint.h>
int mqtt_send_connect(int fd,const char *client_id,uint16_t keepalive);
int mqtt_wait_connack(int fd,int timeout_ms);
int mqtt_send_subscribe(int fd,const char *topic,uint16_t packet_id);
int mqtt_send_publish_qos1(int fd,const char *topic,const void *payload,size_t len,uint16_t packet_id);
int mqtt_send_puback(int fd,uint16_t packet_id);
int mqtt_send_pingreq(int fd);
int mqtt_recv_packet(int fd,uint8_t *type,uint8_t *flags,uint8_t *buf,size_t cap,size_t *len,int timeout_ms);
#endif
```

## src/stcp_bench_diag.h
```c
#ifndef STCP_BENCH_DIAG_H
#define STCP_BENCH_DIAG_H
#include <stdint.h>
#include <zephyr/sys/printk.h>
struct stcp_bench_diag {
    uint64_t send_attempts, send_busy, send_errors, send_total_us, send_max_us;
    uint64_t recv_calls, rx_packets, rx_bytes, rx_errors, rx_total_us, rx_max_us;
    uint64_t rx_drops; /* Unknown unless connected to a driver counter; currently 0. */
};
static inline void stcp_bench_diag_print(const char *transport, const char *direction,
                                         const struct stcp_bench_diag *d)
{
    printk("BENCH_NET_DIAG transport=%s direction=%s send_attempts=%llu send_busy=%llu "
           "send_errors=%llu send_total_us=%llu send_max_us=%llu "
           "recv_calls=%llu rx_packets=%llu rx_bytes=%llu rx_errors=%llu "
           "rx_total_us=%llu rx_max_us=%llu rx_drops=%llu\n",
           transport, direction,
           (unsigned long long)d->send_attempts,
           (unsigned long long)d->send_busy,
           (unsigned long long)d->send_errors,
           (unsigned long long)d->send_total_us,
           (unsigned long long)d->send_max_us,
           (unsigned long long)d->recv_calls,
           (unsigned long long)d->rx_packets,
           (unsigned long long)d->rx_bytes,
           (unsigned long long)d->rx_errors,
           (unsigned long long)d->rx_total_us,
           (unsigned long long)d->rx_max_us,
           (unsigned long long)d->rx_drops);
}
#endif
```
