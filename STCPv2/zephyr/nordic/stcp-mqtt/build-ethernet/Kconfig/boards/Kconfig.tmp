## STCPv2/zephyr/nordic/stcp-mqtt/build-ethernet/Kconfig/boards/Kconfig.tmp
```kconfig
# Load Zephyr board Kconfig descriptions.
osource "/home/pomo/git/STCP/STCPv2/zephyr/nordic/ncs-3.3.0/zephyr/boards/nordic/nrf9151dk/Kconfig"
```

## STCPv2/zephyr/nordic/stcp-mqtt/build-nrf9151/Kconfig/arch/Kconfig
```kconfig
# Load Zephyr Arch Kconfig descriptions.
osource "/home/pomo/git/STCP/STCPv2/zephyr/nordic/ncs-3.3.0/zephyr/arch/rx/Kconfig"
osource "/home/pomo/git/STCP/STCPv2/zephyr/nordic/ncs-3.3.0/zephyr/arch/x86/Kconfig"
osource "/home/pomo/git/STCP/STCPv2/zephyr/nordic/ncs-3.3.0/zephyr/arch/xtensa/Kconfig"
osource "/home/pomo/git/STCP/STCPv2/zephyr/nordic/ncs-3.3.0/zephyr/arch/sparc/Kconfig"
osource "/home/pomo/git/STCP/STCPv2/zephyr/nordic/ncs-3.3.0/zephyr/arch/riscv/Kconfig"
osource "/home/pomo/git/STCP/STCPv2/zephyr/nordic/ncs-3.3.0/zephyr/arch/posix/Kconfig"
osource "/home/pomo/git/STCP/STCPv2/zephyr/nordic/ncs-3.3.0/zephyr/arch/mips/Kconfig"
osource "/home/pomo/git/STCP/STCPv2/zephyr/nordic/ncs-3.3.0/zephyr/arch/arm64/Kconfig"
osource "/home/pomo/git/STCP/STCPv2/zephyr/nordic/ncs-3.3.0/zephyr/arch/arm/Kconfig"
osource "/home/pomo/git/STCP/STCPv2/zephyr/nordic/ncs-3.3.0/zephyr/arch/arc/Kconfig"
```

## STCPv2/zephyr/nordic/stcp-mqtt/build-nrf9151/stcp-mqtt/Kconfig/soc/Kconfig
```kconfig
# Load Zephyr SoC Kconfig descriptions.
osource "/home/pomo/git/STCP/STCPv2/zephyr/nordic/ncs-3.3.0/zephyr/soc/xlnx/zynqmp/Kconfig"
osource "/home/pomo/git/STCP/STCPv2/zephyr/nordic/ncs-3.3.0/zephyr/soc/xlnx/zynq7000/Kconfig"
osource "/home/pomo/git/STCP/STCPv2/zephyr/nordic/ncs-3.3.0/zephyr/soc/xlnx/versalnet/Kconfig"
osource "/home/pomo/git/STCP/STCPv2/zephyr/nordic/ncs-3.3.0/zephyr/soc/xlnx/versal2/Kconfig"
osource "/home/pomo/git/STCP/STCPv2/zephyr/nordic/ncs-3.3.0/zephyr/soc/xlnx/versal/Kconfig"
osource "/home/pomo/git/STCP/STCPv2/zephyr/nordic/ncs-3.3.0/zephyr/soc/xen/Kconfig"
osource "/home/pomo/git/STCP/STCPv2/zephyr/nordic/ncs-3.3.0/zephyr/soc/wch/ch32v/Kconfig"
osource "/home/pomo/git/STCP/STCPv2/zephyr/nordic/ncs-3.3.0/zephyr/soc/ti/simplelink/Kconfig"
osource "/home/pomo/git/STCP/STCPv2/zephyr/nordic/ncs-3.3.0/zephyr/soc/ti/mspm0/Kconfig"
osource "/home/pomo/git/STCP/STCPv2/zephyr/nordic/ncs-3.3.0/zephyr/soc/ti/lm3s6965/Kconfig"
osource "/home/pomo/git/STCP/STCPv2/zephyr/nordic/ncs-3.3.0/zephyr/soc/ti/k3/Kconfig"
osource "/home/pomo/git/STCP/STCPv2/zephyr/nordic/ncs-3.3.0/zephyr/soc/telink/tlsr/Kconfig"
osource "/home/pomo/git/STCP/STCPv2/zephyr/nordic/ncs-3.3.0/zephyr/soc/starfive/jh71xx/Kconfig"
osource "/home/pomo/git/STCP/STCPv2/zephyr/nordic/ncs-3.3.0/zephyr/soc/st/stm32/Kconfig"
osource "/home/pomo/git/STCP/STCPv2/zephyr/nordic/ncs-3.3.0/zephyr/soc/snps/qemu_arc/Kconfig"
osource "/home/pomo/git/STCP/STCPv2/zephyr/nordic/ncs-3.3.0/zephyr/soc/snps/nsim/arc_v/Kconfig"
osource "/home/pomo/git/STCP/STCPv2/zephyr/nordic/ncs-3.3.0/zephyr/soc/snps/nsim/arc_classic/Kconfig"
osource "/home/pomo/git/STCP/STCPv2/zephyr/nordic/ncs-3.3.0/zephyr/soc/snps/hsdk4xd/Kconfig"
osource "/home/pomo/git/STCP/STCPv2/zephyr/nordic/ncs-3.3.0/zephyr/soc/snps/hsdk/Kconfig"
osource "/home/pomo/git/STCP/STCPv2/zephyr/nordic/ncs-3.3.0/zephyr/soc/snps/emsk/Kconfig"
osource "/home/pomo/git/STCP/STCPv2/zephyr/nordic/ncs-3.3.0/zephyr/soc/snps/emsdp/Kconfig"
osource "/home/pomo/git/STCP/STCPv2/zephyr/nordic/ncs-3.3.0/zephyr/soc/snps/arc_iot/Kconfig"
osource "/home/pomo/git/STCP/STCPv2/zephyr/nordic/ncs-3.3.0/zephyr/soc/silabs/Kconfig"
osource "/home/pomo/git/STCP/STCPv2/zephyr/nordic/ncs-3.3.0/zephyr/soc/sifli/sf32/Kconfig"
osource "/home/pomo/git/STCP/STCPv2/zephyr/nordic/ncs-3.3.0/zephyr/soc/sifive/sifive_freedom/Kconfig"
osource "/home/pomo/git/STCP/STCPv2/zephyr/nordic/ncs-3.3.0/zephyr/soc/sensry/Kconfig"
osource "/home/pomo/git/STCP/STCPv2/zephyr/nordic/ncs-3.3.0/zephyr/soc/rockchip/Kconfig"
osource "/home/pomo/git/STCP/STCPv2/zephyr/nordic/ncs-3.3.0/zephyr/soc/renode/riscv_virtual/Kconfig"
osource "/home/pomo/git/STCP/STCPv2/zephyr/nordic/ncs-3.3.0/zephyr/soc/renode/cortex_r8_virtual/Kconfig"
osource "/home/pomo/git/STCP/STCPv2/zephyr/nordic/ncs-3.3.0/zephyr/soc/renesas/smartbond/Kconfig"
osource "/home/pomo/git/STCP/STCPv2/zephyr/nordic/ncs-3.3.0/zephyr/soc/renesas/rz/Kconfig"
osource "/home/pomo/git/STCP/STCPv2/zephyr/nordic/ncs-3.3.0/zephyr/soc/renesas/rx/Kconfig"
osource "/home/pomo/git/STCP/STCPv2/zephyr/nordic/ncs-3.3.0/zephyr/soc/renesas/rcar/Kconfig"
osource "/home/pomo/git/STCP/STCPv2/zephyr/nordic/ncs-3.3.0/zephyr/soc/renesas/ra/Kconfig"
osource "/home/pomo/git/STCP/STCPv2/zephyr/nordic/ncs-3.3.0/zephyr/soc/realtek/ec/Kconfig"
osource "/home/pomo/git/STCP/STCPv2/zephyr/nordic/ncs-3.3.0/zephyr/soc/realtek/ameba/Kconfig"
osource "/home/pomo/git/STCP/STCPv2/zephyr/nordic/ncs-3.3.0/zephyr/soc/raspberrypi/rpi_pico/Kconfig"
osource "/home/pomo/git/STCP/STCPv2/zephyr/nordic/ncs-3.3.0/zephyr/soc/quicklogic/eos_s3/Kconfig"
osource "/home/pomo/git/STCP/STCPv2/zephyr/nordic/ncs-3.3.0/zephyr/soc/qemu/virt_riscv/Kconfig"
osource "/home/pomo/git/STCP/STCPv2/zephyr/nordic/ncs-3.3.0/zephyr/soc/qemu/malta/Kconfig"
osource "/home/pomo/git/STCP/STCPv2/zephyr/nordic/ncs-3.3.0/zephyr/soc/openisa/rv32m1/Kconfig"
osource "/home/pomo/git/STCP/STCPv2/zephyr/nordic/ncs-3.3.0/zephyr/soc/openhwgroup/cva6/Kconfig"
osource "/home/pomo/git/STCP/STCPv2/zephyr/nordic/ncs-3.3.0/zephyr/soc/oct/osd32mp15x/Kconfig"
osource "/home/pomo/git/STCP/STCPv2/zephyr/nordic/ncs-3.3.0/zephyr/soc/nxp/s32/Kconfig"
osource "/home/pomo/git/STCP/STCPv2/zephyr/nordic/ncs-3.3.0/zephyr/soc/nxp/rw/Kconfig"
osource "/home/pomo/git/STCP/STCPv2/zephyr/nordic/ncs-3.3.0/zephyr/soc/nxp/mcx/Kconfig"
osource "/home/pomo/git/STCP/STCPv2/zephyr/nordic/ncs-3.3.0/zephyr/soc/nxp/lpc/Kconfig"
osource "/home/pomo/git/STCP/STCPv2/zephyr/nordic/ncs-3.3.0/zephyr/soc/nxp/layerscape/Kconfig"
osource "/home/pomo/git/STCP/STCPv2/zephyr/nordic/ncs-3.3.0/zephyr/soc/nxp/kinetis/Kconfig"
osource "/home/pomo/git/STCP/STCPv2/zephyr/nordic/ncs-3.3.0/zephyr/soc/nxp/imxrt/Kconfig"
osource "/home/pomo/git/STCP/STCPv2/zephyr/nordic/ncs-3.3.0/zephyr/soc/nxp/imx/Kconfig"
osource "/home/pomo/git/STCP/STCPv2/zephyr/nordic/ncs-3.3.0/zephyr/soc/nuvoton/numicro/Kconfig"
osource "/home/pomo/git/STCP/STCPv2/zephyr/nordic/ncs-3.3.0/zephyr/soc/nuvoton/numaker/Kconfig"
osource "/home/pomo/git/STCP/STCPv2/zephyr/nordic/ncs-3.3.0/zephyr/soc/nuvoton/npcx/Kconfig"
osource "/home/pomo/git/STCP/STCPv2/zephyr/nordic/ncs-3.3.0/zephyr/soc/nuvoton/npcm/Kconfig"
osource "/home/pomo/git/STCP/STCPv2/zephyr/nordic/ncs-3.3.0/zephyr/soc/nordic/Kconfig"
osource "/home/pomo/git/STCP/STCPv2/zephyr/nordic/ncs-3.3.0/zephyr/soc/neorv32/Kconfig"
osource "/home/pomo/git/STCP/STCPv2/zephyr/nordic/ncs-3.3.0/zephyr/soc/native/inf_clock/Kconfig"
osource "/home/pomo/git/STCP/STCPv2/zephyr/nordic/ncs-3.3.0/zephyr/soc/microchip/sam/sama7/Kconfig"
osource "/home/pomo/git/STCP/STCPv2/zephyr/nordic/ncs-3.3.0/zephyr/soc/microchip/sam/sam_d5x_e5x/Kconfig"
osource "/home/pomo/git/STCP/STCPv2/zephyr/nordic/ncs-3.3.0/zephyr/soc/microchip/pic64/Kconfig"
osource "/home/pomo/git/STCP/STCPv2/zephyr/nordic/ncs-3.3.0/zephyr/soc/microchip/pic32c/pic32cz_ca/Kconfig"
osource "/home/pomo/git/STCP/STCPv2/zephyr/nordic/ncs-3.3.0/zephyr/soc/microchip/pic32c/pic32cx_sg/Kconfig"
osource "/home/pomo/git/STCP/STCPv2/zephyr/nordic/ncs-3.3.0/zephyr/soc/microchip/pic32c/pic32cm_jh/Kconfig"
osource "/home/pomo/git/STCP/STCPv2/zephyr/nordic/ncs-3.3.0/zephyr/soc/microchip/miv/Kconfig"
osource "/home/pomo/git/STCP/STCPv2/zephyr/nordic/ncs-3.3.0/zephyr/soc/microchip/mec/Kconfig"
osource "/home/pomo/git/STCP/STCPv2/zephyr/nordic/ncs-3.3.0/zephyr/soc/mediatek/mt8xxx/Kconfig"
osource "/home/pomo/git/STCP/STCPv2/zephyr/nordic/ncs-3.3.0/zephyr/soc/lowrisc/opentitan/Kconfig"
osource "/home/pomo/git/STCP/STCPv2/zephyr/nordic/ncs-3.3.0/zephyr/soc/litex/litex_vexriscv/Kconfig"
osource "/home/pomo/git/STCP/STCPv2/zephyr/nordic/ncs-3.3.0/zephyr/soc/ite/ec/Kconfig"
osource "/home/pomo/git/STCP/STCPv2/zephyr/nordic/ncs-3.3.0/zephyr/soc/intel/wildcat_lake/Kconfig"
osource "/home/pomo/git/STCP/STCPv2/zephyr/nordic/ncs-3.3.0/zephyr/soc/intel/raptor_lake/Kconfig"
osource "/home/pomo/git/STCP/STCPv2/zephyr/nordic/ncs-3.3.0/zephyr/soc/intel/panther_lake/Kconfig"
osource "/home/pomo/git/STCP/STCPv2/zephyr/nordic/ncs-3.3.0/zephyr/soc/intel/lakemont/Kconfig"
osource "/home/pomo/git/STCP/STCPv2/zephyr/nordic/ncs-3.3.0/zephyr/soc/intel/intel_socfpga_std/Kconfig"
osource "/home/pomo/git/STCP/STCPv2/zephyr/nordic/ncs-3.3.0/zephyr/soc/intel/intel_socfpga/Kconfig"
osource "/home/pomo/git/STCP/STCPv2/zephyr/nordic/ncs-3.3.0/zephyr/soc/intel/intel_niosv/Kconfig"
osource "/home/pomo/git/STCP/STCPv2/zephyr/nordic/ncs-3.3.0/zephyr/soc/intel/intel_ish/Kconfig"
osource "/home/pomo/git/STCP/STCPv2/zephyr/nordic/ncs-3.3.0/zephyr/soc/intel/intel_adsp/Kconfig"
osource "/home/pomo/git/STCP/STCPv2/zephyr/nordic/ncs-3.3.0/zephyr/soc/intel/elkhart_lake/Kconfig"
osource "/home/pomo/git/STCP/STCPv2/zephyr/nordic/ncs-3.3.0/zephyr/soc/intel/atom/Kconfig"
osource "/home/pomo/git/STCP/STCPv2/zephyr/nordic/ncs-3.3.0/zephyr/soc/intel/apollo_lake/Kconfig"
osource "/home/pomo/git/STCP/STCPv2/zephyr/nordic/ncs-3.3.0/zephyr/soc/intel/alder_lake/Kconfig"
osource "/home/pomo/git/STCP/STCPv2/zephyr/nordic/ncs-3.3.0/zephyr/soc/infineon/psoc4/Kconfig"
osource "/home/pomo/git/STCP/STCPv2/zephyr/nordic/ncs-3.3.0/zephyr/soc/infineon/edge/Kconfig"
osource "/home/pomo/git/STCP/STCPv2/zephyr/nordic/ncs-3.3.0/zephyr/soc/infineon/cat3/Kconfig"
osource "/home/pomo/git/STCP/STCPv2/zephyr/nordic/ncs-3.3.0/zephyr/soc/infineon/cat1c/Kconfig"
osource "/home/pomo/git/STCP/STCPv2/zephyr/nordic/ncs-3.3.0/zephyr/soc/infineon/cat1b/Kconfig"
osource "/home/pomo/git/STCP/STCPv2/zephyr/nordic/ncs-3.3.0/zephyr/soc/infineon/cat1a/Kconfig"
osource "/home/pomo/git/STCP/STCPv2/zephyr/nordic/ncs-3.3.0/zephyr/soc/gd/gd32/Kconfig"
osource "/home/pomo/git/STCP/STCPv2/zephyr/nordic/ncs-3.3.0/zephyr/soc/gaisler/leon3/Kconfig"
osource "/home/pomo/git/STCP/STCPv2/zephyr/nordic/ncs-3.3.0/zephyr/soc/gaisler/gr716a/Kconfig"
osource "/home/pomo/git/STCP/STCPv2/zephyr/nordic/ncs-3.3.0/zephyr/soc/focaltech/Kconfig"
osource "/home/pomo/git/STCP/STCPv2/zephyr/nordic/ncs-3.3.0/zephyr/soc/espressif/Kconfig"
osource "/home/pomo/git/STCP/STCPv2/zephyr/nordic/ncs-3.3.0/zephyr/soc/ene/kb1200/Kconfig"
osource "/home/pomo/git/STCP/STCPv2/zephyr/nordic/ncs-3.3.0/zephyr/soc/ene/kb106x/Kconfig"
osource "/home/pomo/git/STCP/STCPv2/zephyr/nordic/ncs-3.3.0/zephyr/soc/elan/em32f967/Kconfig"
osource "/home/pomo/git/STCP/STCPv2/zephyr/nordic/ncs-3.3.0/zephyr/soc/egis/Kconfig"
osource "/home/pomo/git/STCP/STCPv2/zephyr/nordic/ncs-3.3.0/zephyr/soc/efinix/sapphire/Kconfig"
osource "/home/pomo/git/STCP/STCPv2/zephyr/nordic/ncs-3.3.0/zephyr/soc/cdns/xtensa_sample_controller/Kconfig"
osource "/home/pomo/git/STCP/STCPv2/zephyr/nordic/ncs-3.3.0/zephyr/soc/cdns/sample_controller32/Kconfig"
osource "/home/pomo/git/STCP/STCPv2/zephyr/nordic/ncs-3.3.0/zephyr/soc/cdns/dc233c/Kconfig"
osource "/home/pomo/git/STCP/STCPv2/zephyr/nordic/ncs-3.3.0/zephyr/soc/brcm/bcmvk/Kconfig"
osource "/home/pomo/git/STCP/STCPv2/zephyr/nordic/ncs-3.3.0/zephyr/soc/brcm/bcm2712/Kconfig"
osource "/home/pomo/git/STCP/STCPv2/zephyr/nordic/ncs-3.3.0/zephyr/soc/brcm/bcm2711/Kconfig"
osource "/home/pomo/git/STCP/STCPv2/zephyr/nordic/ncs-3.3.0/zephyr/soc/blackberry/qnxhv_vm/Kconfig"
osource "/home/pomo/git/STCP/STCPv2/zephyr/nordic/ncs-3.3.0/zephyr/soc/bflb/Kconfig"
osource "/home/pomo/git/STCP/STCPv2/zephyr/nordic/ncs-3.3.0/zephyr/soc/atmel/sam0/Kconfig"
osource "/home/pomo/git/STCP/STCPv2/zephyr/nordic/ncs-3.3.0/zephyr/soc/atmel/sam/Kconfig"
osource "/home/pomo/git/STCP/STCPv2/zephyr/nordic/ncs-3.3.0/zephyr/soc/aspeed/Kconfig"
osource "/home/pomo/git/STCP/STCPv2/zephyr/nordic/ncs-3.3.0/zephyr/soc/arm/Kconfig"
osource "/home/pomo/git/STCP/STCPv2/zephyr/nordic/ncs-3.3.0/zephyr/soc/arm/beetle/Kconfig"
osource "/home/pomo/git/STCP/STCPv2/zephyr/nordic/ncs-3.3.0/zephyr/soc/antmicro/myra/Kconfig"
osource "/home/pomo/git/STCP/STCPv2/zephyr/nordic/ncs-3.3.0/zephyr/soc/andestech/Kconfig"
osource "/home/pomo/git/STCP/STCPv2/zephyr/nordic/ncs-3.3.0/zephyr/soc/amd/acp_6_0/Kconfig"
osource "/home/pomo/git/STCP/STCPv2/zephyr/nordic/ncs-3.3.0/zephyr/soc/ambiq/Kconfig"
osource "/home/pomo/git/STCP/STCPv2/zephyr/nordic/ncs-3.3.0/zephyr/soc/allwinner/sun8i_h3/Kconfig"
osource "/home/pomo/git/STCP/STCPv2/zephyr/nordic/ncs-3.3.0/zephyr/soc/aesc/Kconfig"
osource "/home/pomo/git/STCP/STCPv2/zephyr/nordic/ncs-3.3.0/zephyr/soc/adi/max32/Kconfig"
osource "/home/pomo/git/STCP/STCPv2/zephyr/nordic/ncs-3.3.0/nrf/soc/sercomm/nrf91/Kconfig"
osource "/home/pomo/git/STCP/STCPv2/zephyr/nordic/ncs-3.3.0/nrf/soc/nordic/Kconfig"
```

## kernel-module/Kconfig
```kconfig
config STCP
	tristate "STCP protocol (Secure TCP)"
	depends on NET && INET && CRYPTO
	default m
	help
	  Secure TCP (STCP) kernel protocol.
	  
	  STCP adds a new socket protocol (IPPROTO 253) providing
	  encrypted communication on top of the kernel TCP stack.
	  It performs an elliptic-curve based key exchange and then
	  uses AES encryption for the data channel.
	        
	  The API mimics BSD sockets, allowing STCP to act as a
	  drop-in replacement for TCP in userspace programs.
	        
	  If unsure, select N.

if STCP

config STCP_DEBUG
	bool "Enable STCP debug prints"
	default y
	help
	  Enables pr_debug() and module parameter controlled prints.

endif # STCP
```
