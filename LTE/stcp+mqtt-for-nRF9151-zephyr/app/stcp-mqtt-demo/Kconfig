## LTE/stcp+mqtt-for-nRF9151-zephyr/app/stcp-mqtt-demo/golden/1.4.2026-build/stcp-mqtt-demo/Kconfig/soc/Kconfig
```kconfig
# Load Zephyr SoC Kconfig descriptions.
osource "/home/pomo/ncs/zephyr/soc/xlnx/zynqmp/Kconfig"
osource "/home/pomo/ncs/zephyr/soc/xlnx/zynq7000/Kconfig"
osource "/home/pomo/ncs/zephyr/soc/xlnx/versalnet/Kconfig"
osource "/home/pomo/ncs/zephyr/soc/xlnx/versal2/Kconfig"
osource "/home/pomo/ncs/zephyr/soc/xlnx/versal/Kconfig"
osource "/home/pomo/ncs/zephyr/soc/xen/Kconfig"
osource "/home/pomo/ncs/zephyr/soc/wch/ch32v/Kconfig"
osource "/home/pomo/ncs/zephyr/soc/ti/simplelink/Kconfig"
osource "/home/pomo/ncs/zephyr/soc/ti/mspm0/Kconfig"
osource "/home/pomo/ncs/zephyr/soc/ti/lm3s6965/Kconfig"
osource "/home/pomo/ncs/zephyr/soc/ti/k3/Kconfig"
osource "/home/pomo/ncs/zephyr/soc/telink/tlsr/Kconfig"
osource "/home/pomo/ncs/zephyr/soc/starfive/jh71xx/Kconfig"
osource "/home/pomo/ncs/zephyr/soc/st/stm32/Kconfig"
osource "/home/pomo/ncs/zephyr/soc/snps/qemu_arc/Kconfig"
osource "/home/pomo/ncs/zephyr/soc/snps/nsim/arc_v/Kconfig"
osource "/home/pomo/ncs/zephyr/soc/snps/nsim/arc_classic/Kconfig"
osource "/home/pomo/ncs/zephyr/soc/snps/hsdk4xd/Kconfig"
osource "/home/pomo/ncs/zephyr/soc/snps/hsdk/Kconfig"
osource "/home/pomo/ncs/zephyr/soc/snps/emsk/Kconfig"
osource "/home/pomo/ncs/zephyr/soc/snps/emsdp/Kconfig"
osource "/home/pomo/ncs/zephyr/soc/snps/arc_iot/Kconfig"
osource "/home/pomo/ncs/zephyr/soc/silabs/Kconfig"
osource "/home/pomo/ncs/zephyr/soc/sifli/sf32/Kconfig"
osource "/home/pomo/ncs/zephyr/soc/sifive/sifive_freedom/Kconfig"
osource "/home/pomo/ncs/zephyr/soc/sensry/Kconfig"
osource "/home/pomo/ncs/zephyr/soc/rockchip/Kconfig"
osource "/home/pomo/ncs/zephyr/soc/renode/riscv_virtual/Kconfig"
osource "/home/pomo/ncs/zephyr/soc/renode/cortex_r8_virtual/Kconfig"
osource "/home/pomo/ncs/zephyr/soc/renesas/smartbond/Kconfig"
osource "/home/pomo/ncs/zephyr/soc/renesas/rz/Kconfig"
osource "/home/pomo/ncs/zephyr/soc/renesas/rx/Kconfig"
osource "/home/pomo/ncs/zephyr/soc/renesas/rcar/Kconfig"
osource "/home/pomo/ncs/zephyr/soc/renesas/ra/Kconfig"
osource "/home/pomo/ncs/zephyr/soc/realtek/ec/Kconfig"
osource "/home/pomo/ncs/zephyr/soc/realtek/ameba/Kconfig"
osource "/home/pomo/ncs/zephyr/soc/raspberrypi/rpi_pico/Kconfig"
osource "/home/pomo/ncs/zephyr/soc/quicklogic/eos_s3/Kconfig"
osource "/home/pomo/ncs/zephyr/soc/qemu/virt_riscv/Kconfig"
osource "/home/pomo/ncs/zephyr/soc/qemu/malta/Kconfig"
osource "/home/pomo/ncs/zephyr/soc/openisa/rv32m1/Kconfig"
osource "/home/pomo/ncs/zephyr/soc/openhwgroup/cva6/Kconfig"
osource "/home/pomo/ncs/zephyr/soc/oct/osd32mp15x/Kconfig"
osource "/home/pomo/ncs/zephyr/soc/nxp/s32/Kconfig"
osource "/home/pomo/ncs/zephyr/soc/nxp/rw/Kconfig"
osource "/home/pomo/ncs/zephyr/soc/nxp/mcx/Kconfig"
osource "/home/pomo/ncs/zephyr/soc/nxp/lpc/Kconfig"
osource "/home/pomo/ncs/zephyr/soc/nxp/layerscape/Kconfig"
osource "/home/pomo/ncs/zephyr/soc/nxp/kinetis/Kconfig"
osource "/home/pomo/ncs/zephyr/soc/nxp/imxrt/Kconfig"
osource "/home/pomo/ncs/zephyr/soc/nxp/imx/Kconfig"
osource "/home/pomo/ncs/zephyr/soc/nuvoton/numicro/Kconfig"
osource "/home/pomo/ncs/zephyr/soc/nuvoton/numaker/Kconfig"
osource "/home/pomo/ncs/zephyr/soc/nuvoton/npcx/Kconfig"
osource "/home/pomo/ncs/zephyr/soc/nuvoton/npcm/Kconfig"
osource "/home/pomo/ncs/zephyr/soc/nordic/Kconfig"
osource "/home/pomo/ncs/zephyr/soc/neorv32/Kconfig"
osource "/home/pomo/ncs/zephyr/soc/native/inf_clock/Kconfig"
osource "/home/pomo/ncs/zephyr/soc/microchip/sam/sama7/Kconfig"
osource "/home/pomo/ncs/zephyr/soc/microchip/sam/sam_d5x_e5x/Kconfig"
osource "/home/pomo/ncs/zephyr/soc/microchip/pic64/Kconfig"
osource "/home/pomo/ncs/zephyr/soc/microchip/pic32c/pic32cz_ca/Kconfig"
osource "/home/pomo/ncs/zephyr/soc/microchip/pic32c/pic32cx_sg/Kconfig"
osource "/home/pomo/ncs/zephyr/soc/microchip/pic32c/pic32cm_jh/Kconfig"
osource "/home/pomo/ncs/zephyr/soc/microchip/miv/Kconfig"
osource "/home/pomo/ncs/zephyr/soc/microchip/mec/Kconfig"
osource "/home/pomo/ncs/zephyr/soc/mediatek/mt8xxx/Kconfig"
osource "/home/pomo/ncs/zephyr/soc/lowrisc/opentitan/Kconfig"
osource "/home/pomo/ncs/zephyr/soc/litex/litex_vexriscv/Kconfig"
osource "/home/pomo/ncs/zephyr/soc/ite/ec/Kconfig"
osource "/home/pomo/ncs/zephyr/soc/intel/wildcat_lake/Kconfig"
osource "/home/pomo/ncs/zephyr/soc/intel/raptor_lake/Kconfig"
osource "/home/pomo/ncs/zephyr/soc/intel/panther_lake/Kconfig"
osource "/home/pomo/ncs/zephyr/soc/intel/lakemont/Kconfig"
osource "/home/pomo/ncs/zephyr/soc/intel/intel_socfpga_std/Kconfig"
osource "/home/pomo/ncs/zephyr/soc/intel/intel_socfpga/Kconfig"
osource "/home/pomo/ncs/zephyr/soc/intel/intel_niosv/Kconfig"
osource "/home/pomo/ncs/zephyr/soc/intel/intel_ish/Kconfig"
osource "/home/pomo/ncs/zephyr/soc/intel/intel_adsp/Kconfig"
osource "/home/pomo/ncs/zephyr/soc/intel/elkhart_lake/Kconfig"
osource "/home/pomo/ncs/zephyr/soc/intel/atom/Kconfig"
osource "/home/pomo/ncs/zephyr/soc/intel/apollo_lake/Kconfig"
osource "/home/pomo/ncs/zephyr/soc/intel/alder_lake/Kconfig"
osource "/home/pomo/ncs/zephyr/soc/infineon/psoc4/Kconfig"
osource "/home/pomo/ncs/zephyr/soc/infineon/edge/Kconfig"
osource "/home/pomo/ncs/zephyr/soc/infineon/cat3/Kconfig"
osource "/home/pomo/ncs/zephyr/soc/infineon/cat1c/Kconfig"
osource "/home/pomo/ncs/zephyr/soc/infineon/cat1b/Kconfig"
osource "/home/pomo/ncs/zephyr/soc/infineon/cat1a/Kconfig"
osource "/home/pomo/ncs/zephyr/soc/gd/gd32/Kconfig"
osource "/home/pomo/ncs/zephyr/soc/gaisler/leon3/Kconfig"
osource "/home/pomo/ncs/zephyr/soc/gaisler/gr716a/Kconfig"
osource "/home/pomo/ncs/zephyr/soc/focaltech/Kconfig"
osource "/home/pomo/ncs/zephyr/soc/espressif/Kconfig"
osource "/home/pomo/ncs/zephyr/soc/ene/kb1200/Kconfig"
osource "/home/pomo/ncs/zephyr/soc/ene/kb106x/Kconfig"
osource "/home/pomo/ncs/zephyr/soc/elan/em32f967/Kconfig"
osource "/home/pomo/ncs/zephyr/soc/egis/Kconfig"
osource "/home/pomo/ncs/zephyr/soc/efinix/sapphire/Kconfig"
osource "/home/pomo/ncs/zephyr/soc/cdns/xtensa_sample_controller/Kconfig"
osource "/home/pomo/ncs/zephyr/soc/cdns/sample_controller32/Kconfig"
osource "/home/pomo/ncs/zephyr/soc/cdns/dc233c/Kconfig"
osource "/home/pomo/ncs/zephyr/soc/brcm/bcmvk/Kconfig"
osource "/home/pomo/ncs/zephyr/soc/brcm/bcm2712/Kconfig"
osource "/home/pomo/ncs/zephyr/soc/brcm/bcm2711/Kconfig"
osource "/home/pomo/ncs/zephyr/soc/blackberry/qnxhv_vm/Kconfig"
osource "/home/pomo/ncs/zephyr/soc/bflb/Kconfig"
osource "/home/pomo/ncs/zephyr/soc/atmel/sam0/Kconfig"
osource "/home/pomo/ncs/zephyr/soc/atmel/sam/Kconfig"
osource "/home/pomo/ncs/zephyr/soc/aspeed/Kconfig"
osource "/home/pomo/ncs/zephyr/soc/arm/Kconfig"
osource "/home/pomo/ncs/zephyr/soc/arm/beetle/Kconfig"
osource "/home/pomo/ncs/zephyr/soc/antmicro/myra/Kconfig"
osource "/home/pomo/ncs/zephyr/soc/andestech/Kconfig"
osource "/home/pomo/ncs/zephyr/soc/amd/acp_6_0/Kconfig"
osource "/home/pomo/ncs/zephyr/soc/ambiq/Kconfig"
osource "/home/pomo/ncs/zephyr/soc/allwinner/sun8i_h3/Kconfig"
osource "/home/pomo/ncs/zephyr/soc/aesc/Kconfig"
osource "/home/pomo/ncs/zephyr/soc/adi/max32/Kconfig"
osource "/home/pomo/ncs/nrf/soc/sercomm/nrf91/Kconfig"
osource "/home/pomo/ncs/nrf/soc/nordic/Kconfig"
```

## STCP_integrations/Zephyr/nRF9161dk/modules/stcp/Kconfig
```kconfig
menu "STCP Configuration"

config STCP
    bool "Enable STCP LTE transport"
    default y
    depends on NET_SOCKETS
    help
      Enable STCP LTE transport.

config MQTT_LIB_STCP
    bool "STCP support for socket MQTT Library"
    default y
    depends on STCP && MQTT_LIB
    help
      Enable STCP support for socket MQTT Library

config STCP_DEBUG
    bool "Enable STCP debug"
    default y
    depends on STCP   # esimerkki: riippuvuudet kernelistä
    help
      Enable STCP debugs.

config STCP_STATISTICS
    bool "Enable STCP modem statistics"
    default y
    depends on STCP
    help
      Collect statistics from real-life traffic

config STCP_STATISTICS_LOG_INTERVAL
    int "Enable STCP modem statistics log interval"
    default 5
    depends on STCP_STATISTICS
    help
      The interval in seconds to log statistics

config STCP_TESTING
    bool "Enable STCP test support"
    default y
    depends on STCP
    help
      Enables the STCP Echo test server

config STCP_TESTING_MODE 
    int "Set STCP testmode, see help"
    default 3
    range 0 3
    depends on STCP_TESTING
    help
      Select which testing mode the modem runs.

      0 - Idle test
          Modem connects to the testing server and stays idle.
          Useful for testing LTE stability and watchdog behaviour.

      1 - TCP max throughput
          Raw TCP throughput test without STCP.

      2 - STCP max throughput
          STCP protocol throughput test running over TCP.

      3 - MQTT max throughput
          MQTT publish throughput test running over STCP.

      The modem connects to the host defined by:

          TESTING_PEER_HOSTNAME_TO_CONNECT
          TESTING_PEER_PORT_TO_CONNECT

      Normally the peer host runs the stcp-torture-server.

config STCP_TESTING_PAYLOAD_FORMAT
    string "Testing payload date format"
    default "TEST PAYLOAD %Y-%m-%d %H:%M:%S"
    depends on STCP_TESTING
    help
      Date format used to generate payload.
      set DATE_TIME define ON, to be able to use
      strftime() formatting rules for dynamic
      messages.

config STCP_TESTING_PEER_HOSTNAME_TO_CONNECT
    string "Host IP to where the test server creates connection to"
    default "lja.fi"
    depends on STCP_TESTING
    help
      Cause the connection has to be from the modem, the hostname
      an port is needed to create test connection to.

config STCP_TESTING_PEER_PORT_TO_CONNECT
    string "Port where the test server creates connection to"
    default "7777"
    depends on STCP_TESTING
    help
      Cause the connection has to be from the modem, the hostname
      an port is needed to create test connection to.

config STCP_DEBUG_LATENCY
    bool "Enable STCP latency & timing debug"
    default y
    depends on STCP_DEBUG   # esimerkki: riippuvuudet kernelistä
    help
      Enable STCP latency and timing debugs.

config STCP_WATCHDOG_ENABLE
    bool "Enable STCP watchdog"
    default y
    depends on STCP
    help
      Enable STCP watchdog thread that monitors
      STCP activity and network health.

config STCP_WATCHDOG_MAX_TIMEOUT
    int "Watchdog timeout in seconds"
    default 300
    range 30 36000
    depends on STCP_WATCHDOG_ENABLE
    help
      Maximum allowed inactivity time before
      the watchdog triggers a modem reset.

config STCP_WATCHDOG_CHECK_INTERVAL
    int "Watchdog check interval in seconds"
    default 15
    range 5 36000
    depends on STCP_WATCHDOG_ENABLE
    help
      Interval between watchdog health checks.

config STCP_SELFTEST
    bool "Enable STCP self-test"
    default n
    depends on STCP
    help
      Enable STCP self-test support.

config STCP_AES_BYPASS
    bool "Enable STCP AES bypass"
    default n
    depends on STCP   # esimerkki: riippuvuudet kernelistä
    help
      Bypass AES enc/decryption for development purposes.

config STCP_CONNECT_TO_HOST
    string "STCP Connect to hostname"
    default "lja.fi"
    depends on STCP
    help
      STCP Remote endpoint hostname.

config STCP_CONNECT_TO_PORT
    string "STCP Connect to tcp port"
    default "7777"
    depends on STCP
    help
      STCP Remote endpoint tcp port.

config STCP_LTE_APN_NAME
    string "The APN name to connect."
    default "internet"
    depends on STCP
    help
      The APN name to use to connect.

      Ask from your ISP what is the right APN
      name to use.


endmenu
```
