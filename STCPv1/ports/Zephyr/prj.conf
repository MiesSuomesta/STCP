## CMakeLists.txt
```
cmake_minimum_required(VERSION 3.20.0)
find_package(Zephyr REQUIRED HINTS $ENV{ZEPHYR_BASE})
project(stcp_demo)

# ------------------------------------------------------------
# STCP version
# ------------------------------------------------------------
set(STCP_VERSION "1.0.0-beta")

# ------------------------------------------------------------
# Build time (UTC, reproducible)
# ------------------------------------------------------------
string(TIMESTAMP STCP_BUILD_TIME "%Y-%m-%d %H:%M:%S UTC")

# ------------------------------------------------------------
# Git SHA (safe fallback)
# ------------------------------------------------------------
execute_process(
    COMMAND git describe --tags --dirty --always
    WORKING_DIRECTORY ${CMAKE_SOURCE_DIR}
    OUTPUT_VARIABLE STCP_GIT_SHA
    OUTPUT_STRIP_TRAILING_WHITESPACE
    ERROR_QUIET
)

if(NOT STCP_GIT_SHA)
    set(STCP_GIT_SHA "nogit")
endif()

# ------------------------------------------------------------
# Debug
# ------------------------------------------------------------

option(STCP_DEBUG "Enable STCP Rust-debug feature" ON)

set(STCP_RUST_FEATURES "")
if(STCP_DEBUG)
    set(STCP_RUST_FEATURES "stcp_debug")
endif()

# ------------------------------------------------------------
# Inject into Zephyr app target
# ------------------------------------------------------------
target_compile_definitions(app PRIVATE
    STCP_VERSION=\"${STCP_VERSION}\"
    STCP_BUILD_TIME=\"${STCP_BUILD_TIME}\"
    STCP_GIT_SHA=\"${STCP_GIT_SHA}\"
)


if(CONFIG_STCP_ENABLE)
  message(STATUS "STCP Enabled")
  target_sources(app PRIVATE
    micro-ecc/uECC.c
    src/workers.c
    src/utils.c
    src/network_testing.c
    src/fsm.c
    src/ffi_random.c
    src/rust_alloc.c
    src/rust_log_with_printk.c
    src/stcp_alloc_zephyr.c
    src/stcp_bridge.c
    src/stcp_kernel_crypto.c
    src/stcp_lte_fsm.c
    src/stcp_main_lte.c
    src/stcp_net_zephyr.c
    src/stcp_operations_zephyr.c
    src/stcp_platform_init_lte.c
    src/stcp_soft_reset.c
    src/stcp_tcp_recv.c
    src/stcp_tcp_send.c
    src/stcp_transport_lte.c
  )
else()
  message(STATUS "STCP Disabled")
endif()

#if(CONFIG_STCP_TRANSPORT_BT)
#    target_sources(app PRIVATE
#        src/stcp_main_bt.c
#        src/stcp_platform_init_bt.c
#        src/stcp_transport_bt.c
#        src/stcp_platform_bt.c
#    )
#endif()

set(STCP_FOR_LTE 1)
set(STCP_SDK_DIR "${CMAKE_CURRENT_LIST_DIR}/../out/")

# OOT: anna SDK-polku ulkoa (cmake -DSTCP_SDK_DIR=...)

# --- polut ---
set(RUST_DIR ${CMAKE_CURRENT_LIST_DIR}/rust)
set(RUST_LIB_SRC
  ${RUST_DIR}/target/thumbv8m.main-none-eabi/release/libthe_stcp_kernel_module.a
)

set(STCP_LIB_DST ${STCP_SDK_DIR}/lib/libstcp.a)
set(STCP_INC_DST ${STCP_SDK_DIR}/include)
set(MICRO_INC_DST ${STCP_SDK_DIR}/include)
set(STCP_HDR_DST ${STCP_INC_DST}/stcp.h)

# --- generoi SDK (lib + header) ---
add_custom_command(
  OUTPUT ${STCP_LIB_DST} ${STCP_HDR_DST}

  COMMAND cargo +nightly build
          --release
          --target thumbv8m.main-none-eabi
          --features stcp_debug

  COMMAND ${CMAKE_COMMAND} -E make_directory ${STCP_SDK_DIR}/lib
  COMMAND ${CMAKE_COMMAND} -E make_directory ${STCP_INC_DST}

  # kopioi Rust staticlib
  COMMAND ${CMAKE_COMMAND} -E copy_if_different
          ${RUST_LIB_SRC}
          ${STCP_LIB_DST}

  # aja cbindgen
  COMMAND cbindgen
          --config ${RUST_DIR}/cbindgen.toml
          --crate the_stcp_kernel_module
          --output ${STCP_HDR_DST}

  WORKING_DIRECTORY ${RUST_DIR}

  DEPENDS
    ${RUST_LIB_SRC}
    ${RUST_DIR}/src/lib.rs
    ${RUST_DIR}/cbindgen.toml

  VERBATIM
)

add_custom_target(stcp_sdk ALL
  DEPENDS ${STCP_LIB_DST} ${STCP_HDR_DST}
)

add_dependencies(app stcp_sdk)

# --- include + link ---

target_include_directories(app PRIVATE
  # netti internaalit näkyviin
  ${ZEPHYR_BASE}/subsys/net/ip
  ${ZEPHYR_BASE}/subsys/net/lib/sockets
  # STCP
  ${MICRO_INC_DST}
  ${STCP_INC_DST}
)

target_link_libraries(app PRIVATE
  ${STCP_LIB_DST}
)

target_include_directories(app PRIVATE
  ${CMAKE_CURRENT_LIST_DIR}/include
  ${CMAKE_CURRENT_LIST_DIR}/micro-ecc
  ${STCP_SDK_DIR}/include
)

target_link_libraries(app PRIVATE
  ${STCP_SDK_DIR}/lib/libstcp.a
)
```

## Kconfig
```
source "Kconfig"

menu "STCP Configuration"

config STCP_ENABLE
    bool "Enable STCP LTE transport"
    default y
    depends on NET_SOCKETS   # esimerkki: riippuvuudet kernelistä
    help
      Enable STCP LTE transport.

config STCP_DEBUG
    bool "Enable STCP debug"
    default n
    depends on STCP_ENABLE   # esimerkki: riippuvuudet kernelistä
    help
      Enable STCP debugs.

config STCP_AES_BYPASS
    bool "Enable STCP AES bypass"
    default n
    depends on STCP_ENABLE   # esimerkki: riippuvuudet kernelistä
    help
      Bypass AES enc/decryption for development purposes.

config STCP_CONNECT_TO_HOST
    string "STCP Connect to hostname"
    default "your-public-stcp-server"
    depends on STCP_ENABLE
    help
      STCP Remote endpoint hostname.

config STCP_CONNECT_TO_PORT
    string "STCP Connect to tcp port"
    default "7777"
    depends on STCP_ENABLE
    help
      STCP Remote endpoint tcp port.

config STCP_LTE_APN_NAME
    string "The APN name to connect."
    default "internet"
    depends on STCP_ENABLE
    help
      The APN name to use to connect.

      Ask from your ISP what is the right APN
      name to use.


endmenu
```

## prj.conf
```kconfig
# =========================
# UART driver
# =========================
CONFIG_SERIAL=y

# =========================
# LOG -> UART (vain yksi backend)
# =========================
CONFIG_LOG=y
CONFIG_LOG_BACKEND_UART=y
CONFIG_LOG_MODE_IMMEDIATE=y
CONFIG_LOG_PRINTK=n

# =========================
# Estä printk + early console
# =========================
CONFIG_PRINTK=n
CONFIG_EARLY_CONSOLE=n
CONFIG_STDOUT_CONSOLE=n

# =========================
# Shell UARTiin (ei Shell-log-backendiä!)
# =========================
CONFIG_CONSOLE=y
CONFIG_UART_CONSOLE=y
CONFIG_SHELL=y
CONFIG_SHELL_BACKEND_SERIAL=y
CONFIG_SHELL_LOG_BACKEND=n   # <<< TÄRKEIN

# =========================
# Tracing (vain trace_backend symboliin, ei UARTiin)
# =========================
CONFIG_TRACING=y
CONFIG_TRACING_BACKEND_UART=n   # EI enää UARTiin
CONFIG_TRACING_SYNC=y

# =========================
# Modem trace RAMiin (ei UARTiin)
# =========================
CONFIG_NRF_MODEM_LIB_TRACE=y
CONFIG_NRF_MODEM_LIB_TRACE_BACKEND_RAM=y
CONFIG_NRF_MODEM_LIB_TRACE_BACKEND_RAM_LENGTH=32768

# =========================
# Estä muut backendit
# =========================
CONFIG_LOG_BACKEND_RTT=n

# -------------------------
# Core networking
# -------------------------
CONFIG_PDN=y
CONFIG_NETWORKING=y
CONFIG_NET_IPV4=y
CONFIG_NET_IPV6=n
CONFIG_DNS_RESOLVER=y
CONFIG_NET_CONFIG_SETTINGS=y
CONFIG_NET_CONFIG_AUTO_INIT=y

# -------------------------
# Sockets (pakollinen zsock_*)
# -------------------------
CONFIG_NET_SOCKETS=y
CONFIG_NET_SOCKETS_POSIX_NAMES=y
CONFIG_NET_BUF_RX_COUNT=8
CONFIG_NET_BUF_TX_COUNT=8
CONFIG_NET_PKT_RX_COUNT=4
CONFIG_NET_PKT_TX_COUNT=4

# File dessejä
CONFIG_ZVFS_OPEN_MAX=32
CONFIG_NET_SOCKETS_POLL_MAX=32

# -------------------------
# Offload (nRF9161 modem sockets)
# -------------------------
CONFIG_NET_SOCKETS_OFFLOAD=y
CONFIG_NET_OFFLOAD=y

# -------------------------
# DNS (zsock_getaddrinfo)
# -------------------------
CONFIG_DNS_RESOLVER=y
CONFIG_NET_CONFIG_SETTINGS=y
CONFIG_NET_CONFIG_INIT_TIMEOUT=30

# -------------------------
# LTE / modem
# -------------------------
CONFIG_NRF_MODEM_LIB=y
CONFIG_LTE_LINK_CONTROL=y
CONFIG_LTE_LINK_CONTROL_LOG_LEVEL_DBG=y

CONFIG_MODEM_KEY_MGMT=y
CONFIG_NET_CONFIG_SETTINGS=y
CONFIG_NET_CONFIG_INIT_TIMEOUT=60

# -------------------------
# POSIX layer (poll, fcntl jne)
# -------------------------
CONFIG_POSIX_API=y
CONFIG_POLL=y
CONFIG_EVENTFD=y

# -------------------------
# Crypto
# -------------------------
# Crypto perusta

# nRF9161 HW crypto (CC3XX)
CONFIG_PSA_CRYPTO_DRIVER_CC3XX=y

# Entropy / RNG
CONFIG_ENTROPY_GENERATOR=y

# Tarvittavat ECC-algoritmit
CONFIG_MBEDTLS_ECP_C=y
CONFIG_MBEDTLS_ECDH_C=y
CONFIG_MBEDTLS_ECDSA_C=y

# (valinnainen) debug
CONFIG_MBEDTLS_DEBUG=y

# HW crypto nRF9161:
CONFIG_NORDIC_SECURITY_BACKEND=y
CONFIG_PSA_CRYPTO_DRIVER_CC3XX=y

# Muisti 24kb stakki ja 32kb heappi 
CONFIG_MAIN_STACK_SIZE=32768
CONFIG_HEAP_MEM_POOL_SIZE=32768
CONFIG_NET_SOCKETS_SERVICE_STACK_SIZE=8192
CONFIG_SYSTEM_WORKQUEUE_STACK_SIZE=4096

# Stack debug
CONFIG_INIT_STACKS=y
CONFIG_STACK_SENTINEL=y
CONFIG_THREAD_STACK_INFO=y
CONFIG_MBEDTLS=y


# --- ÄLÄ vedä mbedTLS debug-init mukaan ---
CONFIG_MBEDTLS=n
CONFIG_MBEDTLS_LIBRARY=n
CONFIG_MBEDTLS_DEBUG=n

# --- Disabloi nrf_security mbedTLS backend ---
CONFIG_NRF_SECURITY=n

# --- Pakota mbedTLS kirjasto ---
#CONFIG_MBEDTLS=y
#CONFIG_MBEDTLS_LIBRARY=y

# --- Nordic HW backend ---
#CONFIG_PSA_CRYPTO_DRIVER_CC3XX=y

# --- Entropy ---
#CONFIG_ENTROPY_GENERATOR=y

# --- ECC ---
#CONFIG_MBEDTLS_ECP_C=y
#CONFIG_MBEDTLS_ECDH_C=y
#CONFIG_MBEDTLS_ECDSA_C=y

#defbuggia
CONFIG_SYS_HEAP_RUNTIME_STATS=y
CONFIG_SYS_HEAP_LISTENER=y
CONFIG_ASSERT=y
CONFIG_DEBUG_OPTIMIZATIONS=y
CONFIG_CBPRINTF_COMPLETE=y

#HEappi
CONFIG_SYS_HEAP_LISTENER=y
CONFIG_SYS_HEAP_RUNTIME_STATS=y
CONFIG_SYS_HEAP_VALIDATE=y

CONFIG_ENTROPY_GENERATOR=y
CONFIG_ENTROPY_NRF5_RNG=y
CONFIG_NRFX_RNG=y


#CONFIG_INIT_STACKS=y
#CONFIG_THREAD_STACK_INFO=y
#CONFIG_THREAD_RUNTIME_STATS=y

#CONFIG_HEAP_MEM_POOL_SIZE=65536
CONFIG_DEBUG_INFO=y
CONFIG_DEBUG_OPTIMIZATIONS=y
CONFIG_NO_OPTIMIZATIONS=y

# Analyysiä
#CONFIG_THREAD_ANALYZER=y
#CONFIG_THREAD_ANALYZER_AUTO=y
#CONFIG_THREAD_ANALYZER_USE_PRINTK=y

# STCP configuration
CONFIG_STCP_ENABLE=y
CONFIG_STCP_DEBUG=y
CONFIG_STCP_AES_BYPASS=n
```

## include/stcp_alloc.h
```c
#pragma once

void *stcp_alloc(size_t n);
void stcp_free(void *p);
```

## include/stcp_lte_fsm.h
```c
/* stcp_lte_fsm.h */

#pragma once
#include "stcp.h"

int stcp_run_loop(struct stcp_ctx *theCtx);
```

## include/stcp_rust_exported_functions.h
```c
#pragma once

// Public FFI from Rust
//extern int rust_exported_session_create(void **out_sess, void *transport);
//extern int rust_exported_session_destroy(void *sess);
//extern int rust_exported_session_client_handshake(void *sess);
//extern int rust_exported_session_server_handshake(void *sess);
//
//extern ssize_t rust_exported_session_sendmsg(void *sess, void *transport, void *msg, size_t msglen);
//extern ssize_t rust_exported_session_recvmsg(void *sess, void *transport, void *buffer, size_t maxlen, int bloking);
//
//// Functions to be clear of the scope ...
//extern int rust_exported_data_client_ready_worker(void *sess, void *transport);
//extern int rust_exported_data_server_ready_worker(void *sess, void *transport);
//extern int rust_exported_session_handshake_done(void *sess);
//extern int rust_exported_session_handshake_pump(void *sess, void *transport /* struct sock* */, int reason);
//
//// Module init / exit
extern void stcp_module_rust_enter (void);
extern void stcp_module_rust_exit (void);
//
//// Instance counter
//extern void stcp_exported_rust_sockets_alive_get(void);
//extern void stcp_exported_rust_sockets_alive_put(void);
//extern int  stcp_exported_rust_ctx_alive_count(void);

// RUST initialised 
//inline int is_rust_init_done(void);
```

## include/stcp_struct.h
```c
#pragma once
#include <zephyr/kernel.h>
#include <zephyr/net/socket.h>
#include <zephyr/net/socket_offload.h>
#include <zephyr/sys/fdtable.h>
#include <zephyr/sys/util.h>
#include <errno.h>
#include "stcp.h"

#ifndef STCP_H
struct kernel_socket {
	int fd;
	void *kctx;
	void *resolved_host;
};
#endif

enum {
    CTX_STATE_INIT = 0,
    CTX_STATE_CONNECTING,
    CTX_STATE_CONNECTED,
    CTX_STATE_CLOSING,
};

struct stcp_ctx {
	int tcp_fd;
	void *session;   // Rust STCP session pointer
    int handshake_done;
	atomic_t closing;
	atomic_t ctx_state;
	struct k_mutex lock;
	struct k_work cleanup_work;
	struct k_work connect_work;
	struct kernel_socket ks;
};
```

## include/workers.h
```c
#pragma once
#include <zephyr/kernel.h>

void worker_cleanup_work_handler(struct k_work *work);
void worker_context_init(struct stcp_ctx *ctx);

void worker_schedule_cleanup(struct stcp_ctx * ctx);
void worker_cleanup_work_handler(struct k_work *work);
```

## src/fsm.c
```c
#include <zephyr/logging/log.h>
#include <zephyr/kernel.h>
#include <stdbool.h>
#include "fsm.h"
#include "stcp_lte_fsm.h"

void stcp_fsm_init(struct stcp_fsm *fsm);
void stcp_fsm_start(struct stcp_fsm *fsm);
void stcp_fsm_notify_lte_ready(struct stcp_fsm *fsm);
void stcp_fsm_notify_pdn_ready(struct stcp_fsm *fsm);

LOG_MODULE_REGISTER(stcp_fsm, LOG_LEVEL_INF);

#include "fsm.h"
#include "settings.h"
#include "debug.h"
#include "stcp_alloc.h"
#include "stcp_struct.h"
#include "stcp_bridge.h"
#include "stcp_net.h"
#include "workers.h"
#include "utils.h"
#include "stcp_operations_zephyr.h"

#include "stcp_rust_exported_functions.h"

#define STCP_FSM_REAL_IMPL 1
extern struct stcp_ctx* theStcpContext;

static void stcp_fsm_thread(void *p1, void *p2, void *p3)
{
    struct stcp_fsm *fsm = p1;

    if (p1 == NULL) {
        LDBG("p1 == NULL!");
        return;
    }

    LOG_INF("fsm=%p ctx_ptr=%p", fsm, fsm->ctx);

    while (!fsm->stop) {
        switch (fsm->state) {

        case STCP_FSM_INIT:
            LDBG("[FSM] INIT");
            fsm->state = STCP_FSM_WAIT_LTE;
            break;

        case STCP_FSM_WAIT_LTE:
            LDBG("[FSM] WAIT LTE");
            k_sem_take(&(fsm->lte_ready), K_FOREVER);
            fsm->state = STCP_FSM_WAIT_PDN;
            break;

        case STCP_FSM_WAIT_PDN:
            LDBG("[FSM] WAIT PDN");
            k_sem_take(&(fsm->pdn_ready), K_FOREVER);
            fsm->state = STCP_FSM_WAIT_IP;
            break;

        case STCP_FSM_WAIT_IP:
            LDBG("[FSM] WAIT IP");
            k_sem_take(&(fsm->ip_ready), K_FOREVER);
            fsm->state = STCP_FSM_WAIT_STABLE;
            break;

        case STCP_FSM_WAIT_STABLE:
            LDBG("[FSM] LTE stable settle time...");
            k_sleep(K_SECONDS(3));
            fsm->state = STCP_FSM_TCP_CONNECT;
            break;

        case STCP_FSM_TCP_CONNECT:
            LDBG("[FSM] TCP CONNECT");
#if STCP_FSM_REAL_IMPL
            struct stcp_ctx *ctx = stcp_tcp_resolve_and_make_context(
                    CONFIG_STCP_CONNECT_TO_HOST, 
                    CONFIG_STCP_CONNECT_TO_PORT);
                    
            if (!ctx) {
                LWRN("[FSM] ctx alloc failed");
                k_sleep(K_SECONDS(3));
                break;
            }

            if (ctx != NULL) {
                fsm->ctx = ctx;
                theStcpContext = ctx;
                fsm->state = STCP_FSM_STCP_HANDSHAKE;
            } else {
                //stcp_transport_close(ctx);
                //fsm->ctx = NULL;
                k_sleep(K_SECONDS(3));
                fsm->state = STCP_FSM_TCP_RECONNECT;
            }
#endif
            break;

        case STCP_FSM_STCP_HANDSHAKE: {
            LDBG("[FSM] STCP HANDSHAKE");
#if STCP_FSM_REAL_IMPL
            int rc = stcp_tcp_context_connect_and_shake_hands(fsm->ctx, 3*60*1000);
            if (rc == 1) {
                fsm->state = STCP_FSM_RUN;
            } else {
                LWRN("[FSM] HS failed rc=%d", rc);
                stcp_transport_close(theStcpContext);
                fsm->state = STCP_FSM_TCP_RECONNECT;
            }
#endif
            break;
        }

        case STCP_FSM_RUN:
            LDBG("[FSM] RUN");
#if STCP_FSM_REAL_IMPL
            LDBG("[FSM] Starting AES loop....");
            int rc = 0;
            while (!fsm->stop) {
                rc = stcp_run_loop(fsm->ctx);
                if (rc < 0) {
                    LWRN("[FSM] RUN loop error %d", rc);
                    fsm->state = STCP_FSM_TCP_RECONNECT;
                    break;
                }
                k_sleep(K_MSEC(5));
            }
#endif
            LDBG("[FSM] AES loop ended, rc: %d", rc);
            break;

        case STCP_FSM_TCP_RECONNECT:
            LDBG("[FSM] TCP RECONNECT");
#if STCP_FSM_REAL_IMPL
            stcp_transport_close(fsm->ctx);
#endif 
            k_sleep(K_SECONDS(3));
            fsm->state = STCP_FSM_TCP_CONNECT;
            break;

        case STCP_FSM_FATAL:
        default:
            LERR("[FSM] FATAL STATE");
            k_sleep(K_SECONDS(10));
            break;
        }
    }
    LDBG("Found out...");
}


#define STCP_FSM_STACK_SIZE 4096

K_THREAD_STACK_DEFINE(stcp_fsm_stack, 8192);
static struct k_thread stcp_fsm_thread_data;
static k_tid_t stcp_fsm_tid;

void stcp_fsm_init(struct stcp_fsm *fsm)
{
    memset(fsm, 0, sizeof(*fsm));

    k_sem_init(&fsm->lte_ready, 0, 1);
    k_sem_init(&fsm->pdn_ready, 0, 1);
    k_sem_init(&fsm->ip_ready, 0, 1);

    fsm->ctx = NULL;
    fsm->state = STCP_FSM_INIT;

    stcp_fsm_tid = k_thread_create(
        &stcp_fsm_thread_data,
        stcp_fsm_stack,
        K_THREAD_STACK_SIZEOF(stcp_fsm_stack),
        stcp_fsm_thread,
        fsm, NULL, NULL,
        5, 0, K_NO_WAIT
    );
}

void stcp_fsm_reached_ip_network_up(struct stcp_fsm *fsm) 
{
    if (fsm) {
        k_sem_give(&fsm->ip_ready);
    }
}

void stcp_fsm_reached_lte_ready(struct stcp_fsm *fsm) 
{
    if (fsm) {
        k_sem_give(&fsm->lte_ready);
    }
}

void stcp_fsm_reached_pnd_ready(struct stcp_fsm *fsm) 
{
    if (fsm) {
        k_sem_give(&fsm->pdn_ready);
    }
}

void stcp_fsm_start(struct stcp_fsm *fsm)
{
    k_thread_start(stcp_fsm_tid);
}

void stcp_fsm_notify_lte_ready(struct stcp_fsm *fsm)
{
    k_sem_give(&fsm->lte_ready);
}

void stcp_fsm_notify_pdn_ready(struct stcp_fsm *fsm)
{
    k_sem_give(&fsm->pdn_ready);
}
```

## src/fsm.h
```c
#pragma once
#include <zephyr/kernel.h>
#include <stdbool.h>

typedef enum {
    STCP_FSM_INIT = 0,
    STCP_FSM_WAIT_LTE,
    STCP_FSM_WAIT_PDN,
    STCP_FSM_WAIT_IP,
    STCP_FSM_WAIT_STABLE,
    STCP_FSM_TCP_CONNECT,
    STCP_FSM_STCP_HANDSHAKE,
    STCP_FSM_RUN,
    STCP_FSM_TCP_RECONNECT,
    STCP_FSM_FATAL
} stcp_fsm_state_t;

struct stcp_fsm {
    stcp_fsm_state_t state;
    struct k_sem lte_ready;
    struct k_sem pdn_ready;
    struct k_sem ip_ready;
    struct stcp_ctx * ctx;
    bool stop;
};

void stcp_fsm_init(struct stcp_fsm *fsm);
void stcp_fsm_start(struct stcp_fsm *fsm);
void stcp_fsm_notify_lte_ready(struct stcp_fsm *fsm);
void stcp_fsm_notify_pdn_ready(struct stcp_fsm *fsm);

extern struct stcp_fsm theFSM;

void stcp_fsm_reached_ip_network_up(struct stcp_fsm *fsm);
void stcp_fsm_reached_lte_ready(struct stcp_fsm *fsm);
void stcp_fsm_reached_pnd_ready(struct stcp_fsm *fsm);
```

## src/network_testing.c
```c
#include <zephyr/kernel.h>
#include <zephyr/net/socket.h>
#include <zephyr/logging/log.h>
#include <errno.h>
#include <string.h>
#include <stdlib.h>
#include <zephyr/init.h>
#include <modem/lte_lc.h>

#include <zephyr/sys/heap_listener.h>
#include <zephyr/sys/sys_heap.h>
#include <zephyr/kernel.h>

#include <zephyr/net/socket.h>
#include <zephyr/net/net_ip.h>
#include <errno.h>
#include <zephyr/sys/atomic.h>
#include <modem/nrf_modem_lib.h>

#include "stcp_struct.h"
#include "stcp_net.h"
#include "workers.h"
#include "utils.h"
#include "fsm.h"
#include "stcp_bridge.h"
#include "stcp_operations_zephyr.h"

#include "stcp_rust_exported_functions.h"

LOG_MODULE_REGISTER(stcp_tcp_tester, LOG_LEVEL_INF);

int stcp_network_test_dns(const char *host, const char *port,
                               struct sockaddr_in *out)
{
    struct addrinfo hints = { 0 };
    struct addrinfo *res = NULL;
    int rc;

    hints.ai_family = AF_INET;
    hints.ai_socktype = SOCK_STREAM;

    LINF("DNS test: resolving %s:%s", host, port);

    rc = zsock_getaddrinfo(host, port, &hints, &res);
    if (rc != 0) {
        LERR("getaddrinfo failed rc=%d errno=%d", rc, errno);
        return -errno;
    }

    struct sockaddr_in *addr = (struct sockaddr_in *)res->ai_addr;

    char ip[NET_IPV4_ADDR_LEN];
    net_addr_ntop(AF_INET, &addr->sin_addr, ip, sizeof(ip));

    LINF("DNS OK: %s -> %s:%d", host, ip, ntohs(addr->sin_port));

    if (out) {
        memcpy(out, addr, sizeof(*out));
    }

    zsock_freeaddrinfo(res);
    return 0;
}

int stcp_network_ping_ip(const struct sockaddr_in *addr)
{
    int fd = zsock_socket(AF_INET, SOCK_DGRAM, IPPROTO_ICMP);
    if (fd < 0) {
        LERR("ping socket failed errno=%d", errno);
        return -errno;
    }

    char dummy = 0;
    int rc = zsock_sendto(fd, &dummy, 1, 0,
                          (struct sockaddr *)addr, sizeof(*addr));
// pois     zsock_close(fd);

    LDBG("Ping send rc=%d errno=%d", rc, errno);
    return rc;
}

int stcp_network_test_tcp_connect(const struct sockaddr_in *addr)
{
    int fd = zsock_socket(AF_INET, SOCK_STREAM, IPPROTO_TCP);
    if (fd < 0) {
        LERR("socket failed errno=%d", errno);
        return -errno;
    }

    struct timeval tv = {
        .tv_sec = 5,
        .tv_usec = 0,
    };
    zsock_setsockopt(fd, SOL_SOCKET, SO_SNDTIMEO, &tv, sizeof(tv));
    zsock_setsockopt(fd, SOL_SOCKET, SO_RCVTIMEO, &tv, sizeof(tv));

    LDBG("TCP connect test...");

    int rc = zsock_connect(fd, (struct sockaddr *)addr, sizeof(*addr));
    if (rc < 0) {
        LERR("connect failed errno=%d", errno);
// pois         zsock_close(fd);
        return -errno;
    }

    LDBG("TCP connect OK!");
// pois     zsock_close(fd);
    return 0;
}

int stcp_network_test_network_avalability(const char *host, const char *port) {
    struct sockaddr_in theAddr;
    int err = stcp_network_test_dns(host, port, &theAddr);
    if ( err < 0 ) {
        return -1;
    }
    
/* EI LTE verkossa toimi
    err = stcp_network_ping_ip(&theAddr);
    if ( err < 0 ) {
        return -2;
    }
*/
    err = stcp_network_test_tcp_connect(&theAddr);
    if ( err < 0 ) {
        return -3;
    }

    return 0;
}
```

## src/network_testing.h
```c
#pragma once 
#include <zephyr/kernel.h>
#include <zephyr/net/socket.h>
#include <zephyr/logging/log.h>
#include <errno.h>
#include <string.h>
#include <stdlib.h>
#include <zephyr/init.h>
#include <modem/lte_lc.h>

#include <zephyr/sys/heap_listener.h>
#include <zephyr/sys/sys_heap.h>
#include <zephyr/kernel.h>

#include <zephyr/net/socket.h>
#include <zephyr/net/net_ip.h>
#include <errno.h>
#include <zephyr/sys/atomic.h>
#include <modem/nrf_modem_lib.h>

#include "stcp_struct.h"
#include "stcp_net.h"
#include "workers.h"
#include "utils.h"
#include "fsm.h"
#include "stcp_bridge.h"
#include "stcp_operations_zephyr.h"

#include "stcp_rust_exported_functions.h"

int stcp_network_test_dns(const char *host, const char *port,
                               struct sockaddr_in *out);

int stcp_network_ping_ip(const struct sockaddr_in *addr);

int stcp_network_test_tcp_connect(const struct sockaddr_in *addr);

int stcp_network_test_network_avalability(const char *host, const char *port);
```

## src/rust_alloc.c
```c
#include <zephyr/kernel.h>
#include "debug.h"
LOG_MODULE_REGISTER(stcp_rust_memory_allocations, LOG_LEVEL_INF);

/*
 * Yksinkertaiset wrapperit Rustin globaalille allokaattorille.
 * Tällä hetkellä käytetään GFP_KERNEL.
 * Jos tarvitset myöhemmin ATOMIC tms, voidaan lisätä erillinen API.
 */
// Lippu, jos laittasi moduulin argumentteihin mukaan ??
static int debug_memory_alloc = 0;
#define STCP_MEM_DEBUG 0

void *stcp_rust_kernel_alloc(size_t pSize)
{
    void *p = k_malloc(pSize);
    if (p) {
        memset(p, 0, pSize);
    }

#if STCP_MEM_DEBUG
    if (debug_memory_alloc) {
        SDBG("MEM: Alloc %d bytes => %p", pSize, p);
    }
#endif
    return p;
}

void stcp_rust_kernel_free(const void *pFrom)
{

#if STCP_MEM_DEBUG
    if (debug_memory_alloc) {
        SDBG("MEM: Free %p", pFrom);
    }
#endif

    k_free(pFrom);
}
```

## src/stcp_kernel_crypto.c
```c
#include <zephyr/random/random.h>
#include <zephyr/kernel.h>
#include <string.h>

#include "uECC.h"
#include "debug.h"
#include "stcp_kernel_crypto.h"
LOG_MODULE_REGISTER(stcp_kernel_crypto_module, LOG_LEVEL_INF);

/* uECC RNG hook Zephyrille */
static int zephyr_rng(uint8_t *dest, unsigned size)
{
    sys_rand_get(dest, size);
    return 1; /* uECC odottaa non-zero = OK */
}

int stcp_crypto_generate_keypair(struct stcp_crypto_pubkey *out_pub,
                                 struct stcp_crypto_secret *out_priv)
{
    if (!out_pub || !out_priv) {
        return -1;
    }

    LDBG("sizeof pubkey %u\n", sizeof(struct stcp_crypto_pubkey));
    LDBG("sizeof secret %u\n", sizeof(struct stcp_crypto_secret));

    LDBG("Getting curve...");
    const struct uECC_Curve_t *curve = uECC_secp256r1();
    LDBG("Curve got...");

    /* uECC odottaa: pubkey = 64 tavua (x||y), privkey = 32 tavua */
    uint8_t pub_raw[STCP_CRYPTO_KEY_PUB_LEN];
    uint8_t priv_raw[STCP_CRYPTO_KEY_PRIV_LEN];
    LDBG("Allocated stack....");

    uECC_set_rng(zephyr_rng);
    LDBG("Random set ...");

    if (!uECC_make_key(pub_raw, priv_raw, curve)) {
        LDBG("Make key failed!");
        return -2;
    }

    LDBG("Keys made....");

    /* Kopioi x ja y omiin rakenteisiin */
    memcpy(out_pub->x, pub_raw, STCP_CRYPTO_KEY_PUB_XY_LEN);
    LDBG("Key pub X");
    memcpy(out_pub->y, pub_raw + STCP_CRYPTO_KEY_PUB_XY_LEN, STCP_CRYPTO_KEY_PUB_XY_LEN);
    LDBG("Key pub Y");
    
    /* Private key */
    LDBG("Check point");
    memcpy(out_priv->data, priv_raw, STCP_CRYPTO_KEY_PRIV_LEN);
    LDBG("Check the FINAL point");
    LDBG("Ret 0");
    return 0;
}

int stcp_crypto_compute_shared(const struct stcp_crypto_secret *priv,
                               const struct stcp_crypto_pubkey *peer_pub,
                               struct stcp_crypto_secret *out_shared)
{
    if (!priv || !peer_pub || !out_shared) {
        return -1;
    }

    const struct uECC_Curve_t *curve = uECC_secp256r1();

    uint8_t peer_pub_raw[STCP_CRYPTO_KEY_PUB_LEN];
    uint8_t shared_raw[STCP_CRYPTO_KEY_SHARED_LEN];

    /* Rakenna uECC:n odottama pubkey = x||y */
    memcpy(peer_pub_raw, peer_pub->x, STCP_CRYPTO_KEY_PUB_XY_LEN);
    memcpy(peer_pub_raw + STCP_CRYPTO_KEY_PUB_XY_LEN,
           peer_pub->y,
           STCP_CRYPTO_KEY_PUB_XY_LEN);

    if (!uECC_shared_secret(peer_pub_raw,
                            (const uint8_t *)priv->data,
                            shared_raw,
                            curve)) {
        printk("stcp_crypto: uECC_shared_secret failed\n");
        return -2;
    }

    memcpy(out_shared->data, shared_raw, STCP_CRYPTO_KEY_SHARED_LEN);
    return 0;
}
```

## src/stcp_logger_test.c
```c
#include <zephyr/kernel.h>
#include <zephyr/net/socket.h>
#include <zephyr/logging/log.h>
#include <string.h>

LOG_MODULE_REGISTER(paxlogd_test, LOG_LEVEL_INF);

#define TEST_HOST "192.168.1.20"
#define TEST_PORT 7755

static void paxlogd_test_thread(void)
{
    while (1) {
        LOG_INF("paxlogd test: connecting...");

        int fd = zsock_socket(AF_INET, SOCK_STREAM, IPPROTO_TCP);
        if (fd < 0) {
            LOG_ERR("socket() failed: %d", errno);
            k_sleep(K_SECONDS(5));
            continue;
        }

        struct sockaddr_in addr = {
            .sin_family = AF_INET,
            .sin_port = htons(TEST_PORT),
        };

        if (zsock_inet_pton(AF_INET, TEST_HOST, &addr.sin_addr) != 1) {
            LOG_ERR("inet_pton failed");
// pois             zsock_close(fd);
            k_sleep(K_SECONDS(5));
            continue;
        }

        if (zsock_connect(fd, (struct sockaddr *)&addr, sizeof(addr)) < 0) {
            LOG_ERR("connect() failed: %d", errno);
// pois             zsock_close(fd);
            k_sleep(K_SECONDS(5));
            continue;
        }

        const char *msg = "HELLO FROM MODEM\n";
        ssize_t rc = zsock_send(fd, msg, strlen(msg), 0);

        if (rc < 0) {
            LOG_ERR("send() failed: %d", errno);
        } else {
            LOG_INF("sent %d bytes", rc);
        }

// pois         zsock_close(fd);
        k_sleep(K_SECONDS(10));
    }
}

K_THREAD_DEFINE(paxlogd_test_tid, 2048, paxlogd_test_thread, NULL, NULL, NULL, 7, 0, 0);
```
