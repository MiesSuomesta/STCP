## Kconfig
```
mainmenu "STCP transport benchmark"

source "Kconfig.zephyr"

menu "Echo benchmark"

config ECHO_SERVER_HOST
    string "Echo server hostname or IPv4 address"
    default "lja.fi"

config ECHO_SERVER_PORT
    string "Echo server port"
    default "19000"

choice ECHO_TRANSPORT
    prompt "Echo transport"
    default ECHO_TRANSPORT_TCP

config ECHO_TRANSPORT_TCP
    bool "TCP"

config ECHO_TRANSPORT_STCP
    bool "STCP over current carrier"

endchoice

config ECHO_PAYLOAD_SIZE
    int "Echo payload size"
    default 1024
    range 1 4096

config ECHO_ITERATIONS
    int "Number of echo round trips"
    default 100
    range 1 100000

config ECHO_SOCKET_TIMEOUT_MS
    int "Socket send/receive timeout in milliseconds"
    default 30000
    range 1000 300000

config BENCH_TOTAL_BYTES
    int "Bytes transferred per direction in each throughput test"
    default 1048576
    range 4096 67108864

config BENCH_MAX_CHUNK_SIZE
    int "Maximum runtime streaming chunk size"
    default 65536
    range 4096 65536
    help
      Maximum chunk accepted by the runtime shell and benchmark core. Buffers
      are allocated dynamically for each test. Full duplex needs two buffers.

config BENCH_CHUNK_SIZE
    int "Default streaming I/O chunk size"
    default 4096
    range 256 BENCH_MAX_CHUNK_SIZE

config BENCH_PAUSE_SECONDS
    int "Pause between upload, download and full-duplex tests"
    default 5
    range 0 120

config BENCH_REPORT_INTERVAL_MS
    int "Progress report interval in milliseconds"
    default 5000
    range 0 600000
    help
      Controls how often the modem-side benchmark reports transferred bytes,
      remaining bytes, percentage and average throughput. Set to 0 to disable
      periodic reports; the final 100 percent report is still printed.

config BENCH_SENDER_STACK_SIZE
    int "Full-duplex sender thread stack size"
    default 4096
    range 2048 16384

config BENCH_WORKER_STACK_SIZE
    int "Benchmark worker thread stack size"
    default 8192
    range 6144 24576
    help
      Stack reserved for the dedicated benchmark worker. AF_STCP socket and
      Rust session creation run in this thread instead of the shell UART
      thread, preventing shell stack overflow.

config BENCH_WORKER_PRIORITY
    int "Benchmark worker thread priority"
    default 5
    range 0 15
    help
      Cooperative/preemptible Zephyr priority used by the benchmark worker.


config BENCH_STCP_BLOCKING_CONNECT
    bool "Use blocking connect for STCP benchmark sockets"
    default y
    help
      STCP socket offload currently does not implement F_GETFL/F_SETFL.
      Enable this option to skip unsupported O_NONBLOCK setup for AF_STCP
      sockets and call connect() in blocking mode. Native TCP continues to
      use the existing non-blocking connect and poll path.


config BENCH_SOCKET_BUFFER_SIZE
    int "Requested modem socket send/receive buffer size"
    default 32768
    range 4096 131072
    help
      Best-effort SO_SNDBUF/SO_RCVBUF value. The modem offload may clamp or
      reject the value; benchmark startup logs the actual result.

config BENCH_FULL_RX_BUFFER_SIZE
    int "Full-duplex receive scratch buffer size"
    default 4096
    range 1024 16384
    help
      Full-duplex uses the configured chunk size for TX, but a smaller RX
      scratch buffer to avoid reserving two 64 KiB buffers at once. TCP is a
      byte stream, so receive calls do not need to match the peer send size.

endmenu

menu "Interactive benchmark control"

config STCP_BENCH_SHELL
    bool "Enable STCP benchmark shell commands"
    default y
    select SHELL
    help
      Builds the interactive 'stcp config' and 'stcp bench' command tree.
      Disable this option to remove the shell command implementation and its
      command tables from the firmware image.

config STCP_BENCH_AUTORUN
    bool "Run all throughput benchmarks automatically after LTE connects"
    default n if STCP_BENCH_SHELL
    default y if !STCP_BENCH_SHELL
    help
      Automatically runs upload, download and full-duplex benchmarks after
      LTE registration. This can be enabled together with the shell if both
      automatic and interactive testing are desired.

endmenu

menu "LTE transport initialization"

config STCP_LTE_REG_TIMEOUT_SECONDS
    int "LTE registration timeout in seconds"
    default 300
    range 10 1800

config STCP_LTE_PDN_TIMEOUT_SECONDS
    int "PDN activation timeout in seconds"
    default 300
    range 10 1800

config STCP_LTE_FORCE_DEFAULT_APN
    bool "Configure default CID 0 APN before LTE attach"
    default n
    help
      Writes CONFIG_STCP_LTE_DEFAULT_APN to PDP context CID 0 before
      lte_lc_connect(). Benchmark sockets use this default context.

config STCP_LTE_DEFAULT_APN
    string "Default CID 0 APN"
    default "APN internet"
    depends on STCP_LTE_FORCE_DEFAULT_APN

config STCP_LTE_CUSTOM_PDN
    bool "Create, activate and bind sockets to a separate PDN context"
    default n
    depends on LTE_LC_PDN_MODULE
    help
      Reproduces the STCPv1 model by creating and activating an additional
      PDN context after LTE registration. Benchmark TCP sockets are bound to
      the resulting modem PDN ID with SO_BINDTOPDN before connect().

config STCP_LTE_APN
    string "APN for the separate PDN context"
    default "APN internet"
    depends on STCP_LTE_CUSTOM_PDN

endmenu


menu "MQTT over STCP"

config STCP_MQTT_ENABLE
    bool "Enable MQTT over STCP application"
    default y
    select MQTT_LIB
    select MQTT_LIB_CUSTOM_TRANSPORT
    help
      Enable the Zephyr MQTT library and its custom transport backend.
      MQTT protocol version 3.1.1 is selected by the MQTT library choice
      default and must not be forced with select.

config STCP_MQTT_BROKER_IPV4
    string "MQTT broker IPv4 address"
    default "192.168.1.20"
    depends on STCP_MQTT_ENABLE

config STCP_MQTT_BROKER_PORT
    int "MQTT broker port"
    default 1883
    range 1 65535
    depends on STCP_MQTT_ENABLE

config STCP_MQTT_TOPIC
    string "MQTT publish topic"
    default "stcp/demo"
    depends on STCP_MQTT_ENABLE

config STCP_MQTT_CLIENT_ID
    string "MQTT client ID"
    default "stcp-zephyr"
    depends on STCP_MQTT_ENABLE

config STCP_MQTT_PAYLOAD
    string "MQTT publish payload"
    default "hello from Zephyr over STCP"
    depends on STCP_MQTT_ENABLE

config STCP_MQTT_PUBLISH_INTERVAL_MS
    int "MQTT publish interval in milliseconds"
    default 10000
    range 1000 3600000
    depends on STCP_MQTT_ENABLE

config STCP_MQTT_RECONNECT_DELAY_MS
    int "MQTT reconnect delay in milliseconds"
    default 3000
    range 100 60000
    depends on STCP_MQTT_ENABLE

endmenu

menu "CoAP over STCP"

config STCP_COAP_ENABLE
    bool "Enable CoAP over STCP application"
    default y
    select COAP
    help
      Enable the Zephyr CoAP library. STCPv2 provides the transport.

config STCP_COAP_SERVER_IPV4
    string "CoAP server IPv4 address"
    default "192.168.1.20"
    depends on STCP_COAP_ENABLE

config STCP_COAP_SERVER_PORT
    int "STCP CoAP gateway port"
    default 56830
    range 1 65535
    depends on STCP_COAP_ENABLE

config STCP_COAP_PATH
    string "CoAP resource path"
    default "hello"
    depends on STCP_COAP_ENABLE

config STCP_COAP_INTERVAL_MS
    int "Request interval in milliseconds"
    default 10000
    range 1000 3600000
    depends on STCP_COAP_ENABLE

config STCP_COAP_RECONNECT_DELAY_MS
    int "Reconnect delay in milliseconds"
    default 3000
    range 100 60000
    depends on STCP_COAP_ENABLE

endmenu
```

## prj.conf
```kconfig
# STCPv2 Zephyr clean application base configuration.
#
# Keep this file present because Zephyr requires application/prj.conf.
# The transport/build-specific settings are supplied by EXTRA_CONF_FILE,
# currently application/ethernet-v2.conf.
#
# Intentionally empty.

# CoAP over STCP
CONFIG_COAP=y
```

## ethernet-v2.conf
```kconfig
# STCPv2 Ethernet build for nRF9151 DK + Seeed W5500

CONFIG_THREAD_STACK_INFO=y
CONFIG_INIT_STACKS=y
CONFIG_STACK_SENTINEL=y

# Console and shell
CONFIG_SERIAL=y
CONFIG_CONSOLE=y
CONFIG_UART_CONSOLE=y
CONFIG_PRINTK=y
CONFIG_SHELL=y
CONFIG_SHELL_BACKEND_SERIAL=y
CONFIG_SHELL_PROMPT_UART="stcp> "

# Logging
CONFIG_LOG=y
CONFIG_LOG_MODE_IMMEDIATE=y
CONFIG_LOG_MODE_DEFERRED=n

# Älä ohjaa printk:iä deferred loggerin kautta.
CONFIG_LOG_PRINTK=n

CONFIG_LOG_DEFAULT_LEVEL=2
CONFIG_KERNEL_LOG_LEVEL_WRN=y
CONFIG_LOG_BACKEND_UART=y
CONFIG_SPI_LOG_LEVEL_WRN=y
CONFIG_ETHERNET_LOG_LEVEL_INF=y
CONFIG_NET_LOG=n

# Native Zephyr network stack
CONFIG_NETWORKING=y
CONFIG_NET_BUF=y
CONFIG_NET_NATIVE=y
CONFIG_NET_IPV4=y
CONFIG_NET_IPV6=n
CONFIG_NET_TCP=y
CONFIG_NET_UDP=y
CONFIG_NET_SOCKETS=y
CONFIG_NET_SOCKETS_OFFLOAD=n
CONFIG_NET_L2_ETHERNET=y
CONFIG_ETH_W5500=y
CONFIG_SPI=y
CONFIG_GPIO=y
CONFIG_NET_ARP=y

# Static LAN configuration
CONFIG_NET_DHCPV4=n
CONFIG_NET_CONFIG_SETTINGS=y
CONFIG_NET_CONFIG_AUTO_INIT=y
CONFIG_NET_CONFIG_NEED_IPV4=y
CONFIG_NET_CONFIG_INIT_TIMEOUT=10
CONFIG_NET_CONFIG_MY_IPV4_ADDR="192.168.1.50"
CONFIG_NET_CONFIG_MY_IPV4_NETMASK="255.255.255.0"
CONFIG_NET_CONFIG_MY_IPV4_GW="192.168.1.111"

# MQTT
CONFIG_STCP_MQTT_BROKER_IPV4="192.168.1.20"
CONFIG_STCP_MQTT_BROKER_PORT=18830

# Network management and diagnostics
CONFIG_NET_MGMT=y
CONFIG_NET_MGMT_EVENT=y
CONFIG_NET_CONNECTION_MANAGER=y
CONFIG_NET_SHELL=y
CONFIG_NET_STATISTICS=y

# MQTT and STCP
CONFIG_MQTT_LIB=y

# Memory
#CONFIG_HEAP_MEM_POOL_SIZE=98304
CONFIG_HEAP_MEM_POOL_SIZE=32768
CONFIG_MAIN_STACK_SIZE=4096
CONFIG_ETH_W5500_RX_THREAD_STACK_SIZE=16384
CONFIG_SYSTEM_WORKQUEUE_STACK_SIZE=4096

# Utilities
CONFIG_RING_BUFFER=y
CONFIG_REBOOT=y
CONFIG_ENTROPY_GENERATOR=y
CONFIG_THREAD_NAME=y
CONFIG_ASSERT=y
CONFIG_SPEED_OPTIMIZATIONS=y
CONFIG_ASSERT_VERBOSE=n

# Echo benchmark
CONFIG_ECHO_TRANSPORT_STCP=y
CONFIG_ECHO_SERVER_HOST="192.168.1.20"
CONFIG_ECHO_SERVER_PORT="19000"
CONFIG_ECHO_SOCKET_TIMEOUT_MS=60000
CONFIG_BENCH_TOTAL_BYTES=1048576
CONFIG_BENCH_MAX_CHUNK_SIZE=65536
#OLI CONFIG_BENCH_CHUNK_SIZE=16384
CONFIG_BENCH_CHUNK_SIZE=4096
CONFIG_BENCH_PAUSE_SECONDS=5
CONFIG_BENCH_REPORT_INTERVAL_MS=5000
CONFIG_BENCH_SENDER_STACK_SIZE=4096
CONFIG_BENCH_FULL_RX_BUFFER_SIZE=4096
CONFIG_STCP_BENCH_SHELL=y
CONFIG_STCP_BENCH_AUTORUN=n

# Ethernet build: modem/LTE stack disabled
CONFIG_NRF_MODEM_LIB=n
CONFIG_LTE_LINK_CONTROL=n
CONFIG_PDN=n

CONFIG_BENCH_STCP_BLOCKING_CONNECT=y

# PSA_CRYPTO_CLIENT is generated/hidden in NCS 3.3.0; do not assign it directly.
# Client benchmark needs one active STCP socket; keep one spare for recovery.
# The RX stack is embedded in every pool entry, so limiting the pool saves
# 24+ KiB of static RAM compared with the default eight sockets.
CONFIG_MBEDTLS_PSA_CRYPTO_C=y

# Run benchmark and Rust STCP session creation outside shell_uart.
CONFIG_BENCH_WORKER_STACK_SIZE=8192
CONFIG_BENCH_WORKER_PRIORITY=5
CONFIG_THREAD_STACK_INFO=y



# Clean STCPv2 Zephyr adapter: custom AF_STCP provider, not global socket offload.
CONFIG_STCP_V2=y
CONFIG_STCP_V2_SOCKET_PRIORITY=20
CONFIG_STCP_V2_MAX_SOCKETS=2
CONFIG_STCP_V2_CONNECT_TIMEOUT_MS=60000
CONFIG_STCP_V2_LOG_LEVEL=3
CONFIG_STCP_V2_RUST_TOOLCHAIN="nightly"
#CONFIG_STCP_V2_RX_STACK_SIZE=3072
CONFIG_STCP_V2_RX_STACK_SIZE=8192
CONFIG_STCP_V2_RX_PRIORITY=7
CONFIG_STCP_V2_RX_BUFFER_SIZE=2048
CONFIG_STCP_V2_X25519_SOFTWARE=y
CONFIG_STCP_V2_TRACE_WIRE=n
CONFIG_STCP_V2_TRACE_EVENTS=n
CONFIG_STCP_V2_TRACE_ALLOC=n
CONFIG_STCP_V2_TRACE_CRYPTO=n

# AF_STCP connect is deliberately blocking in the benchmark shell for bring-up.

# CoAP over STCP
CONFIG_COAP=y

CONFIG_STCP_COAP_INTERVAL_MS=2000
```

## ethernet.conf
```kconfig
# STCP Ethernet build for nRF9151 DK + Seeed W5500

CONFIG_THREAD_STACK_INFO=y
CONFIG_INIT_STACKS=y
CONFIG_STACK_SENTINEL=y

# Console and shell
CONFIG_SERIAL=y
CONFIG_CONSOLE=y
CONFIG_UART_CONSOLE=y
CONFIG_PRINTK=y
CONFIG_SHELL=y
CONFIG_SHELL_BACKEND_SERIAL=y
CONFIG_SHELL_PROMPT_UART="stcp> "

# Logging
CONFIG_LOG=y
CONFIG_LOG_MODE_IMMEDIATE=y
CONFIG_LOG_MODE_DEFERRED=n

# Älä ohjaa printk:iä deferred loggerin kautta.
CONFIG_LOG_PRINTK=n

CONFIG_LOG_DEFAULT_LEVEL=2
CONFIG_KERNEL_LOG_LEVEL_WRN=y
CONFIG_LOG_BACKEND_UART=y
CONFIG_SPI_LOG_LEVEL_WRN=y
CONFIG_ETHERNET_LOG_LEVEL_INF=y
CONFIG_NET_LOG=n

# Native Zephyr network stack
CONFIG_NETWORKING=y
CONFIG_NET_BUF=y
CONFIG_NET_NATIVE=y
CONFIG_NET_IPV4=y
CONFIG_NET_IPV6=n
CONFIG_NET_TCP=y
CONFIG_NET_UDP=y
CONFIG_NET_SOCKETS=y
CONFIG_NET_SOCKETS_OFFLOAD=n
CONFIG_NET_L2_ETHERNET=y
CONFIG_ETH_W5500=y
CONFIG_SPI=y
CONFIG_GPIO=y
CONFIG_NET_ARP=y

# Static LAN configuration
CONFIG_NET_DHCPV4=n
CONFIG_NET_CONFIG_SETTINGS=y
CONFIG_NET_CONFIG_AUTO_INIT=y
CONFIG_NET_CONFIG_NEED_IPV4=y
CONFIG_NET_CONFIG_INIT_TIMEOUT=10
CONFIG_NET_CONFIG_MY_IPV4_ADDR="192.168.1.50"
CONFIG_NET_CONFIG_MY_IPV4_NETMASK="255.255.255.0"
CONFIG_NET_CONFIG_MY_IPV4_GW="192.168.1.111"

# MQTT
CONFIG_STCP_MQTT_BROKER_IPV4="192.168.1.20"
CONFIG_STCP_MQTT_BROKER_PORT=18830

# Network management and diagnostics
CONFIG_NET_MGMT=y
CONFIG_NET_MGMT_EVENT=y
CONFIG_NET_CONNECTION_MANAGER=y
CONFIG_NET_SHELL=y
CONFIG_NET_STATISTICS=y

# MQTT and STCP
CONFIG_MQTT_LIB=y

# Memory
#CONFIG_HEAP_MEM_POOL_SIZE=98304
CONFIG_HEAP_MEM_POOL_SIZE=32768
CONFIG_MAIN_STACK_SIZE=4096
CONFIG_ETH_W5500_RX_THREAD_STACK_SIZE=16384
CONFIG_SYSTEM_WORKQUEUE_STACK_SIZE=4096

# Utilities
CONFIG_RING_BUFFER=y
CONFIG_REBOOT=y
CONFIG_ENTROPY_GENERATOR=y
CONFIG_THREAD_NAME=y
CONFIG_ASSERT=y
CONFIG_SPEED_OPTIMIZATIONS=y
CONFIG_ASSERT_VERBOSE=n

# Echo benchmark
CONFIG_ECHO_TRANSPORT_STCP=y
CONFIG_ECHO_SERVER_HOST="192.168.1.20"
CONFIG_ECHO_SERVER_PORT="19000"
CONFIG_ECHO_SOCKET_TIMEOUT_MS=60000
CONFIG_BENCH_TOTAL_BYTES=1048576
CONFIG_BENCH_MAX_CHUNK_SIZE=65536
#OLI CONFIG_BENCH_CHUNK_SIZE=16384
CONFIG_BENCH_CHUNK_SIZE=4096
CONFIG_BENCH_PAUSE_SECONDS=5
CONFIG_BENCH_REPORT_INTERVAL_MS=5000
CONFIG_BENCH_SENDER_STACK_SIZE=4096
CONFIG_BENCH_FULL_RX_BUFFER_SIZE=4096
CONFIG_STCP_BENCH_SHELL=y
CONFIG_STCP_BENCH_AUTORUN=n

# Ethernet build: modem/LTE stack disabled
CONFIG_NRF_MODEM_LIB=n
CONFIG_LTE_LINK_CONTROL=n
CONFIG_PDN=n

CONFIG_BENCH_STCP_BLOCKING_CONNECT=y

# PSA_CRYPTO_CLIENT is generated/hidden in NCS 3.3.0; do not assign it directly.
# Client benchmark needs one active STCP socket; keep one spare for recovery.
# The RX stack is embedded in every pool entry, so limiting the pool saves
# 24+ KiB of static RAM compared with the default eight sockets.
CONFIG_MBEDTLS_PSA_CRYPTO_C=y

# Run benchmark and Rust STCP session creation outside shell_uart.
CONFIG_BENCH_WORKER_STACK_SIZE=8192
CONFIG_BENCH_WORKER_PRIORITY=5
CONFIG_THREAD_STACK_INFO=y



# Clean STCP Zephyr adapter: custom AF_STCP provider, not global socket offload.
CONFIG_STCP_V2=y
CONFIG_STCP_V2_SOCKET_PRIORITY=20
CONFIG_STCP_V2_MAX_SOCKETS=2
CONFIG_STCP_V2_CONNECT_TIMEOUT_MS=60000
CONFIG_STCP_V2_LOG_LEVEL=3
CONFIG_STCP_V2_RUST_TOOLCHAIN="nightly"
#CONFIG_STCP_V2_RX_STACK_SIZE=3072
CONFIG_STCP_V2_RX_STACK_SIZE=8192
CONFIG_STCP_V2_RX_PRIORITY=7
CONFIG_STCP_V2_RX_BUFFER_SIZE=2048
CONFIG_STCP_V2_X25519_SOFTWARE=y
CONFIG_STCP_V2_TRACE_WIRE=n
CONFIG_STCP_V2_TRACE_EVENTS=n
CONFIG_STCP_V2_TRACE_ALLOC=n
CONFIG_STCP_V2_TRACE_CRYPTO=n

# AF_STCP connect is deliberately blocking in the benchmark shell for bring-up.

# CoAP over STCP
CONFIG_COAP=y

CONFIG_STCP_COAP_INTERVAL_MS=2000
```

## src/coap_stcp_transport.c
```c
#include <errno.h>
#include <stddef.h>
#include <stdint.h>

#include <zephyr/logging/log.h>
#include <zephyr/net/net_ip.h>
#include <zephyr/net/socket.h>

#include <stcp/stcp.h>

#include "coap_stcp_transport.h"

LOG_MODULE_REGISTER(coap_stcp_transport, LOG_LEVEL_INF);

static int stcp_fd = -1;

int coap_stcp_fd(void)
{
    return stcp_fd;
}

int coap_stcp_connect(void)
{
    struct net_sockaddr_in peer = { 0 };
    int fd;
    int rc;

    if (stcp_fd >= 0) {
        return 0;
    }

    peer.sin_family = NET_AF_INET;
    peer.sin_port = net_htons(CONFIG_STCP_COAP_SERVER_PORT);

    rc = zsock_inet_pton(NET_AF_INET,
                         CONFIG_STCP_COAP_SERVER_IPV4,
                         &peer.sin_addr);
    if (rc != 1) {
        LOG_ERR("Invalid CoAP gateway IPv4 address: %s",
                CONFIG_STCP_COAP_SERVER_IPV4);
        return -EINVAL;
    }

    LOG_INF("CoAP STCP-UDP connect target=%s:%d public=SOCK_STREAM/%d",
            CONFIG_STCP_COAP_SERVER_IPV4,
            CONFIG_STCP_COAP_SERVER_PORT,
            IPPROTO_STCP_UDP);

    /*
     * Canonical STCP public ABI, matching Linux/SDK:
     *   SOCK_STREAM + 253 -> STCP-TCP
     *   SOCK_STREAM + 254 -> STCP-UDP
     *
     * module-v2 maps protocol 254 internally to a UDP carrier.
     */
    fd = zsock_socket(AF_STCP, NET_SOCK_STREAM, IPPROTO_STCP_UDP);
    if (fd < 0) {
        int err = -errno;
        LOG_ERR("CoAP STCP-UDP socket failed errno=%d", errno);
        return err;
    }

    if (zsock_connect(fd,
                      (const struct net_sockaddr *)&peer,
                      sizeof(peer)) < 0) {
        int err = -errno;

        LOG_ERR("CoAP STCP-UDP connect failed target=%s:%d fd=%d errno=%d",
                CONFIG_STCP_COAP_SERVER_IPV4,
                CONFIG_STCP_COAP_SERVER_PORT,
                fd,
                errno);

        (void)zsock_close(fd);
        return err;
    }

    stcp_fd = fd;

    LOG_INF("CoAP STCP-UDP transport connected fd=%d target=%s:%d",
            fd,
            CONFIG_STCP_COAP_SERVER_IPV4,
            CONFIG_STCP_COAP_SERVER_PORT);
    return 0;
}

void coap_stcp_close(void)
{
    if (stcp_fd >= 0) {
        (void)zsock_close(stcp_fd);
        stcp_fd = -1;
    }
}

int coap_stcp_send(const uint8_t *data, size_t len)
{
    size_t sent = 0U;

    if (stcp_fd < 0) {
        return -ENOTCONN;
    }

    while (sent < len) {
        ssize_t n = zsock_send(stcp_fd, data + sent, len - sent, 0);

        if (n < 0) {
            return -errno;
        }
        if (n == 0) {
            return -ECONNRESET;
        }

        sent += (size_t)n;
    }

    return 0;
}

int coap_stcp_recv(uint8_t *data, size_t len)
{
    ssize_t n;

    if (stcp_fd < 0) {
        return -ENOTCONN;
    }

    n = zsock_recv(stcp_fd, data, len, 0);
    if (n < 0) {
        return -errno;
    }

    return (int)n;
}
```
