## STCPv4/zephyr/nordic/application/build-v2-clean/Kconfig/soc/Kconfig.sysbuild
```kconfig
# Load Sysbuild SoC Kconfig descriptions.
osource "/home/pomo/zephyr-stcp/zephyr/soc/xlnx/zynqmp/Kconfig.sysbuild"
osource "/home/pomo/zephyr-stcp/zephyr/soc/xlnx/zynq7000/Kconfig.sysbuild"
osource "/home/pomo/zephyr-stcp/zephyr/soc/xlnx/versalnet/Kconfig.sysbuild"
osource "/home/pomo/zephyr-stcp/zephyr/soc/xlnx/versal2/Kconfig.sysbuild"
osource "/home/pomo/zephyr-stcp/zephyr/soc/xlnx/versal/Kconfig.sysbuild"
osource "/home/pomo/zephyr-stcp/zephyr/soc/xen/Kconfig.sysbuild"
osource "/home/pomo/zephyr-stcp/zephyr/soc/wch/ch32v/Kconfig.sysbuild"
osource "/home/pomo/zephyr-stcp/zephyr/soc/ti/simplelink/Kconfig.sysbuild"
osource "/home/pomo/zephyr-stcp/zephyr/soc/ti/mspm0/Kconfig.sysbuild"
osource "/home/pomo/zephyr-stcp/zephyr/soc/ti/lm3s6965/Kconfig.sysbuild"
osource "/home/pomo/zephyr-stcp/zephyr/soc/ti/k3/Kconfig.sysbuild"
osource "/home/pomo/zephyr-stcp/zephyr/soc/telink/tlsr/Kconfig.sysbuild"
osource "/home/pomo/zephyr-stcp/zephyr/soc/starfive/jh71xx/Kconfig.sysbuild"
osource "/home/pomo/zephyr-stcp/zephyr/soc/st/stm32/Kconfig.sysbuild"
osource "/home/pomo/zephyr-stcp/zephyr/soc/snps/qemu_arc/Kconfig.sysbuild"
osource "/home/pomo/zephyr-stcp/zephyr/soc/snps/nsim/arc_v/Kconfig.sysbuild"
osource "/home/pomo/zephyr-stcp/zephyr/soc/snps/nsim/arc_classic/Kconfig.sysbuild"
osource "/home/pomo/zephyr-stcp/zephyr/soc/snps/hsdk4xd/Kconfig.sysbuild"
osource "/home/pomo/zephyr-stcp/zephyr/soc/snps/hsdk/Kconfig.sysbuild"
osource "/home/pomo/zephyr-stcp/zephyr/soc/snps/emsk/Kconfig.sysbuild"
osource "/home/pomo/zephyr-stcp/zephyr/soc/snps/emsdp/Kconfig.sysbuild"
osource "/home/pomo/zephyr-stcp/zephyr/soc/snps/arc_iot/Kconfig.sysbuild"
osource "/home/pomo/zephyr-stcp/zephyr/soc/silabs/Kconfig.sysbuild"
osource "/home/pomo/zephyr-stcp/zephyr/soc/sifli/sf32/Kconfig.sysbuild"
osource "/home/pomo/zephyr-stcp/zephyr/soc/sifive/sifive_freedom/Kconfig.sysbuild"
osource "/home/pomo/zephyr-stcp/zephyr/soc/sensry/Kconfig.sysbuild"
osource "/home/pomo/zephyr-stcp/zephyr/soc/rockchip/Kconfig.sysbuild"
osource "/home/pomo/zephyr-stcp/zephyr/soc/renode/riscv_virtual/Kconfig.sysbuild"
osource "/home/pomo/zephyr-stcp/zephyr/soc/renode/cortex_r8_virtual/Kconfig.sysbuild"
osource "/home/pomo/zephyr-stcp/zephyr/soc/renesas/smartbond/Kconfig.sysbuild"
osource "/home/pomo/zephyr-stcp/zephyr/soc/renesas/rz/Kconfig.sysbuild"
osource "/home/pomo/zephyr-stcp/zephyr/soc/renesas/rx/Kconfig.sysbuild"
osource "/home/pomo/zephyr-stcp/zephyr/soc/renesas/rcar/Kconfig.sysbuild"
osource "/home/pomo/zephyr-stcp/zephyr/soc/renesas/ra/Kconfig.sysbuild"
osource "/home/pomo/zephyr-stcp/zephyr/soc/realtek/ec/Kconfig.sysbuild"
osource "/home/pomo/zephyr-stcp/zephyr/soc/realtek/ameba/Kconfig.sysbuild"
osource "/home/pomo/zephyr-stcp/zephyr/soc/raspberrypi/rpi_pico/Kconfig.sysbuild"
osource "/home/pomo/zephyr-stcp/zephyr/soc/quicklogic/eos_s3/Kconfig.sysbuild"
osource "/home/pomo/zephyr-stcp/zephyr/soc/qemu/virt_riscv/Kconfig.sysbuild"
osource "/home/pomo/zephyr-stcp/zephyr/soc/qemu/malta/Kconfig.sysbuild"
osource "/home/pomo/zephyr-stcp/zephyr/soc/openisa/rv32m1/Kconfig.sysbuild"
osource "/home/pomo/zephyr-stcp/zephyr/soc/openhwgroup/cva6/Kconfig.sysbuild"
osource "/home/pomo/zephyr-stcp/zephyr/soc/oct/osd32mp15x/Kconfig.sysbuild"
osource "/home/pomo/zephyr-stcp/zephyr/soc/nxp/s32/Kconfig.sysbuild"
osource "/home/pomo/zephyr-stcp/zephyr/soc/nxp/rw/Kconfig.sysbuild"
osource "/home/pomo/zephyr-stcp/zephyr/soc/nxp/mcx/Kconfig.sysbuild"
osource "/home/pomo/zephyr-stcp/zephyr/soc/nxp/lpc/Kconfig.sysbuild"
osource "/home/pomo/zephyr-stcp/zephyr/soc/nxp/layerscape/Kconfig.sysbuild"
osource "/home/pomo/zephyr-stcp/zephyr/soc/nxp/kinetis/Kconfig.sysbuild"
osource "/home/pomo/zephyr-stcp/zephyr/soc/nxp/imxrt/Kconfig.sysbuild"
osource "/home/pomo/zephyr-stcp/zephyr/soc/nxp/imx/Kconfig.sysbuild"
osource "/home/pomo/zephyr-stcp/zephyr/soc/nuvoton/numicro/Kconfig.sysbuild"
osource "/home/pomo/zephyr-stcp/zephyr/soc/nuvoton/numaker/Kconfig.sysbuild"
osource "/home/pomo/zephyr-stcp/zephyr/soc/nuvoton/npcx/Kconfig.sysbuild"
osource "/home/pomo/zephyr-stcp/zephyr/soc/nuvoton/npcm/Kconfig.sysbuild"
osource "/home/pomo/zephyr-stcp/zephyr/soc/nordic/Kconfig.sysbuild"
osource "/home/pomo/zephyr-stcp/zephyr/soc/neorv32/Kconfig.sysbuild"
osource "/home/pomo/zephyr-stcp/zephyr/soc/native/inf_clock/Kconfig.sysbuild"
osource "/home/pomo/zephyr-stcp/zephyr/soc/microchip/sam/sama7/Kconfig.sysbuild"
osource "/home/pomo/zephyr-stcp/zephyr/soc/microchip/sam/sam_d5x_e5x/Kconfig.sysbuild"
osource "/home/pomo/zephyr-stcp/zephyr/soc/microchip/pic64/Kconfig.sysbuild"
osource "/home/pomo/zephyr-stcp/zephyr/soc/microchip/pic32c/pic32cz_ca/Kconfig.sysbuild"
osource "/home/pomo/zephyr-stcp/zephyr/soc/microchip/pic32c/pic32cx_sg/Kconfig.sysbuild"
osource "/home/pomo/zephyr-stcp/zephyr/soc/microchip/pic32c/pic32cm_jh/Kconfig.sysbuild"
osource "/home/pomo/zephyr-stcp/zephyr/soc/microchip/miv/Kconfig.sysbuild"
osource "/home/pomo/zephyr-stcp/zephyr/soc/microchip/mec/Kconfig.sysbuild"
osource "/home/pomo/zephyr-stcp/zephyr/soc/mediatek/mt8xxx/Kconfig.sysbuild"
osource "/home/pomo/zephyr-stcp/zephyr/soc/lowrisc/opentitan/Kconfig.sysbuild"
osource "/home/pomo/zephyr-stcp/zephyr/soc/litex/litex_vexriscv/Kconfig.sysbuild"
osource "/home/pomo/zephyr-stcp/zephyr/soc/ite/ec/Kconfig.sysbuild"
osource "/home/pomo/zephyr-stcp/zephyr/soc/intel/wildcat_lake/Kconfig.sysbuild"
osource "/home/pomo/zephyr-stcp/zephyr/soc/intel/raptor_lake/Kconfig.sysbuild"
osource "/home/pomo/zephyr-stcp/zephyr/soc/intel/panther_lake/Kconfig.sysbuild"
osource "/home/pomo/zephyr-stcp/zephyr/soc/intel/lakemont/Kconfig.sysbuild"
osource "/home/pomo/zephyr-stcp/zephyr/soc/intel/intel_socfpga_std/Kconfig.sysbuild"
osource "/home/pomo/zephyr-stcp/zephyr/soc/intel/intel_socfpga/Kconfig.sysbuild"
osource "/home/pomo/zephyr-stcp/zephyr/soc/intel/intel_niosv/Kconfig.sysbuild"
osource "/home/pomo/zephyr-stcp/zephyr/soc/intel/intel_ish/Kconfig.sysbuild"
osource "/home/pomo/zephyr-stcp/zephyr/soc/intel/intel_adsp/Kconfig.sysbuild"
osource "/home/pomo/zephyr-stcp/zephyr/soc/intel/elkhart_lake/Kconfig.sysbuild"
osource "/home/pomo/zephyr-stcp/zephyr/soc/intel/atom/Kconfig.sysbuild"
osource "/home/pomo/zephyr-stcp/zephyr/soc/intel/apollo_lake/Kconfig.sysbuild"
osource "/home/pomo/zephyr-stcp/zephyr/soc/intel/alder_lake/Kconfig.sysbuild"
osource "/home/pomo/zephyr-stcp/zephyr/soc/infineon/psoc4/Kconfig.sysbuild"
osource "/home/pomo/zephyr-stcp/zephyr/soc/infineon/edge/Kconfig.sysbuild"
osource "/home/pomo/zephyr-stcp/zephyr/soc/infineon/cat3/Kconfig.sysbuild"
osource "/home/pomo/zephyr-stcp/zephyr/soc/infineon/cat1c/Kconfig.sysbuild"
osource "/home/pomo/zephyr-stcp/zephyr/soc/infineon/cat1b/Kconfig.sysbuild"
osource "/home/pomo/zephyr-stcp/zephyr/soc/infineon/cat1a/Kconfig.sysbuild"
osource "/home/pomo/zephyr-stcp/zephyr/soc/gd/gd32/Kconfig.sysbuild"
osource "/home/pomo/zephyr-stcp/zephyr/soc/gaisler/leon3/Kconfig.sysbuild"
osource "/home/pomo/zephyr-stcp/zephyr/soc/gaisler/gr716a/Kconfig.sysbuild"
osource "/home/pomo/zephyr-stcp/zephyr/soc/focaltech/Kconfig.sysbuild"
osource "/home/pomo/zephyr-stcp/zephyr/soc/espressif/Kconfig.sysbuild"
osource "/home/pomo/zephyr-stcp/zephyr/soc/ene/kb1200/Kconfig.sysbuild"
osource "/home/pomo/zephyr-stcp/zephyr/soc/ene/kb106x/Kconfig.sysbuild"
osource "/home/pomo/zephyr-stcp/zephyr/soc/elan/em32f967/Kconfig.sysbuild"
osource "/home/pomo/zephyr-stcp/zephyr/soc/egis/Kconfig.sysbuild"
osource "/home/pomo/zephyr-stcp/zephyr/soc/efinix/sapphire/Kconfig.sysbuild"
osource "/home/pomo/zephyr-stcp/zephyr/soc/cdns/xtensa_sample_controller/Kconfig.sysbuild"
osource "/home/pomo/zephyr-stcp/zephyr/soc/cdns/sample_controller32/Kconfig.sysbuild"
osource "/home/pomo/zephyr-stcp/zephyr/soc/cdns/dc233c/Kconfig.sysbuild"
osource "/home/pomo/zephyr-stcp/zephyr/soc/brcm/bcmvk/Kconfig.sysbuild"
osource "/home/pomo/zephyr-stcp/zephyr/soc/brcm/bcm2712/Kconfig.sysbuild"
osource "/home/pomo/zephyr-stcp/zephyr/soc/brcm/bcm2711/Kconfig.sysbuild"
osource "/home/pomo/zephyr-stcp/zephyr/soc/blackberry/qnxhv_vm/Kconfig.sysbuild"
osource "/home/pomo/zephyr-stcp/zephyr/soc/bflb/Kconfig.sysbuild"
osource "/home/pomo/zephyr-stcp/zephyr/soc/atmel/sam0/Kconfig.sysbuild"
osource "/home/pomo/zephyr-stcp/zephyr/soc/atmel/sam/Kconfig.sysbuild"
osource "/home/pomo/zephyr-stcp/zephyr/soc/aspeed/Kconfig.sysbuild"
osource "/home/pomo/zephyr-stcp/zephyr/soc/arm/Kconfig.sysbuild"
osource "/home/pomo/zephyr-stcp/zephyr/soc/arm/beetle/Kconfig.sysbuild"
osource "/home/pomo/zephyr-stcp/zephyr/soc/antmicro/myra/Kconfig.sysbuild"
osource "/home/pomo/zephyr-stcp/zephyr/soc/andestech/Kconfig.sysbuild"
osource "/home/pomo/zephyr-stcp/zephyr/soc/amd/acp_6_0/Kconfig.sysbuild"
osource "/home/pomo/zephyr-stcp/zephyr/soc/ambiq/Kconfig.sysbuild"
osource "/home/pomo/zephyr-stcp/zephyr/soc/allwinner/sun8i_h3/Kconfig.sysbuild"
osource "/home/pomo/zephyr-stcp/zephyr/soc/aesc/Kconfig.sysbuild"
osource "/home/pomo/zephyr-stcp/zephyr/soc/adi/max32/Kconfig.sysbuild"
osource "/home/pomo/zephyr-stcp/nrf/soc/sercomm/nrf91/Kconfig.sysbuild"
osource "/home/pomo/zephyr-stcp/nrf/soc/nordic/Kconfig.sysbuild"
```

## STCPv4/zephyr/nordic/module-v2/Kconfig
```kconfig
menuconfig STCP_V2
    bool "STCPv2 clean AF_STCP provider"
    depends on NET_SOCKETS
    default n
    help
      Clean Zephyr adapter for the canonical shared STCPv2 Rust core.
      This deliberately does NOT select NET_SOCKETS_OFFLOAD. AF_STCP is
      registered as its own socket family with NET_SOCKET_REGISTER so normal
      AF_INET sockets continue to use the native Ethernet/LTE stack.

if STCP_V2
config STCP_V2_SOCKET_PRIORITY
    int "AF_STCP socket provider priority"
    default 20

config STCP_V2_MAX_SOCKETS
    int "Maximum STCPv2 sockets"
    default 8
    range 2 16

config STCP_V2_CONNECT_TIMEOUT_MS
    int "STCPv2 handshake timeout"
    default 60000
    range 1000 300000

config STCP_V2_LOG_LEVEL
    int "STCPv2 adapter log level"
    default 3
    range 0 4

config STCP_V2_RUST_TOOLCHAIN
    string "Rustup toolchain"
    default "nightly"

config STCP_V2_RX_STACK_SIZE
    int "Per-socket native carrier RX thread stack"
    default 4096
    range 2048 32768

config STCP_V2_RX_PRIORITY
    int "Native carrier RX thread priority"
    default 7

config STCP_V2_RX_BUFFER_SIZE
    int "Native carrier RX buffer"
    default 2048
    range 512 8192

config STCP_V2_HEXDUMP_BYTES
    int "Maximum wire trace bytes"
    default 96
    range 16 512

config STCP_V2_TRACE_WIRE
    bool "Trace STCPv2 wire frames"
    default n

config STCP_V2_TRACE_EVENTS
    bool "Trace shared-core events"
    default n

config STCP_V2_TRACE_ALLOC
    bool "Trace shared-core allocations"
    default n

config STCP_V2_TRACE_CRYPTO
    bool "Trace crypto backend"
    default n

config STCP_V2_X25519_SOFTWARE
    bool "Use bundled RFC7748 X25519 keypair backend"
    default y
    select MBEDTLS_PSA_CRYPTO_C
    select PSA_WANT_ALG_SHA_256
    select PSA_WANT_ALG_HMAC
    select PSA_WANT_KEY_TYPE_HMAC
    select PSA_WANT_ALG_ECDH
    select PSA_WANT_ECC_MONTGOMERY_255
    select PSA_WANT_KEY_TYPE_ECC_KEY_PAIR_IMPORT
    select PSA_WANT_KEY_TYPE_ECC_KEY_PAIR_DERIVE

endif
```

## STCPv4/zephyr/nordic/p2p-application/build/p2p-application/Kconfig/boards/Kconfig.defconfig
```kconfig
# Load Zephyr board defconfig descriptions.
osource "/home/pomo/zephyr-stcp/zephyr/boards/nordic/nrf9151dk/Kconfig.defconfig"
```

## STCPv6/zephyr/nordic/module-v2/Kconfig
```kconfig
menuconfig STCP
    bool "STCP2 socket offload"
    depends on NET_SOCKETS
    select NET_SOCKETS_OFFLOAD
    default n

if STCP
config STCP_SOCKET_PRIORITY
    int "Socket provider priority"
    default 20
config STCP_MAX_SOCKETS
    int "Maximum STCP sockets"
    default 8
    range 1 16
config STCP_CONNECT_TIMEOUT_MS
    int "Carrier and Rust handshake connect timeout"
    default 60000
    range 1000 300000
config STCP_LOG_LEVEL
    int "STCP log level"
    default 3
    range 0 4

menuconfig STCP_DEBUG
    bool "Compile STCP debug diagnostics"
    default n
    help
      Master switch for verbose STCP diagnostics. When disabled, all category
      macros compile out completely. Functional LOG_ERR messages remain.

if STCP_DEBUG
config STCP_DEBUG_POLL
    bool "Poll and fdtable diagnostics"
    default n
config STCP_DEBUG_RX
    bool "Receive path and wire-frame diagnostics"
    default n
config STCP_DEBUG_TX
    bool "Transmit path diagnostics"
    default n
config STCP_DEBUG_CARRIER
    bool "Carrier socket diagnostics"
    default n
config STCP_DEBUG_SOCKET
    bool "AF_STCP socket lifecycle diagnostics"
    default n
config STCP_DEBUG_HANDSHAKE
    bool "Handshake state diagnostics"
    default n
config STCP_DEBUG_CRYPTO
    bool "Crypto and X25519 diagnostics"
    default n
config STCP_DEBUG_MQTT
    bool "MQTT client and generator diagnostics"
    default n
config STCP_DEBUG_W5500
    bool "W5500 driver diagnostics"
    default n
    help
      Reserved for the W5500 driver patch. The driver should wrap verbose IRQ,
      SPI and polling fallback messages with this option.
endif

config STCP_POLL_TRACE
    bool
    default STCP_DEBUG_POLL
    help
      Compatibility symbol for older poll-debug code. New code should use
      CONFIG_STCP_DEBUG_POLL and the macros in stcp_debug.h.

menuconfig STCP_RUST_CORE
    bool "Use shared Raspberry Pi Rust STCP protocol core"
    default y
    select MBEDTLS_PSA_CRYPTO_C
    help
      Builds the no_std Rust STCP core as a static library and links it into
      Zephyr. C remains only the BSD socket and native carrier adapter.

if STCP_RUST_CORE
config STCP_RUST_TOOLCHAIN
    string "Rustup toolchain used by Cargo"
    default "nightly"
config STCP_RUST_RX_STACK_SIZE
    int "Per-socket Rust carrier RX thread stack"
    default 8192
    range 4096 12288
    help
      Stack for the per-socket Rust carrier RX thread. The software RFC 7748
      X25519 backend and Rust handshake processing run in this thread, so the
      stack must also cover the RX buffer and crypto call chain. Use 8192
      bytes on nRF9151 software-X25519 builds to balance safety and RAM use.
config STCP_RUST_RX_PRIORITY
    int "Rust carrier RX thread priority"
    default 7
config STCP_RUST_RX_BUFFER_SIZE
    int "Rust carrier RX buffer"
    default 512
    range 512 8192
config STCP_RUST_HEXDUMP_BYTES
    int "Maximum bytes in Rust wire hexdumps"
    default 96
    range 16 512
config STCP_RUST_TRACE_WIRE
    bool "Trace Rust STCP wire frames (legacy compatibility)"
    default n
config STCP_RUST_TRACE_EVENTS
    bool "Trace numeric Rust core events"
    default n
config STCP_RUST_TRACE_ALLOC
    bool "Trace Rust allocations"
    default n
config STCP_RUST_TRACE_CRYPTO
    bool "Trace Rust STCP crypto backend and PSA operations (legacy compatibility)"
    default n
config STCP_RUST_X25519_SOFTWARE
    bool "Use bundled software X25519 backend"
    default y
    help
      Use the bundled constant-time RFC 7748 X25519 implementation. PSA is
      used only as the cryptographic random-number generator. This is needed
      on NCS 3.3.0 targets whose PSA/TF-M backend does not expose Montgomery
      key generation, import, or ECDH.
endif
endif
```
