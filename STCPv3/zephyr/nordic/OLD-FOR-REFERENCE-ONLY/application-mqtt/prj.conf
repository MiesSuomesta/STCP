## Kconfig
```
mainmenu "STCPv2 MQTT application"

source "Kconfig.zephyr"

#
# Some NCS/Zephyr revisions carry the MQTT custom-transport code in mqtt.h /
# mqtt_transport.c but do not expose a selectable Kconfig symbol in the same
# way as upstream main.  Define/augment it here so the public structures and
# enum values guarded by CONFIG_MQTT_LIB_CUSTOM_TRANSPORT are compiled in.
#
config MQTT_LIB_CUSTOM_TRANSPORT
    bool "Enable MQTT custom transport"
    depends on MQTT_LIB
    default y
    help
      Enable Zephyr MQTT custom transport support.  The STCP MQTT application
      uses this to bind the Zephyr MQTT protocol engine to AF_STCP.

menu "STCP MQTT"

config STCP_MQTT_BROKER_IPV4
    string "MQTT broker IPv4"
    default "192.168.1.20"

config STCP_MQTT_BROKER_PORT
    int "MQTT broker port"
    default 1883
    range 1 65535

config STCP_MQTT_TOPIC
    string "Publish topic"
    default "stcp/demo"

config STCP_MQTT_CLIENT_ID
    string "MQTT client ID"
    default "stcp-zephyr"

config STCP_MQTT_PAYLOAD
    string "Publish payload"
    default "hello from Zephyr over STCP"

config STCP_MQTT_PUBLISH_INTERVAL_MS
    int "Publish interval ms"
    default 10000
    range 1000 3600000

config STCP_MQTT_RECONNECT_DELAY_MS
    int "Reconnect delay ms"
    default 3000
    range 100 60000

endmenu
```

## prj.conf
```kconfig
# STCPv2 Zephyr clean application base configuration.
#
# Keep this file present because Zephyr requires application/prj.conf.
# The transport/build-specific settings are supplied by EXTRA_CONF_FILE,
# currently application/ethernet-v2.conf.
#
# Intentionally empty.

# MQTT over STCP
CONFIG_MQTT_LIB=y
CONFIG_MQTT_LIB_CUSTOM_TRANSPORT=y
CONFIG_MQTT_VERSION_3_1_1=y
CONFIG_MQTT_KEEPALIVE=60
CONFIG_MQTT_LOG_LEVEL_INF=y
```

## mqtt.conf
```kconfig
# Additive config on top of duplicated golden Zephyr application.

CONFIG_MQTT_LIB=y
CONFIG_MQTT_LIB_CUSTOM_TRANSPORT=y
CONFIG_MQTT_VERSION_3_1_1=y
CONFIG_MQTT_KEEPALIVE=60
CONFIG_MQTT_LOG_LEVEL_INF=y

# Keep the proven STCP settings explicit in this project.
CONFIG_STCP_V2=y
CONFIG_STCP_V2_MAX_SOCKETS=2
CONFIG_STCP_V2_CONNECT_TIMEOUT_MS=60000
CONFIG_STCP_V2_RX_STACK_SIZE=8192
CONFIG_STCP_V2_RX_PRIORITY=7
CONFIG_STCP_V2_RX_BUFFER_SIZE=2048
```

## src/main.c
```c
#include <errno.h>
#include <stdint.h>
#include <string.h>

#include <zephyr/kernel.h>
#include <zephyr/logging/log.h>
#include <zephyr/net/mqtt.h>
#include <zephyr/net/net_ip.h>
#include <zephyr/net/socket.h>

#include "mqtt_stcp_transport.h"

LOG_MODULE_REGISTER(stcp_mqtt_app, LOG_LEVEL_INF);

static struct mqtt_client client;

static struct mqtt_stcp_transport_data transport = {
    .fd = -1,
};

static struct net_sockaddr_in broker;

static uint8_t rx_buffer[1024];
static uint8_t tx_buffer[1024];

static bool connected;

static void mqtt_evt_handler(struct mqtt_client *const client,
                             const struct mqtt_evt *evt)
{
    ARG_UNUSED(client);

    switch (evt->type) {
    case MQTT_EVT_CONNACK:
        if (evt->result == 0 && evt->param.connack.return_code == 0) {
            connected = true;
            LOG_INF("MQTT CONNACK OK");
        } else {
            LOG_ERR("MQTT CONNACK failed result=%d code=%u",
                    evt->result,
                    evt->param.connack.return_code);
        }
        break;

    case MQTT_EVT_DISCONNECT:
        connected = false;
        LOG_WRN("MQTT disconnected result=%d", evt->result);
        break;

    case MQTT_EVT_PUBACK:
        LOG_INF("MQTT PUBACK id=%u", evt->param.puback.message_id);
        break;

    case MQTT_EVT_PINGRESP:
        LOG_DBG("MQTT PINGRESP");
        break;

    default:
        break;
    }
}

static int broker_init(void)
{
    memset(&broker, 0, sizeof(broker));

    broker.sin_family = NET_AF_INET;
    broker.sin_port = net_htons(CONFIG_STCP_MQTT_BROKER_PORT);

    if (zsock_inet_pton(NET_AF_INET,
                        CONFIG_STCP_MQTT_BROKER_IPV4,
                        &broker.sin_addr) != 1) {
        return -EINVAL;
    }

    return 0;
}

static void client_init(void)
{
    mqtt_client_init(&client);

    client.broker = &broker;
    client.evt_cb = mqtt_evt_handler;

    client.client_id.utf8 = (uint8_t *)CONFIG_STCP_MQTT_CLIENT_ID;
    client.client_id.size = strlen(CONFIG_STCP_MQTT_CLIENT_ID);

    client.password = NULL;
    client.user_name = NULL;

    client.protocol_version = MQTT_VERSION_3_1_1;

    client.rx_buf = rx_buffer;
    client.rx_buf_size = sizeof(rx_buffer);
    client.tx_buf = tx_buffer;
    client.tx_buf_size = sizeof(tx_buffer);

    client.transport.type = MQTT_TRANSPORT_CUSTOM;
    client.transport.custom_transport_data = &transport;
}

static int service_until_connected(int timeout_ms)
{
    int64_t deadline = k_uptime_get() + timeout_ms;

    while (!connected && k_uptime_get() < deadline) {
        struct zsock_pollfd pfd = {
            .fd = mqtt_stcp_poll_fd(&client),
            .events = ZSOCK_POLLIN,
        };

        int rc = zsock_poll(&pfd, 1, 500);
        if (rc < 0) {
            return -errno;
        }

        if (rc > 0 && (pfd.revents & ZSOCK_POLLIN) != 0) {
            rc = mqtt_input(&client);
            if (rc < 0 && rc != -EAGAIN) {
                return rc;
            }
        }

        rc = mqtt_live(&client);
        if (rc < 0 && rc != -EAGAIN) {
            return rc;
        }
    }

    return connected ? 0 : -ETIMEDOUT;
}

static int publish_once(uint32_t sequence)
{
    char payload[256];
    struct mqtt_publish_param param;
    int len;

    len = snprintk(payload,
                   sizeof(payload),
                   "%s seq=%u uptime_ms=%lld",
                   CONFIG_STCP_MQTT_PAYLOAD,
                   sequence,
                   (long long)k_uptime_get());

    if (len < 0) {
        return len;
    }

    if ((size_t)len >= sizeof(payload)) {
        len = sizeof(payload) - 1;
    }

    memset(&param, 0, sizeof(param));

    param.message.topic.qos = MQTT_QOS_0_AT_MOST_ONCE;
    param.message.topic.topic.utf8 =
        (uint8_t *)CONFIG_STCP_MQTT_TOPIC;
    param.message.topic.topic.size =
        strlen(CONFIG_STCP_MQTT_TOPIC);

    param.message.payload.data = (uint8_t *)payload;
    param.message.payload.len = (size_t)len;

    param.message_id = (uint16_t)(sequence & 0xffffU);
    param.dup_flag = 0U;
    param.retain_flag = 0U;

    return mqtt_publish(&client, &param);
}

int main(void)
{
    uint32_t sequence = 1U;
    int rc;

    LOG_INF("Zephyr MQTT over STCP starting");
    LOG_INF("broker=%s:%d topic=%s",
            CONFIG_STCP_MQTT_BROKER_IPV4,
            CONFIG_STCP_MQTT_BROKER_PORT,
            CONFIG_STCP_MQTT_TOPIC);

    rc = broker_init();
    if (rc < 0) {
        LOG_ERR("broker_init failed: %d", rc);
        return rc;
    }

    while (true) {
        connected = false;
        transport.fd = -1;

        client_init();

        LOG_INF("Connecting MQTT using Zephyr MQTT library + STCP transport");

        rc = mqtt_connect(&client);
        if (rc < 0) {
            LOG_ERR("mqtt_connect failed: %d", rc);
            goto reconnect;
        }

        rc = service_until_connected(15000);
        if (rc < 0) {
            LOG_ERR("CONNACK wait failed: %d", rc);
            (void)mqtt_abort(&client);
            goto reconnect;
        }

        LOG_INF("MQTT connected over STCP");

        while (connected) {
            int64_t deadline;

            rc = publish_once(sequence++);
            if (rc < 0) {
                LOG_ERR("mqtt_publish failed: %d", rc);
                break;
            }

            LOG_INF("MQTT PUBLISH OK");

            deadline =
                k_uptime_get() + CONFIG_STCP_MQTT_PUBLISH_INTERVAL_MS;

            while (connected && k_uptime_get() < deadline) {
                int timeout = mqtt_keepalive_time_left(&client);
                struct zsock_pollfd pfd = {
                    .fd = mqtt_stcp_poll_fd(&client),
                    .events = ZSOCK_POLLIN,
                };

                if (timeout < 0 || timeout > 500) {
                    timeout = 500;
                }

                rc = zsock_poll(&pfd, 1, timeout);
                if (rc < 0) {
                    rc = -errno;
                    break;
                }

                if (rc > 0 && (pfd.revents & ZSOCK_POLLIN) != 0) {
                    rc = mqtt_input(&client);
                    if (rc < 0 && rc != -EAGAIN) {
                        break;
                    }
                }

                rc = mqtt_live(&client);
                if (rc < 0 && rc != -EAGAIN) {
                    break;
                }
            }
        }

        (void)mqtt_abort(&client);

reconnect:
        LOG_WRN("MQTT reconnect in %d ms",
                CONFIG_STCP_MQTT_RECONNECT_DELAY_MS);
        k_sleep(K_MSEC(CONFIG_STCP_MQTT_RECONNECT_DELAY_MS));
    }

    return 0;
}
```
