## CMakeLists.txt
```
message(STATUS "Loading STCP2 offload module from ${CMAKE_CURRENT_LIST_DIR}")
zephyr_include_directories(${CMAKE_CURRENT_LIST_DIR}/include)
zephyr_library_named(stcp)
zephyr_library_sources_ifdef(CONFIG_STCP
    src/stcp_context.c
    src/stcp_carrier.c
    src/stcp_socket_offload.c
)

if(CONFIG_STCP_RUST_CORE)
    zephyr_library_sources(
        src/stcp_rust_platform.c
        src/stcp_rust_rx.c
        src/stcp_x25519_soft.c
    )

    find_program(CARGO_EXECUTABLE cargo REQUIRED)
    set(STCP_RUST_DIR ${CMAKE_CURRENT_LIST_DIR}/rust)
    set(STCP_RUST_TARGET thumbv8m.main-none-eabi)
    set(STCP_RUST_PROFILE release)
    set(STCP_RUST_LIB ${STCP_RUST_DIR}/target/${STCP_RUST_TARGET}/${STCP_RUST_PROFILE}/libstcp_kernel_core.a)

    add_custom_command(
        OUTPUT ${STCP_RUST_LIB}
        COMMAND ${CMAKE_COMMAND} -E env
            CARGO_TERM_COLOR=always
            RUSTUP_TOOLCHAIN=${CONFIG_STCP_RUST_TOOLCHAIN}
            ${CARGO_EXECUTABLE} build
                -Z build-std=core,alloc
                --manifest-path ${STCP_RUST_DIR}/Cargo.toml
                --target ${STCP_RUST_TARGET}
                --release
        DEPENDS
            ${STCP_RUST_DIR}/Cargo.toml
            ${STCP_RUST_DIR}/.cargo/config.toml
            ${STCP_RUST_DIR}/src/lib.rs
            ${STCP_RUST_DIR}/src/ffi.rs
            ${STCP_RUST_DIR}/src/session.rs
            ${STCP_RUST_DIR}/src/carrier.rs
            ${STCP_RUST_DIR}/src/crypto.rs
        WORKING_DIRECTORY ${STCP_RUST_DIR}
        COMMENT "Building shared Raspberry Pi Rust STCP core for ${STCP_RUST_TARGET}"
        VERBATIM
    )
    add_custom_target(stcp_rust_core_build DEPENDS ${STCP_RUST_LIB})
    add_dependencies(stcp stcp_rust_core_build)
    zephyr_link_libraries(${STCP_RUST_LIB})
    message(STATUS "STCP Rust core enabled: ${STCP_RUST_LIB}")
endif()
```

## Kconfig
```
menuconfig STCP
    bool "STCP2 socket offload"
    depends on NET_SOCKETS
    select NET_SOCKETS_OFFLOAD
    default n

if STCP
config STCP_SOCKET_PRIORITY
    int "Socket provider priority"
    default 20
config STCP_MAX_SOCKETS
    int "Maximum STCP sockets"
    default 8
    range 2 16
config STCP_CONNECT_TIMEOUT_MS
    int "Carrier and Rust handshake connect timeout"
    default 60000
    range 1000 300000
config STCP_LOG_LEVEL
    int "STCP log level"
    default 3
    range 0 4

menuconfig STCP_RUST_CORE
    bool "Use shared Raspberry Pi Rust STCP protocol core"
    default y
    select MBEDTLS_PSA_CRYPTO_C
    help
      Builds the no_std Rust STCP core as a static library and links it into
      Zephyr. C remains only the BSD socket and native carrier adapter.

if STCP_RUST_CORE
config STCP_RUST_TOOLCHAIN
    string "Rustup toolchain used by Cargo"
    default "nightly"
config STCP_RUST_RX_STACK_SIZE
    int "Per-socket Rust carrier RX thread stack"
    default 4096
    range 2048 8192
config STCP_RUST_RX_PRIORITY
    int "Rust carrier RX thread priority"
    default 7
config STCP_RUST_RX_BUFFER_SIZE
    int "Rust carrier RX buffer"
    default 2048
    range 512 8192
config STCP_RUST_HEXDUMP_BYTES
    int "Maximum bytes in Rust wire hexdumps"
    default 96
    range 16 512
config STCP_RUST_TRACE_WIRE
    bool "Trace Rust STCP wire frames"
    default y
config STCP_RUST_TRACE_EVENTS
    bool "Trace numeric Rust core events"
    default n
config STCP_RUST_TRACE_ALLOC
    bool "Trace Rust allocations"
    default n
endif
endif
```

## prj.conf
```kconfig
CONFIG_NETWORKING=y
CONFIG_NET_SOCKETS=y
CONFIG_NET_SOCKETS_OFFLOAD=y
CONFIG_STCP=y
```

## src/stcp_carrier.c
```c
#include <errno.h>
#include <string.h>
#include <zephyr/net/socket.h>
#include <stcp/stcp_internal.h>

static int neg_errno(void)
{
    return errno > 0 ? -errno : -EIO;
}

int stcp_carrier_init(struct stcp_carrier *carrier, int protocol)
{
    int type;
    int ipproto;

    if (carrier == NULL) {
        return -EINVAL;
    }

    memset(carrier, 0, sizeof(*carrier));
    carrier->fd = -1;

    switch (protocol) {
    case STCP_PROTO_DEFAULT:
    case STCP_PROTO_TCP:
        carrier->kind = STCP_CARRIER_TCP;
        type = SOCK_STREAM;
        ipproto = IPPROTO_TCP;
        break;
    case STCP_PROTO_UDP:
        carrier->kind = STCP_CARRIER_UDP;
        type = SOCK_DGRAM;
        ipproto = IPPROTO_UDP;
        break;
    default:
        return -EPROTONOSUPPORT;
    }

    /* AF_INET is intentional: this is the hidden transport below AF_STCP. */
    carrier->fd = zsock_socket(AF_INET, type, ipproto);
    if (carrier->fd < 0) {
        return neg_errno();
    }

    return 0;
}

void stcp_carrier_close(struct stcp_carrier *carrier)
{
    if (carrier != NULL && carrier->fd >= 0) {
        (void)zsock_close(carrier->fd);
        carrier->fd = -1;
    }
}

int stcp_carrier_bind(struct stcp_carrier *carrier, const struct sockaddr_in *addr)
{
    if (carrier == NULL || addr == NULL || carrier->fd < 0) {
        return -EINVAL;
    }
    if (zsock_bind(carrier->fd, (const struct sockaddr *)addr, sizeof(*addr)) < 0) {
        return neg_errno();
    }
    carrier->bound = true;
    return 0;
}

int stcp_carrier_connect(struct stcp_carrier *carrier, const struct sockaddr_in *addr)
{
    if (carrier == NULL || addr == NULL || carrier->fd < 0) {
        return -EINVAL;
    }
    if (zsock_connect(carrier->fd, (const struct sockaddr *)addr, sizeof(*addr)) < 0) {
        return neg_errno();
    }
    carrier->connected = true;
    return 0;
}

int stcp_carrier_listen(struct stcp_carrier *carrier, int backlog)
{
    if (carrier == NULL || carrier->fd < 0 || backlog < 1) {
        return -EINVAL;
    }
    if (carrier->kind != STCP_CARRIER_TCP) {
        return -EOPNOTSUPP;
    }
    if (zsock_listen(carrier->fd, backlog) < 0) {
        return neg_errno();
    }
    carrier->listening = true;
    return 0;
}

int stcp_carrier_accept(struct stcp_carrier *listener, struct stcp_carrier *child,
                        struct sockaddr_in *peer, socklen_t *peer_len)
{
    int fd;

    if (listener == NULL || child == NULL || listener->fd < 0) {
        return -EINVAL;
    }
    if (listener->kind != STCP_CARRIER_TCP || !listener->listening) {
        return -EINVAL;
    }

    fd = zsock_accept(listener->fd, (struct sockaddr *)peer, peer_len);
    if (fd < 0) {
        return neg_errno();
    }

    memset(child, 0, sizeof(*child));
    child->kind = STCP_CARRIER_TCP;
    child->fd = fd;
    child->connected = true;
    return 0;
}

ssize_t stcp_carrier_send(struct stcp_carrier *carrier, const void *buf,
                          size_t len, int flags)
{
    ssize_t ret;
    if (carrier == NULL || carrier->fd < 0 || (buf == NULL && len != 0)) {
        return -EINVAL;
    }
    ret = zsock_send(carrier->fd, buf, len, flags);
    return ret < 0 ? neg_errno() : ret;
}

ssize_t stcp_carrier_recv(struct stcp_carrier *carrier, void *buf,
                          size_t len, int flags)
{
    ssize_t ret;
    if (carrier == NULL || carrier->fd < 0 || (buf == NULL && len != 0)) {
        return -EINVAL;
    }
    ret = zsock_recv(carrier->fd, buf, len, flags);
    return ret < 0 ? neg_errno() : ret;
}

int stcp_carrier_shutdown(struct stcp_carrier *carrier, int how)
{
    if (carrier == NULL || carrier->fd < 0) {
        return -EINVAL;
    }
    if (zsock_shutdown(carrier->fd, how) < 0) {
        return neg_errno();
    }
    return 0;
}

int stcp_carrier_getsockname(struct stcp_carrier *carrier,
                             struct sockaddr_in *addr, socklen_t *len)
{
    if (carrier == NULL || addr == NULL || len == NULL || carrier->fd < 0) {
        return -EINVAL;
    }
    if (zsock_getsockname(carrier->fd, (struct sockaddr *)addr, len) < 0) {
        return neg_errno();
    }
    return 0;
}

int stcp_carrier_getpeername(struct stcp_carrier *carrier,
                             struct sockaddr_in *addr, socklen_t *len)
{
    if (carrier == NULL || addr == NULL || len == NULL || carrier->fd < 0) {
        return -EINVAL;
    }
    if (zsock_getpeername(carrier->fd, (struct sockaddr *)addr, len) < 0) {
        return neg_errno();
    }
    return 0;
}
```

## src/stcp_context.c
```c
#include <string.h>
#include <zephyr/kernel.h>
#include <stcp/stcp_internal.h>

static struct stcp_socket_ctx contexts[CONFIG_STCP_MAX_SOCKETS];
K_MUTEX_DEFINE(contexts_lock);

struct stcp_socket_ctx *stcp_ctx_alloc(void)
{
    struct stcp_socket_ctx *ctx = NULL;

    k_mutex_lock(&contexts_lock, K_FOREVER);
    for (size_t i = 0; i < ARRAY_SIZE(contexts); ++i) {
        if (!contexts[i].allocated) {
            ctx = &contexts[i];
            memset(ctx, 0, sizeof(*ctx));
            ctx->allocated = true;
            ctx->fd = -1;
            ctx->carrier.fd = -1;
            ctx->state = STCP_STATE_CREATED;
            k_mutex_init(&ctx->lock);
            break;
        }
    }
    k_mutex_unlock(&contexts_lock);
    return ctx;
}

void stcp_ctx_release(struct stcp_socket_ctx *ctx)
{
    if (ctx == NULL) {
        return;
    }

    stcp_carrier_close(&ctx->carrier);

    k_mutex_lock(&contexts_lock, K_FOREVER);
    memset(ctx, 0, sizeof(*ctx));
    ctx->fd = -1;
    ctx->carrier.fd = -1;
    ctx->state = STCP_STATE_FREE;
    k_mutex_unlock(&contexts_lock);
}
```

## src/stcp_core.c
```c
#include <errno.h>
#include <string.h>
#include <zephyr/kernel.h>
#include <stcp/stcp_internal.h>

int stcp_core_bind(struct stcp_socket_ctx *ctx, const struct sockaddr_in *addr)
{
    int ret;
    if (ctx == NULL || addr == NULL) return -EINVAL;
    if (ctx->state != STCP_STATE_CREATED) return -EINVAL;
    ret = stcp_carrier_bind(&ctx->carrier, addr);
    if (ret < 0) return ret;
    ctx->local = *addr;
    ctx->state = STCP_STATE_BOUND;
    return 0;
}

int stcp_core_connect(struct stcp_socket_ctx *ctx, const struct sockaddr_in *addr)
{
    int ret;
    if (ctx == NULL || addr == NULL) return -EINVAL;
    if (ctx->state != STCP_STATE_CREATED && ctx->state != STCP_STATE_BOUND) return -EISCONN;
    ctx->state = STCP_STATE_CONNECTING;
    ret = stcp_carrier_connect(&ctx->carrier, addr);
    if (ret < 0) {
        ctx->state = STCP_STATE_CREATED;
        return ret;
    }
    ctx->peer = *addr;
    ctx->state = STCP_STATE_CONNECTED;
    return 0;
}

int stcp_core_listen(struct stcp_socket_ctx *ctx, int backlog)
{
    int ret;
    if (ctx == NULL || backlog < 1) return -EINVAL;
    if (ctx->state != STCP_STATE_BOUND) return -EINVAL;
    ret = stcp_carrier_listen(&ctx->carrier, backlog);
    if (ret < 0) return ret;
    ctx->state = STCP_STATE_LISTENING;
    return 0;
}

int stcp_core_accept(struct stcp_socket_ctx *listener, struct stcp_socket_ctx *child,
                     struct sockaddr_in *peer, socklen_t *peer_len)
{
    int ret;
    if (listener == NULL || child == NULL) return -EINVAL;
    ret = stcp_carrier_accept(&listener->carrier, &child->carrier, peer, peer_len);
    if (ret < 0) return ret;
    child->protocol = STCP_PROTO_TCP;
    child->type = SOCK_STREAM;
    child->state = STCP_STATE_CONNECTED;
    if (peer != NULL) child->peer = *peer;
    return 0;
}

ssize_t stcp_core_send(struct stcp_socket_ctx *ctx, const void *buf,
                       size_t len, int flags)
{
    if (ctx == NULL) return -EINVAL;
    if (ctx->state != STCP_STATE_CONNECTED) return -ENOTCONN;
    return stcp_carrier_send(&ctx->carrier, buf, len, flags);
}

ssize_t stcp_core_recv(struct stcp_socket_ctx *ctx, void *buf,
                       size_t len, int flags)
{
    if (ctx == NULL) return -EINVAL;
    if (ctx->state != STCP_STATE_CONNECTED) return -ENOTCONN;
    return stcp_carrier_recv(&ctx->carrier, buf, len, flags);
}

int stcp_core_shutdown(struct stcp_socket_ctx *ctx, int how)
{
    int ret;
    if (ctx == NULL) return -EINVAL;
    if (ctx->state == STCP_STATE_CLOSED) return 0;
    ret = stcp_carrier_shutdown(&ctx->carrier, how);
    if (ret < 0 && ret != -ENOTCONN) return ret;
    ctx->state = STCP_STATE_CLOSED;
    return 0;
}
```

## src/stcp_rust_platform.c
```c
#include <errno.h>
#include <string.h>
#include <zephyr/kernel.h>
#include <zephyr/logging/log.h>
#include <zephyr/sys/byteorder.h>
#include <psa/crypto.h>
#include <stcp/stcp_internal.h>
#include <stcp/stcp_rust_ffi.h>

LOG_MODULE_REGISTER(stcp_rust_platform, CONFIG_STCP_LOG_LEVEL);

void *stcp_rust_kernel_alloc(size_t size)
{
    void *ptr = k_malloc(size ? size : 1U);
    if (IS_ENABLED(CONFIG_STCP_RUST_TRACE_ALLOC)) {
        LOG_DBG("rust alloc size=%u ptr=%p", (unsigned)size, ptr);
    }
    return ptr;
}

void stcp_rust_kernel_free(void *ptr)
{
    if (ptr != NULL) {
        k_free(ptr);
    }
}

__attribute__((noreturn)) void stcp_kernel_panic(void)
{
    LOG_ERR("Rust STCP core panic");
    k_panic();
    CODE_UNREACHABLE;
}

void stcp_kernel_wake_accept(void *owner)
{
    struct stcp_ctx *ctx = owner;
    if (ctx != NULL) {
        k_sem_give(&ctx->rust_event);
    }
}

void stcp_kernel_wake_recv(void *owner)
{
    struct stcp_ctx *ctx = owner;
    if (ctx != NULL) {
        k_sem_give(&ctx->rust_event);
    }
}

void stcp_kernel_debug_event(uint32_t event, uintptr_t ctx,
                             uintptr_t arg0, uintptr_t arg1)
{
    if (IS_ENABLED(CONFIG_STCP_RUST_TRACE_EVENTS)) {
        LOG_DBG("rust event=%u ctx=%p arg0=%u arg1=%u", event,
                (void *)ctx, (unsigned)arg0, (unsigned)arg1);
    }
}

static void nonce_to_bytes(uint64_t nonce, uint8_t out[12])
{
    memset(out, 0, 12);
    sys_put_le64(nonce, &out[4]);
}

static int psa_to_errno(psa_status_t status)
{
    switch (status) {
    case PSA_SUCCESS: return 0;
    case PSA_ERROR_INVALID_ARGUMENT: return -EINVAL;
    case PSA_ERROR_NOT_SUPPORTED: return -ENOTSUP;
    case PSA_ERROR_INSUFFICIENT_MEMORY: return -ENOMEM;
    case PSA_ERROR_BUFFER_TOO_SMALL: return -ENOSPC;
    case PSA_ERROR_INVALID_SIGNATURE: return -EBADMSG;
    default: return -EIO;
    }
}

int stcp_kernel_x25519_keypair(uint8_t *secret, uint8_t *public_key)
{
    psa_key_attributes_t attr = PSA_KEY_ATTRIBUTES_INIT;
    psa_key_id_t key = 0;
    size_t secret_len = 0, public_len = 0;
    psa_status_t status;

    if (secret == NULL || public_key == NULL) return -EINVAL;
    psa_set_key_type(&attr, PSA_KEY_TYPE_ECC_KEY_PAIR(PSA_ECC_FAMILY_MONTGOMERY));
    psa_set_key_bits(&attr, 255);
    psa_set_key_usage_flags(&attr, PSA_KEY_USAGE_DERIVE | PSA_KEY_USAGE_EXPORT);
    psa_set_key_algorithm(&attr, PSA_ALG_ECDH);

    status = psa_generate_key(&attr, &key);
    if (status == PSA_SUCCESS) status = psa_export_key(key, secret, 32, &secret_len);
    if (status == PSA_SUCCESS) status = psa_export_public_key(key, public_key, 32, &public_len);
    if (key != 0) (void)psa_destroy_key(key);
    psa_reset_key_attributes(&attr);
    if (status != PSA_SUCCESS) return psa_to_errno(status);
    return (secret_len == 32 && public_len == 32) ? 0 : -EIO;
}

int stcp_kernel_x25519_shared(uint8_t *shared, const uint8_t *secret,
                              const uint8_t *peer)
{
    psa_key_attributes_t attr = PSA_KEY_ATTRIBUTES_INIT;
    psa_key_id_t key = 0;
    size_t out_len = 0;
    psa_status_t status;

    if (!shared || !secret || !peer) return -EINVAL;
    psa_set_key_type(&attr, PSA_KEY_TYPE_ECC_KEY_PAIR(PSA_ECC_FAMILY_MONTGOMERY));
    psa_set_key_bits(&attr, 255);
    psa_set_key_usage_flags(&attr, PSA_KEY_USAGE_DERIVE);
    psa_set_key_algorithm(&attr, PSA_ALG_ECDH);
    status = psa_import_key(&attr, secret, 32, &key);
    if (status == PSA_SUCCESS) {
        status = psa_raw_key_agreement(PSA_ALG_ECDH, key, peer, 32,
                                       shared, 32, &out_len);
    }
    if (key != 0) (void)psa_destroy_key(key);
    psa_reset_key_attributes(&attr);
    if (status != PSA_SUCCESS) return psa_to_errno(status);
    return out_len == 32 ? 0 : -EIO;
}

int stcp_kernel_chacha_encrypt(const uint8_t *key, uint64_t nonce,
                               const uint8_t *aad, size_t aad_len,
                               const uint8_t *plain, size_t plain_len,
                               uint8_t *out, size_t out_len)
{
    psa_key_attributes_t attr = PSA_KEY_ATTRIBUTES_INIT;
    psa_key_id_t key_id = 0;
    uint8_t nonce_bytes[12];
    size_t written = 0;
    psa_status_t status;
    if (!key || !out || out_len < plain_len + 16) return -EINVAL;
    nonce_to_bytes(nonce, nonce_bytes);
    psa_set_key_type(&attr, PSA_KEY_TYPE_CHACHA20);
    psa_set_key_bits(&attr, 256);
    psa_set_key_usage_flags(&attr, PSA_KEY_USAGE_ENCRYPT);
    psa_set_key_algorithm(&attr, PSA_ALG_CHACHA20_POLY1305);
    status = psa_import_key(&attr, key, 32, &key_id);
    if (status == PSA_SUCCESS) {
        status = psa_aead_encrypt(key_id, PSA_ALG_CHACHA20_POLY1305,
                                  nonce_bytes, sizeof(nonce_bytes),
                                  aad, aad_len, plain, plain_len,
                                  out, out_len, &written);
    }
    if (key_id != 0) (void)psa_destroy_key(key_id);
    psa_reset_key_attributes(&attr);
    return status == PSA_SUCCESS && written == plain_len + 16 ? 0 : psa_to_errno(status);
}

int stcp_kernel_chacha_decrypt(const uint8_t *key, uint64_t nonce,
                               const uint8_t *aad, size_t aad_len,
                               const uint8_t *cipher, size_t cipher_len,
                               uint8_t *out, size_t out_len)
{
    psa_key_attributes_t attr = PSA_KEY_ATTRIBUTES_INIT;
    psa_key_id_t key_id = 0;
    uint8_t nonce_bytes[12];
    size_t written = 0;
    psa_status_t status;
    if (!key || !cipher || !out || cipher_len < 16 || out_len < cipher_len - 16) return -EINVAL;
    nonce_to_bytes(nonce, nonce_bytes);
    psa_set_key_type(&attr, PSA_KEY_TYPE_CHACHA20);
    psa_set_key_bits(&attr, 256);
    psa_set_key_usage_flags(&attr, PSA_KEY_USAGE_DECRYPT);
    psa_set_key_algorithm(&attr, PSA_ALG_CHACHA20_POLY1305);
    status = psa_import_key(&attr, key, 32, &key_id);
    if (status == PSA_SUCCESS) {
        status = psa_aead_decrypt(key_id, PSA_ALG_CHACHA20_POLY1305,
                                  nonce_bytes, sizeof(nonce_bytes),
                                  aad, aad_len, cipher, cipher_len,
                                  out, out_len, &written);
    }
    if (key_id != 0) (void)psa_destroy_key(key_id);
    psa_reset_key_attributes(&attr);
    return status == PSA_SUCCESS && written == cipher_len - 16 ? 0 : psa_to_errno(status);
}

int stcp_kernel_chacha_decrypt_in_place(const uint8_t *key, uint64_t nonce,
                                        const uint8_t *aad, size_t aad_len,
                                        uint8_t *cipher, size_t cipher_len)
{
    uint8_t *tmp;
    int rc;
    if (!cipher || cipher_len < 16) return -EINVAL;
    tmp = k_malloc(cipher_len - 16);
    if (!tmp) return -ENOMEM;
    rc = stcp_kernel_chacha_decrypt(key, nonce, aad, aad_len,
                                    cipher, cipher_len, tmp, cipher_len - 16);
    if (rc == 0) memcpy(cipher, tmp, cipher_len - 16);
    memset(tmp, 0, cipher_len - 16);
    k_free(tmp);
    return rc;
}

bool stcp_carrier_needs_reliability(const void *carrier)
{
    const struct stcp_ctx *ctx = carrier;
    return ctx != NULL && ctx->socket_type == SOCK_DGRAM;
}

void *stcp_carrier_create_udp_child(void *listener, void *child_rust_ctx,
                                    uint32_t peer_addr, uint16_t peer_port)
{
    ARG_UNUSED(listener); ARG_UNUSED(child_rust_ctx);
    ARG_UNUSED(peer_addr); ARG_UNUSED(peer_port);
    return NULL; /* Server-side UDP child support is phase 2. */
}

void stcp_carrier_destroy(void *carrier)
{
    ARG_UNUSED(carrier); /* Carrier lifetime is owned by stcp_ctx. */
}

ssize_t stcp_carrier_send(void *carrier, const uint8_t *data,
                          size_t len, int flags)
{
    struct stcp_ctx *ctx = carrier;
    ssize_t rc;
    if (!ctx || ctx->carrier_fd < 0) return -ENOTCONN;
    if (IS_ENABLED(CONFIG_STCP_RUST_TRACE_WIRE)) {
        LOG_HEXDUMP_DBG(data, MIN(len, (size_t)CONFIG_STCP_RUST_HEXDUMP_BYTES),
                        "Rust STCP TX");
    }
    rc = zsock_send(ctx->carrier_fd, data, len, flags);
    if (rc < 0) return -errno;
    return rc;
}
```

## src/stcp_rust_rx.c
```c
#include <errno.h>
#include <zephyr/kernel.h>
#include <zephyr/logging/log.h>
#include <zephyr/net/socket.h>
#include <stcp/stcp_internal.h>
#include <stcp/stcp_rust_ffi.h>
LOG_MODULE_REGISTER(stcp_rust_rx, CONFIG_STCP_LOG_LEVEL);

static void rust_rx_thread(void *p1, void *p2, void *p3)
{
    struct stcp_ctx *ctx = p1;
    uint8_t buffer[CONFIG_STCP_RUST_RX_BUFFER_SIZE];
    ARG_UNUSED(p2); ARG_UNUSED(p3);
    while (!ctx->rust_rx_stop && ctx->carrier_fd >= 0) {
        ssize_t n = zsock_recv(ctx->carrier_fd, buffer, sizeof(buffer), 0);
        if (n > 0) {
            int rc;
            if (IS_ENABLED(CONFIG_STCP_RUST_TRACE_WIRE)) {
                LOG_HEXDUMP_DBG(buffer, MIN((size_t)n, (size_t)CONFIG_STCP_RUST_HEXDUMP_BYTES),
                                "Rust STCP RX");
            }
            rc = stcp_rust_carrier_receive(ctx->rust_ctx, buffer, (size_t)n);
            if (rc < 0 && rc != -EAGAIN) LOG_ERR("rust carrier receive rc=%d", rc);
            k_sem_give(&ctx->rust_event);
            continue;
        }
        if (n == 0) break;
        if (errno == EAGAIN || errno == EWOULDBLOCK || errno == EINTR) {
            k_sleep(K_MSEC(1));
            continue;
        }
        if (!ctx->rust_rx_stop) LOG_ERR("carrier recv failed errno=%d", errno);
        break;
    }
    ctx->rust_rx_running = false;
    k_sem_give(&ctx->rust_event);
}

int stcp_rust_rx_start(struct stcp_ctx *ctx)
{
    if (!ctx || ctx->rust_rx_running) return 0;
    ctx->rust_rx_stop = false;
    ctx->rust_rx_running = true;
    k_thread_create(&ctx->rust_rx_thread, ctx->rust_rx_stack,
                    K_KERNEL_STACK_SIZEOF(ctx->rust_rx_stack),
                    rust_rx_thread, ctx, NULL, NULL,
                    CONFIG_STCP_RUST_RX_PRIORITY, 0, K_NO_WAIT);
    k_thread_name_set(&ctx->rust_rx_thread, "stcp-rust-rx");
    return 0;
}

void stcp_rust_rx_stop(struct stcp_ctx *ctx)
{
    if (!ctx || !ctx->rust_rx_running) return;
    ctx->rust_rx_stop = true;
    if (ctx->carrier_fd >= 0) (void)zsock_shutdown(ctx->carrier_fd, ZSOCK_SHUT_RDWR);
    k_sem_take(&ctx->rust_event, K_MSEC(250));
    if (ctx->rust_rx_running) {
        k_thread_abort(&ctx->rust_rx_thread);
        ctx->rust_rx_running = false;
    }
}
```

## src/stcp_socket_offload.c
```c
#include <errno.h>
#include <stdarg.h>
#include <string.h>
#include <zephyr/kernel.h>
#include <zephyr/logging/log.h>
#include <zephyr/net/socket.h>
#include <zephyr/net/socket_offload.h>
#include <zephyr/posix/fcntl.h>
#include <zephyr/sys/fdtable.h>
#include <stcp/stcp_internal.h>
#ifdef CONFIG_STCP_RUST_CORE
#include <stcp/stcp_rust_ffi.h>
#endif

LOG_MODULE_REGISTER(stcp_offload, CONFIG_STCP_LOG_LEVEL);

#ifdef CONFIG_STCP_RUST_CORE
static int rust_errno(int rc)
{
    if (rc >= 0) return rc;
    errno = -rc;
    return -1;
}

static int wait_rust_ready(struct stcp_ctx *ctx, int timeout_ms)
{
    int64_t deadline = k_uptime_get() + timeout_ms;
    while (k_uptime_get() < deadline) {
        int ready = stcp_rust_is_connected(ctx->rust_ctx);
        if (ready > 0) return 0;
        if (ready < 0 && ready != -EAGAIN) return ready;
        (void)k_sem_take(&ctx->rust_event, K_MSEC(25));
        (void)stcp_rust_tick(ctx->rust_ctx);
    }
    return -ETIMEDOUT;
}
#endif

static int stcp_close(void *obj)
{
    struct stcp_ctx *ctx = obj;
    if (!ctx) return 0;
#ifdef CONFIG_STCP_RUST_CORE
    stcp_rust_rx_stop(ctx);
    if (ctx->rust_ctx) {
        stcp_rust_set_carrier(ctx->rust_ctx, NULL);
        stcp_rust_release(ctx->rust_ctx);
        ctx->rust_ctx = NULL;
    }
#endif
    if (ctx->carrier_fd >= 0) zsock_close(ctx->carrier_fd);
    stcp_ctx_free(ctx);
    return 0;
}

static ssize_t stcp_read(void *obj, void *buf, size_t len)
{
    struct stcp_ctx *ctx = obj;
#ifdef CONFIG_STCP_RUST_CORE
    while (true) {
        ssize_t rc = stcp_rust_recv(ctx->rust_ctx, buf, len, 0);
        if (rc >= 0) return rc;
        if (rc != -EAGAIN) { errno = (int)-rc; return -1; }
        (void)k_sem_take(&ctx->rust_event, K_MSEC(100));
    }
#else
    return zsock_recv(ctx->carrier_fd, buf, len, 0);
#endif
}

static ssize_t stcp_write(void *obj, const void *buf, size_t len)
{
    struct stcp_ctx *ctx = obj;
#ifdef CONFIG_STCP_RUST_CORE
    while (true) {
        ssize_t rc = stcp_rust_send(ctx->rust_ctx, buf, len, 0);
        if (rc >= 0) return rc;
        if (rc != -EAGAIN) { errno = (int)-rc; return -1; }
        (void)k_sem_take(&ctx->rust_event, K_MSEC(10));
        (void)stcp_rust_tick(ctx->rust_ctx);
    }
#else
    return zsock_send(ctx->carrier_fd, buf, len, 0);
#endif
}

static int stcp_ioctl(void *obj, unsigned int request, va_list args)
{
    ARG_UNUSED(obj); ARG_UNUSED(args);
    /* Rust-core client mode currently uses blocking socket semantics. The
     * benchmark application skips O_NONBLOCK for AF_STCP. */
    ARG_UNUSED(request);
    errno = ENOTSUP;
    return -1;
}

static int stcp_bind(void *obj, const struct sockaddr *addr, socklen_t addrlen)
{
    struct stcp_ctx *ctx = obj;
    const struct sockaddr_in *sin = (const struct sockaddr_in *)addr;
    if (!ctx || !addr || addrlen < sizeof(*sin)) { errno = EINVAL; return -1; }
    if (zsock_bind(ctx->carrier_fd, addr, addrlen) < 0) return -1;
#ifdef CONFIG_STCP_RUST_CORE
    if (rust_errno(stcp_rust_bind(ctx->rust_ctx, sin->sin_addr.s_addr, sin->sin_port)) < 0) return -1;
#endif
    memcpy(&ctx->local, addr, sizeof(ctx->local));
    ctx->state = STCP_BOUND;
    return 0;
}

static int stcp_connect(void *obj, const struct sockaddr *addr, socklen_t addrlen)
{
    struct stcp_ctx *ctx = obj;
    const struct sockaddr_in *peer = (const struct sockaddr_in *)addr;
    struct sockaddr_in carrier_peer;
    int rc;
    if (!ctx || !addr || addrlen < sizeof(*peer) || peer->sin_family != AF_INET) {
        errno = EINVAL; return -1;
    }
    memset(&carrier_peer, 0, sizeof(carrier_peer));
    carrier_peer.sin_family = AF_INET;
    carrier_peer.sin_port = peer->sin_port;
    carrier_peer.sin_addr = peer->sin_addr;
    ctx->state = STCP_CONNECTING;
    {
        uint32_t peer_host = ntohl(carrier_peer.sin_addr.s_addr);

        LOG_INF("carrier connect fd=%d peer=%u.%u.%u.%u:%u",
                ctx->carrier_fd,
                (unsigned int)((peer_host >> 24) & 0xffU),
                (unsigned int)((peer_host >> 16) & 0xffU),
                (unsigned int)((peer_host >> 8) & 0xffU),
                (unsigned int)(peer_host & 0xffU),
                ntohs(carrier_peer.sin_port));
    }
    rc = zsock_connect(ctx->carrier_fd, (const struct sockaddr *)&carrier_peer,
                       sizeof(carrier_peer));
    if (rc < 0) { ctx->state = STCP_CREATED; return -1; }
#ifdef CONFIG_STCP_RUST_CORE
    rc = stcp_rust_connect(ctx->rust_ctx, peer->sin_addr.s_addr,
                           peer->sin_port, 0);
    if (rc < 0) { errno = -rc; return -1; }
    rc = stcp_rust_rx_start(ctx);
    if (rc < 0) { errno = -rc; return -1; }
    LOG_INF("Rust STCP handshake start fd=%d rust_ctx=%p", ctx->fd, ctx->rust_ctx);
    rc = stcp_rust_start_handshake(ctx->rust_ctx);
    if (rc < 0) { errno = -rc; return -1; }
    rc = wait_rust_ready(ctx, CONFIG_STCP_CONNECT_TIMEOUT_MS);
    if (rc < 0) {
        LOG_ERR("Rust STCP handshake failed rc=%d", rc);
        errno = -rc;
        return -1;
    }
    LOG_INF("Rust STCP handshake complete fd=%d", ctx->fd);
#endif
    memcpy(&ctx->peer, &carrier_peer, sizeof(ctx->peer));
    ctx->state = STCP_CONNECTED;
    return 0;
}

static int stcp_listen(void *obj, int backlog)
{
    struct stcp_ctx *ctx = obj;
    if (zsock_listen(ctx->carrier_fd, backlog) < 0) return -1;
#ifdef CONFIG_STCP_RUST_CORE
    if (rust_errno(stcp_rust_listen(ctx->rust_ctx, backlog)) < 0) return -1;
#endif
    ctx->state = STCP_LISTENING;
    return 0;
}

static int stcp_accept(void *obj, struct sockaddr *addr, socklen_t *addrlen)
{
    /* Phase 1 keeps server-side accept on the existing C carrier path.
     * Client connect/send/recv already use the shared Raspberry Rust core. */
    struct stcp_ctx *listener = obj;
    int cfd = zsock_accept(listener->carrier_fd, addr, addrlen);
    if (cfd < 0) return -1;
    struct stcp_ctx *child = stcp_ctx_alloc();
    if (!child) { zsock_close(cfd); errno = ENOMEM; return -1; }
    int fd = zvfs_reserve_fd();
    if (fd < 0) { zsock_close(cfd); stcp_ctx_free(child); return -1; }
    child->fd = fd; child->carrier_fd = cfd;
    child->socket_type = listener->socket_type;
    child->protocol = listener->protocol;
    child->state = STCP_CONNECTED;
    extern const struct socket_op_vtable stcp_vtable;
    zvfs_finalize_typed_fd(fd, child, (const struct fd_op_vtable *)&stcp_vtable, ZVFS_MODE_IFSOCK);
    return fd;
}

static ssize_t stcp_sendto(void *obj, const void *buf, size_t len, int flags,
                           const struct sockaddr *dst, socklen_t dstlen)
{
    ARG_UNUSED(dst); ARG_UNUSED(dstlen);
#ifdef CONFIG_STCP_RUST_CORE
    return stcp_write(obj, buf, len);
#else
    struct stcp_ctx *ctx=obj;
    return dst ? zsock_sendto(ctx->carrier_fd,buf,len,flags,dst,dstlen) : zsock_send(ctx->carrier_fd,buf,len,flags);
#endif
}

static ssize_t stcp_recvfrom(void *obj, void *buf, size_t len, int flags,
                             struct sockaddr *src, socklen_t *srclen)
{
    ARG_UNUSED(flags); ARG_UNUSED(src); ARG_UNUSED(srclen);
#ifdef CONFIG_STCP_RUST_CORE
    return stcp_read(obj, buf, len);
#else
    struct stcp_ctx *ctx=obj;
    return src ? zsock_recvfrom(ctx->carrier_fd,buf,len,flags,src,srclen) : zsock_recv(ctx->carrier_fd,buf,len,flags);
#endif
}

static int stcp_shutdown(void *obj, int how)
{
    struct stcp_ctx *ctx = obj;
#ifdef CONFIG_STCP_RUST_CORE
    stcp_rust_shutdown(ctx->rust_ctx, how);
#endif
    return zsock_shutdown(ctx->carrier_fd, how);
}
static int stcp_getsockopt(void *obj,int level,int optname,void *optval,socklen_t *optlen)
{ return zsock_getsockopt(((struct stcp_ctx *)obj)->carrier_fd,level,optname,optval,optlen); }
static int stcp_setsockopt(void *obj,int level,int optname,const void *optval,socklen_t optlen)
{ return zsock_setsockopt(((struct stcp_ctx *)obj)->carrier_fd,level,optname,optval,optlen); }
static int stcp_getpeername(void *obj, struct sockaddr *addr, socklen_t *len)
{ return zsock_getpeername(((struct stcp_ctx *)obj)->carrier_fd,addr,len); }
static int stcp_getsockname(void *obj, struct sockaddr *addr, socklen_t *len)
{ return zsock_getsockname(((struct stcp_ctx *)obj)->carrier_fd,addr,len); }

const struct socket_op_vtable stcp_vtable = {
    .fd_vtable = { .read = stcp_read, .write = stcp_write, .close = stcp_close, .ioctl = stcp_ioctl },
    .bind = stcp_bind, .connect = stcp_connect, .listen = stcp_listen, .accept = stcp_accept,
    .sendto = stcp_sendto, .recvfrom = stcp_recvfrom, .shutdown = stcp_shutdown,
    .getsockopt = stcp_getsockopt, .setsockopt = stcp_setsockopt,
    .getpeername = stcp_getpeername, .getsockname = stcp_getsockname,
};

static bool stcp_supported(int family, int type, int protocol)
{
    return family == AF_STCP && (type == SOCK_STREAM || type == SOCK_DGRAM) &&
           (protocol == 0 || protocol == IPPROTO_STCP);
}

static int stcp_socket(int family, int type, int protocol)
{
    struct stcp_ctx *ctx;
    int fd;
    int rc;
    ARG_UNUSED(family);
    if (protocol == 0) protocol = IPPROTO_STCP;
    ctx = stcp_ctx_alloc();
    if (!ctx) { errno = ENOMEM; return -1; }
    ctx->carrier_fd = stcp_carrier_open(type);
    if (ctx->carrier_fd < 0) { stcp_ctx_free(ctx); return -1; }
#ifdef CONFIG_STCP_RUST_CORE
    rc = stcp_rust_create(type == SOCK_DGRAM ? 254 : 253, &ctx->rust_ctx);
    if (rc < 0) {
        zsock_close(ctx->carrier_fd); stcp_ctx_free(ctx); errno = -rc; return -1;
    }
    stcp_rust_set_owner(ctx->rust_ctx, ctx);
    stcp_rust_set_carrier(ctx->rust_ctx, ctx);
#endif
    fd = zvfs_reserve_fd();
    if (fd < 0) { stcp_close(ctx); return -1; }
    ctx->fd = fd; ctx->socket_type = type; ctx->protocol = protocol;
    zvfs_finalize_typed_fd(fd, ctx, (const struct fd_op_vtable *)&stcp_vtable, ZVFS_MODE_IFSOCK);
    LOG_INF("STCP fd=%d type=%d protocol=%d carrier_fd=%d rust=%p",
            fd, type, protocol, ctx->carrier_fd,
#ifdef CONFIG_STCP_RUST_CORE
            ctx->rust_ctx
#else
            NULL
#endif
    );
    return fd;
}
NET_SOCKET_OFFLOAD_REGISTER(stcp, CONFIG_STCP_SOCKET_PRIORITY, AF_STCP, stcp_supported, stcp_socket);
```

## src/stcp_x25519_soft.c
```c
/*
 * Compact RFC 7748 X25519 implementation for Zephyr targets whose PSA
 * backend does not expose Montgomery/X25519 operations.
 *
 * The field arithmetic is derived from the public-domain TweetNaCl
 * Curve25519 implementation. It operates in constant-time with respect to
 * the secret scalar and has no heap or platform dependencies.
 */
#include <zephyr/kernel.h>
#include <zephyr/sys/util.h>
#include <errno.h>
#include <stdint.h>
#include <string.h>

#include <stcp/stcp_x25519_soft.h>

typedef int64_t gf[16];

static const gf gf_121665 = {0xdb41, 1};

static void car25519(gf o)
{
    int i;
    int64_t c;

    for (i = 0; i < 16; ++i) {
        o[i] += (int64_t)1 << 16;
        c = o[i] >> 16;
        o[(i + 1) * (i < 15)] += c - 1 + 37 * (c - 1) * (i == 15);
        o[i] -= c << 16;
    }
}

static void sel25519(gf p, gf q, int b)
{
    int i;
    int64_t t;
    const int64_t mask = -(int64_t)b;

    for (i = 0; i < 16; ++i) {
        t = mask & (p[i] ^ q[i]);
        p[i] ^= t;
        q[i] ^= t;
    }
}

static void pack25519(uint8_t out[32], const gf n)
{
    int i, j;
    gf m, t;

    for (i = 0; i < 16; ++i) {
        t[i] = n[i];
    }
    car25519(t);
    car25519(t);
    car25519(t);

    for (j = 0; j < 2; ++j) {
        m[0] = t[0] - 0xffed;
        for (i = 1; i < 15; ++i) {
            m[i] = t[i] - 0xffff - ((m[i - 1] >> 16) & 1);
            m[i - 1] &= 0xffff;
        }
        m[15] = t[15] - 0x7fff - ((m[14] >> 16) & 1);
        {
            const int b = (int)((m[15] >> 16) & 1);
            m[14] &= 0xffff;
            sel25519(t, m, 1 - b);
        }
    }

    for (i = 0; i < 16; ++i) {
        out[2 * i] = (uint8_t)(t[i] & 0xff);
        out[2 * i + 1] = (uint8_t)(t[i] >> 8);
    }
}

static void unpack25519(gf out, const uint8_t in[32])
{
    int i;

    for (i = 0; i < 16; ++i) {
        out[i] = (int64_t)in[2 * i] + ((int64_t)in[2 * i + 1] << 8);
    }
    out[15] &= 0x7fff;
}

static void add(gf out, const gf a, const gf b)
{
    int i;
    for (i = 0; i < 16; ++i) {
        out[i] = a[i] + b[i];
    }
}

static void sub(gf out, const gf a, const gf b)
{
    int i;
    for (i = 0; i < 16; ++i) {
        out[i] = a[i] - b[i];
    }
}

static void mul(gf out, const gf a, const gf b)
{
    int i, j;
    int64_t t[31] = {0};

    for (i = 0; i < 16; ++i) {
        for (j = 0; j < 16; ++j) {
            t[i + j] += a[i] * b[j];
        }
    }
    for (i = 0; i < 15; ++i) {
        t[i] += 38 * t[i + 16];
    }
    for (i = 0; i < 16; ++i) {
        out[i] = t[i];
    }
    car25519(out);
    car25519(out);
}

static void square(gf out, const gf a)
{
    mul(out, a, a);
}

static void inv25519(gf out, const gf in)
{
    int i;
    gf c;

    for (i = 0; i < 16; ++i) {
        c[i] = in[i];
    }
    for (i = 253; i >= 0; --i) {
        square(c, c);
        if (i != 2 && i != 4) {
            mul(c, c, in);
        }
    }
    for (i = 0; i < 16; ++i) {
        out[i] = c[i];
    }
}

int stcp_x25519_soft(uint8_t out[32], const uint8_t scalar[32],
                     const uint8_t point[32])
{
    uint8_t z[32];
    int i;
    gf x, a, b, c, d, e, f;

    if (out == NULL || scalar == NULL || point == NULL) {
        return -EINVAL;
    }

    memcpy(z, scalar, sizeof(z));
    z[31] = (uint8_t)((z[31] & 127U) | 64U);
    z[0] &= 248U;
    unpack25519(x, point);

    for (i = 0; i < 16; ++i) {
        b[i] = x[i];
        d[i] = a[i] = c[i] = 0;
    }
    a[0] = d[0] = 1;

    for (i = 254; i >= 0; --i) {
        const int r = (z[i >> 3] >> (i & 7)) & 1;
        sel25519(a, b, r);
        sel25519(c, d, r);
        add(e, a, c);
        sub(a, a, c);
        add(c, b, d);
        sub(b, b, d);
        square(d, e);
        square(f, a);
        mul(a, c, a);
        mul(c, b, e);
        add(e, a, c);
        sub(a, a, c);
        square(b, a);
        sub(c, d, f);
        mul(a, c, gf_121665);
        add(a, a, d);
        mul(c, c, a);
        mul(a, d, f);
        mul(d, b, x);
        square(b, e);
        sel25519(a, b, r);
        sel25519(c, d, r);
    }

    inv25519(c, c);
    mul(a, a, c);
    pack25519(out, a);
    memset(z, 0, sizeof(z));
    return 0;
}

int stcp_x25519_soft_public(uint8_t public_key[32], const uint8_t secret[32])
{
    uint8_t basepoint[32] = {9};
    return stcp_x25519_soft(public_key, secret, basepoint);
}

bool stcp_x25519_soft_is_all_zero(const uint8_t value[32])
{
    uint8_t acc = 0;
    int i;

    for (i = 0; i < 32; ++i) {
        acc |= value[i];
    }
    return acc == 0;
}
```
