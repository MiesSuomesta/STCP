## prj.conf
```kconfig
# =========================================================
# MINIMAL SYSTEM
# =========================================================

CONFIG_PRINTK=y
CONFIG_CONSOLE=y
CONFIG_UART_CONSOLE=y

# =========================================================
# LOGGING (minimal)
# =========================================================

CONFIG_LOG=y
CONFIG_LOG_BACKEND_UART=y
CONFIG_LOG_MODE_IMMEDIATE=y

# =========================================================
# LTE LINK CONTROL DEBUG
# =========================================================
CONFIG_LTE_LINK_CONTROL_LOG_LEVEL_DBG=y

# =========================================================
# AT MONITOR (optional but useful)
# =========================================================

CONFIG_AT_MONITOR=y
CONFIG_AT_MONITOR_LOG_LEVEL_DBG=y

# =========================================================
# MODEM / Nordic
# =========================================================

CONFIG_NRF_MODEM_LIB=y
CONFIG_MODEM_INFO=y

# =========================================================
# MODEM / Link control
# =========================================================
CONFIG_LTE_LINK_CONTROL=y
CONFIG_LTE_LINK_CONTROL_LOG_LEVEL_DBG=y

# =========================================================
# NETWORK
# =========================================================

CONFIG_NETWORKING=y
CONFIG_NET_SOCKETS=y
CONFIG_NET_IPV4=y
CONFIG_NET_TCP=y

# =========================================================
# Stacks
# =========================================================
CONFIG_SYSTEM_WORKQUEUE_STACK_SIZE=2048
CONFIG_NET_SOCKETS_SERVICE_STACK_SIZE=2048

CONFIG_MAIN_STACK_SIZE=10240
CONFIG_HEAP_MEM_POOL_SIZE=10240

#CONFIG_NET_SOCKETS_SERVICE_STACK_SIZE=4096
#CONFIG_SYSTEM_WORKQUEUE_STACK_SIZE=4096

CONFIG_AT_MONITOR_HEAP_SIZE=4096


# =========================================================
# DNS
# =========================================================

CONFIG_DNS_RESOLVER=y

# STCP
CONFIG_STCP=y
CONFIG_STCP_DEBUG=y
CONFIG_STCP_DEBUG_LATENCY=n
CONFIG_STCP_SELFTEST=n

# STCP / Watchdog
CONFIG_STCP_WATCHDOG_ENABLE=n
CONFIG_STCP_WATCHDOG_MAX_TIMEOUT=1200
CONFIG_STCP_WATCHDOG_CHECK_INTERVAL=15

# STCP / AES
CONFIG_STCP_AES_BYPASS=y

# STCP / MQTT
CONFIG_MQTT_LIB=y
CONFIG_MQTT_LIB_STCP=y

# STCP / Status monitor & Statistics
CONFIG_STCP_STATUS_MONITOR=y
CONFIG_STCP_STATUS_MONITOR_STATISTICS=y
CONFIG_STCP_STATUS_MONITOR_LOG_INTERVAL=5

# STCP ISP's APN name
CONFIG_STCP_LTE_APN_NAME="internet"

# STCP networking: Where to connect
CONFIG_STCP_CONNECT_TO_HOST="lja.fi"
CONFIG_STCP_CONNECT_TO_PORT=7777


# STCP / testing
CONFIG_STCP_TESTING=y
# Sets debuggin on IF this is Y or if not then default is STCP_DEBUG setting
CONFIG_STCP_TESTING_LOG=y

# Disables testing debugs completely.
CONFIG_STCP_TESTING_LOG_COMPLETELY_OFF=n

CONFIG_STCP_TESTING_PEER_HOSTNAME_TO_CONNECT="lja.fi"
CONFIG_STCP_TESTING_PEER_PORT_TO_CONNECT=7777
# strftime format string 
CONFIG_STCP_TESTING_PAYLOAD_FORMAT="TErveppä terve! %Y-%m-%d %H:%M:%S ..."

# Testing mode 
CONFIG_STCP_TESTING_MODE=2

# Date-support for nice payload generation
# if user needs
CONFIG_DATE_TIME=y

# Power saving mode (=n)
CONFIG_LTE_PSM_REQ=n

# optimisations here
CONFIG_NET_BUF_RX_COUNT=8
CONFIG_NET_BUF_TX_COUNT=8
CONFIG_NET_PKT_RX_COUNT=4
CONFIG_NET_PKT_TX_COUNT=4
CONFIG_NET_MAX_CONTEXTS=4
CONFIG_NET_NATIVE=y
CONFIG_NET_OFFLOAD=y
CONFIG_NET_SOCKETS_OFFLOAD=y
CONFIG_NET_LOG=n
CONFIG_NET_TCP_LOG_LEVEL_OFF=y
CONFIG_NET_UDP_LOG_LEVEL_OFF=y
```

## include/stcp_mqtt.h
```c
#pragma once
#include <zephyr/kernel.h>
#include <zephyr/net/socket.h>
#include <zephyr/net/mqtt.h>
#include <modem/lte_lc.h>
#include <zephyr/logging/log.h>

#include <stcp_api.h>

int stpc_mqtt_subscribe(struct mqtt_client *client);

int mqtt_connect_via_stcp(char *host, int port, struct stcp_api **saveTo);

int mqtt_server_stcp_recv_loop(struct stcp_api *api);

int mqtt_publish_message(const char *topic,
                         const uint8_t *payload,
                         size_t len);

int stcp_mqtt_reconnect(struct mqtt_client *client);
int stcp_mqtt_run_session(struct stcp_api *api);
void make_timestamp(char *out, size_t max_len);

#define CLIENT_LOCK(clientArg) \
    do {                                       \
        MDBG("MQTT: Locking %p client...", clientArg);    \
        k_mutex_lock((clientArg), K_FOREVER); \
        MDBG("MQTT: Locked %p client...", clientArg);     \
    } while (0)

#define CLIENT_UNLOCK(clientArg) \
    do {                                       \
        MDBG("MQTT: Unlocking %p client...", clientArg);  \
        k_mutex_unlock((clientArg));          \
        MDBG("MQTT: Unlocked %p client...", clientArg);   \
    } while (0)

                         
```

## src/mqtt_demo_utils.h
```c
#pragma once
#include <zephyr/random/random.h>
#include <zephyr/kernel.h>

#define STCP_MQTT_WAIT_CONNACK_EVENT_FOR_MSEC    (60 * 1000)
#define STCP_MQTT_POLL_TIMEOUT_MSEC              (500)

// Tuotantoon 30 - 300 sec, mut MAX KEEPALIVE sec
#if CONFIG_STCP_TESTING && (CONFIG_STCP_TESTING_MODE == 3)
#define STCP_MQTT_PUBLISH_INTERVAL_MS            (15)
#else
#define STCP_MQTT_PUBLISH_INTERVAL_MS            (5 * 1000)
#endif

// Keepalive PITÄÄ olla isompi kuin poll interval.
#define STCP_MQTT_KEEPALIVE_SECONDS              300

void sleep_ms_jitter(uint32_t base_ms, uint32_t jitter_ms);
void stpc_mqtt_init_fsm_thread();
void make_timestamp(char *out, size_t max_len);
int mqtt_dns_info_free();

#if CONFIG_STCP_TESTING && (CONFIG_STCP_TESTING_MODE == 3)
#define SLEEP_JITTER_MS             50
#define SLEEP_MSEC(val)             sleep_ms_jitter(10, SLEEP_JITTER_MS)
#define SLEEP_SEC(val)              sleep_ms_jitter(20, SLEEP_JITTER_MS)
#else
#define SLEEP_JITTER_MS             500
#define SLEEP_MSEC(val)             sleep_ms_jitter(val, SLEEP_JITTER_MS)
#define SLEEP_SEC(val)              sleep_ms_jitter((val) * 1000, SLEEP_JITTER_MS)
#endif

int stcp_mqtt_wait_for_connak_event(int timeout_ms);
void stcp_mqtt_set_connak_event_seen();
void stcp_mqtt_reset_connak_event_seen();
```

## src/stcp_mqtt.c
```c
#include <zephyr/random/random.h>
#include <zephyr/kernel.h>
#include <zephyr/net/socket.h>
#include <errno.h>
#include <string.h>
#include <stdlib.h>
#include <zephyr/init.h>
#include <modem/lte_lc.h>

#include <zephyr/kernel.h>
#include <zephyr/sys/timeutil.h>
#include <zephyr/sys/heap_listener.h>
#include <zephyr/sys/sys_heap.h>
#include <zephyr/kernel.h>
#include <zephyr/posix/fcntl.h>

#include <stcp_api.h>
#include <stcp/debug.h>
#include <stcp/stcp_socket.h>
#include <stcp/utils.h>
#include <zephyr/net/mqtt.h>
#include <stcp/mqtt_stcp_stats.h>
#include <stcp/dns.h>

#include "mqtt_demo_utils.h"

#include "stcp_mqtt.h"

struct mqtt_client client;
static struct sockaddr_storage broker;
extern struct k_mutex client_lock;
int mqtt_connected = 0;

#define RX_BUF_SIZE             1024
#define TX_BUF_SIZE             1024
#define RECV_RETRY_DELAY_MS     5


static uint8_t rx_buffer[RX_BUF_SIZE];
static uint8_t tx_buffer[TX_BUF_SIZE];

int stcp_mqtt_reconnect(struct mqtt_client *client)
{
    int rc;

    MINF("MQTT reconnect attempt");

    CLIENT_LOCK(&client_lock);
    mqtt_disconnect(client, NULL);
    CLIENT_UNLOCK(&client_lock);

    SLEEP_SEC(1);

    CLIENT_LOCK(&client_lock);
    rc = mqtt_connect(client);
    CLIENT_UNLOCK(&client_lock);

    if (rc != 0) {
        LERR("MQTT reconnect failed rc=%d", rc);
        return rc;
    }

    MINF("MQTT reconnect OK");

    /* resubscribe */
    rc = stpc_mqtt_subscribe(client);
    if (rc) {
        MWRN("Subscribe failed: %d", rc);
    }

    return rc;
}

int mqtt_publish_message(const char *topic,
                         const uint8_t *payload,
                         size_t len)
{

    struct mqtt_publish_param param;
        param.message.topic.qos = MQTT_QOS_0_AT_MOST_ONCE;
        param.message.topic.topic.utf8 = (uint8_t *)topic;
        param.message.topic.topic.size = strlen(topic);

        param.message.payload.data = (uint8_t *)payload;
        param.message.payload.len  = len;

        param.message_id  = sys_rand32_get();
        param.dup_flag    = 0;
        param.retain_flag = 0;

    CLIENT_LOCK(&client_lock);
        int ret = mqtt_publish(&client, &param);
    CLIENT_UNLOCK(&client_lock);
    return ret;
}

static void mqtt_evt_handler(struct mqtt_client *const clientPtr,
                             const struct mqtt_evt *evt)
{
    switch (evt->type) {

        case MQTT_EVT_CONNACK:
            MDBG("MQTT: CONNACK received, result=%d\n",
                evt->param.connack.return_code);

            if (evt->param.connack.return_code == MQTT_CONNECTION_ACCEPTED) {
                MDBG("MQTT: CONNECT OK\n");
                mqtt_connected = 1;
                stcp_mqtt_set_connak_event_seen();
            } else {
                MDBG("MQTT: CONNECT FAILED\n");
                stcp_mqtt_reset_connak_event_seen();
                mqtt_connected = 0;
            }

            break;

        case MQTT_EVT_DISCONNECT:
            MDBG("MQTT: DISCONNECTED\n");
            mqtt_connected = 0;
            stcp_mqtt_reset_connak_event_seen();
            break;

        case MQTT_EVT_PUBLISH:
        {
            MDBG("MQTT: PUBLISH received\n");
            mqtt_connected = 1;

            const struct mqtt_publish_param *p = &evt->param.publish;

            MDBG("MQTT: topic len %d\n", p->message.topic.topic.size);
            MDBG("MQTT: payload len %d\n", p->message.payload.len);

            uint8_t buf[256];
            int len = MIN(p->message.payload.len, sizeof(buf));

            CLIENT_LOCK(&client_lock);
            mqtt_read_publish_payload(clientPtr, buf, len);
            CLIENT_UNLOCK(&client_lock);

            printk("MQTT: payload: ");
            for (int i = 0; i < len; i++) {
                printk("%c", buf[i]);
            }
            printk("\n");

            break;
        }

        case MQTT_EVT_PUBACK:
            MDBG("MQTT: PUBACK received id=%d\n",
                evt->param.puback.message_id);
            break;

        case MQTT_EVT_SUBACK:
            MDBG("MQTT: SUBACK id=%d\n",
                evt->param.suback.message_id);
            break;

        case MQTT_EVT_PINGRESP:
            MDBG("MQTT: PINGRESP\n");
            break;

        default:
            MDBG("MQTT: event type %d\n", evt->type);
            break;
        }
}

static struct zsock_addrinfo *mqtt_dns_info = NULL;

int mqtt_dns_info_free() 
{
    return stcp_dns_free(mqtt_dns_info);
}

int mqtt_connect_via_stcp(char *host, int port, struct stcp_api **saveTo)
{
    LERRBIG("MQTT Connect via thread: %p", k_current_get());
    LDBGBIG("Starting to connect MQTT via STCP (%s:%d)", host, port);
    CLIENT_LOCK(&client_lock);
    int rc = -1;
    
    if (mqtt_dns_info == NULL) {
        rc = stcp_dns_resolve(host, port, &mqtt_dns_info);
    }

    if (!mqtt_dns_info) {
        LERRBIG("DNS resolve failed %s:%d (%d)", host, port, errno);
        CLIENT_UNLOCK(&client_lock);
        return -EAGAIN;
    }

    stcp_util_log_sockaddr("MQTT connect resolved: ", mqtt_dns_info);

    memcpy(&broker, mqtt_dns_info->ai_addr, mqtt_dns_info->ai_addrlen);

    /* Init MQTT client */
    mqtt_client_init(&client);

    client.broker = &broker;
    client.evt_cb = mqtt_evt_handler;

    client.client_id.utf8 = "zephyr-stcp-device";
    client.client_id.size = strlen("zephyr-stcp-device");

    client.keepalive = STCP_MQTT_KEEPALIVE_SECONDS;
    client.protocol_version = MQTT_VERSION_3_1_1;

    client.rx_buf = rx_buffer;
    client.rx_buf_size = sizeof(rx_buffer);

    client.tx_buf = tx_buffer;
    client.tx_buf_size = sizeof(tx_buffer);

    /* tärkeä */
    client.transport.type = MQTT_TRANSPORT_STCP;


    MDBG("MQTT connecting...");

    rc = mqtt_connect(&client);

    LINF("Client info:");
    LINF("  Keepalive: %d (set: %d)", STCP_MQTT_KEEPALIVE_SECONDS, client.keepalive);

    if (rc < 0) {
       MDBG("MQTT connect failed rc=%d, errno: %d", rc, errno);
       CLIENT_UNLOCK(&client_lock);
       return errno;
    }

    MDBG("MQTT connect started");

    /* STCP API pointer löytyy vasta nyt */
    struct stcp_api *api = client.transport.stcp.stcp_api_instance;

    if (api) {
        int fd = stcp_api_get_fd(api);
        int flags = zsock_fcntl(fd, F_GETFL, 0);
        zsock_fcntl(fd, F_SETFL, flags | O_NONBLOCK);

        MDBG("STCP socket (set not to block) FD: %d", fd);
        if (saveTo) {
            *saveTo = api;
        }
    } else {
        MDBG("STCP API not available");
    }
    CLIENT_UNLOCK(&client_lock);

    return 0;
}
```

## src/stcp_mqtt_fsm.c
```c
#include <stcp_api.h>
#include <stcp/debug.h>
#include <stcp/stcp_socket.h>
#include <stcp/utils.h>

#include "stcp_mqtt.h"
#include "stcp_mqtt_fsm.h"
#include "mqtt_demo_utils.h"


#define MQTT_STACK_SIZE 7168
#define MQTT_PRIORITY 5

enum mqtt_state state = MQTT_STATE_IDLE;
extern struct mqtt_client client;
extern int mqtt_connected;

void stcp_mqtt_task(void *p1, void *p2, void *p3);
extern struct k_mutex client_lock;

K_THREAD_STACK_DEFINE(stpc_mqtt_stack, MQTT_STACK_SIZE);
struct k_thread stpc_mqtt_thread;

// Semaphore for connack

struct k_sem g_sem_connack_seen;

int stcp_mqtt_wait_for_connak_event(int timeout_ms) 
{
    if ( k_sem_count_get(&g_sem_connack_seen) == 0) {
        return 0;
    }
    MINFBIG("CONNACK take (%d ms)", timeout_ms);
    return k_sem_take(&g_sem_connack_seen, K_MSEC(timeout_ms));
}

void stcp_mqtt_set_connak_event_seen()
{
    MINFBIG("CONNACK give..");
    k_sem_give(&g_sem_connack_seen);
}

void stcp_mqtt_reset_connak_event_seen() 
{
    MINFBIG("CONNACK seen reset..");
    k_sem_reset(&g_sem_connack_seen);
}

void stpc_mqtt_init_fsm_thread() {
#if defined(CONFIG_STCP_TESTING) && (CONFIG_STCP_TEST_MODE != 3)
#define STCP_COMPILE_MQTT 0
#else
#define STCP_COMPILE_MQTT 1
#endif

#if STCP_COMPILE_MQTT
    MINFBIG("Initialising & staring MQTT FSM thread...");

    k_sem_init(&g_sem_connack_seen, 0, 1);

    k_thread_create(
        &stpc_mqtt_thread,                 // thread object
        stpc_mqtt_stack,                   // stack
        K_THREAD_STACK_SIZEOF(stpc_mqtt_stack),
        stcp_mqtt_task,               // entry function
        &client,                      // p1
        NULL,                         // p2
        NULL,                         // p3
        MQTT_PRIORITY,                // priority
        0,                            // options
        K_NO_WAIT                     // start delay
    );
#else
    MINFBIG("Testing enabled but not MQTT testing => MQTT FSM not started");
#endif
}

static int stcp_mqtt_do_run_event(struct mqtt_client *client, struct stcp_api *api)
{
    int rc;

    int fd = stcp_api_get_fd(api);

    struct zsock_pollfd fds[1];

    int poll_for = ZSOCK_POLLIN | ZSOCK_POLLERR | ZSOCK_POLLHUP;

    fds[0].fd = fd;
    fds[0].events = poll_for;

    int ret = zsock_poll(fds, 1, STCP_MQTT_POLL_TIMEOUT_MSEC);

    if (ret < 0) {
        LERR("poll error %d", errno);
        return -errno;
    }

    /* timeout -> keepalive */
    if (ret == 0) {
        MDBG("Calling mqtt_live...");
        rc = mqtt_live(client);
        MDBG("Return of mqtt_live, rc: %d / errno: %d", rc, errno);

        if (rc < 0) {
            LERR("mqtt_live error %d", rc);
            return rc;
        }
    }

    if (fds[0].revents & poll_for) {

        MDBG("Calling mqtt_input...");
        rc = mqtt_input(client);
        MDBG("Return of mqtt_input, rc: %d / errno: %d", rc, errno);

        if (rc < 0) {
            LERR("mqtt_input error %d", rc);
            return rc;
        }

    }

    return 0;
}

static const char *get_state_name(enum mqtt_state state) {
#if CONFIG_STCP_DEBUG
    //MDBG("Gettin string for state %d", state);
    switch (state)
    {
        case MQTT_STATE_INITIAL:    return "INITIAL";   
        case MQTT_STATE_IDLE:       return "IDLE";      
        case MQTT_STATE_CONNECT:    return "CONNECT";   
        case MQTT_STATE_SUBSCRIBE:  return "SUBSCRIBE"; 
        case MQTT_STATE_RUNNING:    return "RUNNING";   
        case MQTT_STATE_DISCONNECT: return "DISCONNECT";
        case MQTT_STATE_RECONNECT:  return "RECONNECT"; 
        case MQTT_STATE_WAIT_RETRY: return "WAIT_RETRY";
        default:                    return "UNKNOWN";   
    }
#else
    static char tmp[2];

    tmp[0] = "0";
    tmp[0] += (int)state;
    tmp[1] = 0;

    return tmp;
#endif
}

void stcp_mqtt_task(void *p1, void *p2, void *p3)
{
    int rc;
    struct mqtt_client *clientPtr = p1;
    struct stcp_api *api = clientPtr->transport.stcp.stcp_api_instance;
    static uint32_t loop_cnt = 0;

#if CONFIG_STCP_DEBUG
    static enum mqtt_state last_state = MQTT_STATE_INITIAL;
#endif

    while (1) {

        loop_cnt++;

        //if (loop_cnt % 30 == 0) {
        {
#if CONFIG_STCP_DEBUG
            const char *msg = get_state_name(state);
            MINF("MQTT alive, uptime %u sec, current state %s (%d)", 
                k_uptime_get_32()/1000,
                msg,
                state
            );
#else
            MINF("MQTT alive, uptime %u sec, current state %d", 
                k_uptime_get()/1000,
                state
            );
#endif
        }

#if CONFIG_STCP_DEBUG
        if (state != last_state) {
            MINF("MQTT FSM State change: %s => %s", 
                get_state_name(last_state), 
                get_state_name(state));

            last_state = state;
        } else {
            MWRN("MQTT FSM State: %s", get_state_name(state));
        }
#endif
        switch (state) {

            case MQTT_STATE_INITIAL: 
                MINF("MQTT: @ %s state handler", get_state_name(state));
                state = MQTT_STATE_INITIAL;
                break;

            case MQTT_STATE_IDLE:
                MINF("MQTT: @ %s state handler", get_state_name(state));

                memset(clientPtr, 0, sizeof(*clientPtr));

                stcp_mqtt_reset_connak_event_seen();

                mqtt_client_init(clientPtr);

                state = MQTT_STATE_CONNECT;
                break;

            case MQTT_STATE_CONNECT:

                MINF("MQTT: @ %s state handler", get_state_name(state));

                rc = mqtt_connect_via_stcp(CONFIG_STCP_CONNECT_TO_HOST, CONFIG_STCP_CONNECT_TO_PORT, NULL);

                mqtt_connected = rc == 0;

                if (rc == 0) {
                    MINF("MQTT: connected!");
                    state = MQTT_STATE_SUBSCRIBE;
                } else {
                    MERR("MQTT: connect failed rc=%d errno=%d", rc, errno);
                    state = MQTT_STATE_WAIT_RETRY;
                }


                break;

            case MQTT_STATE_SUBSCRIBE:
                MINF("MQTT: @ %s state handler", get_state_name(state));

                MINF("MQTT: Waiting CONNACK event for %d ms",
                    STCP_MQTT_WAIT_CONNACK_EVENT_FOR_MSEC);
                rc = stcp_mqtt_wait_for_connak_event(
                        STCP_MQTT_WAIT_CONNACK_EVENT_FOR_MSEC
                    );

                if (rc != 0) {
                    // error while waiting for connect => reinit
                    MWRN("Wait for CONNACK timeout => reinit..");
                    state = MQTT_STATE_WAIT_RETRY;
                    break;
                }

                MINF("Starting subscription .....");
                rc = stpc_mqtt_subscribe(clientPtr);
                if (rc < 0) {
                    MWRN("Subscribe failed: %d", rc);
                }

                MINFBIG("Subscription OK");
                state = MQTT_STATE_RUNNING;
                break;


            case MQTT_STATE_RUNNING: {
                static uint32_t last_pub = 0;
                uint32_t now = k_uptime_get_32();
                MINF("MQTT: @ %s state handler", get_state_name(state));

                if (!mqtt_connected) {
                    MWRN("MQTT: connection lost @ running state");
                    state = MQTT_STATE_DISCONNECT;
                    break;
                }

                MINF("MQTT: Doign poll event....");
                rc = stcp_mqtt_do_run_event(clientPtr, api);
                MINF("MQTT: Event ret: %d", rc);

                if (rc < 0) {
                    int isNotError = 0;
                    if (rc == -EINPROGRESS) {
                        MWRN("Client processing ... (EINPROGRESS)");
                        SLEEP_MSEC(100);

                        isNotError = 1;
                    }

                    if (rc == -EAGAIN) {
                        MWRN("Client processing ... (EAGAIN)");
                        SLEEP_MSEC(10);
                        isNotError = 1;
                    }

                    if(!isNotError) {
                        MWRN("Poller ret: %d => State update: Disconnected", rc);
                        state = MQTT_STATE_DISCONNECT;
                        mqtt_connected = 0;
                        break;
                    }

                    /* tarkoituksella, jatkaa debug viestiin.. */
                }
                
                uint32_t diffPub = now - last_pub;
                int publish  = (last_pub == 0);
                    publish |= (diffPub > STCP_MQTT_PUBLISH_INTERVAL_MS);

                if (publish)
                {
                    char timestamp[128];

                    last_pub = now;

                    make_timestamp(timestamp, sizeof(timestamp));

                    CLIENT_LOCK(&client_lock);

                    MDBG("Publishing: %s", timestamp);
                    mqtt_publish_message(
                        "testi",
                        (uint8_t *)timestamp,
                        strlen(timestamp)
                    );
                    
                    rc = mqtt_live(clientPtr);

                    CLIENT_UNLOCK(&client_lock);
                }

                if (rc < 0 && rc != -EAGAIN) {
                    MERR("mqtt_live error @ publish %d", rc);
                    state = MQTT_STATE_DISCONNECT;
                    mqtt_connected = 0;
                }
                break;
            }

            case MQTT_STATE_DISCONNECT:
                MINF("MQTT: @ %s state handler", get_state_name(state));

                mqtt_abort(clientPtr);

                mqtt_connected = 0;
                state = MQTT_STATE_RECONNECT;

                break;


            case MQTT_STATE_RECONNECT:
                MINF("MQTT: @ %s state handler", get_state_name(state));

                rc = stcp_mqtt_reconnect(clientPtr);

                if (rc != 0) {
                    state = MQTT_STATE_WAIT_RETRY;
                    break;
                }

                mqtt_connected = 1;
                state = MQTT_STATE_RUNNING;
                break;

            case MQTT_STATE_WAIT_RETRY:
                MINF("MQTT: @ %s state handler", get_state_name(state));

                MINF("MQTT: retry in 2 seconds");
                SLEEP_SEC(2);

                state = MQTT_STATE_RECONNECT;
                break;
        }
    }
    
    mqtt_dns_info_free();
}
```
