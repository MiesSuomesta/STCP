## STCPv2/RaspberryPI/raspberry-kernel-sources/Kconfig
```kconfig
# SPDX-License-Identifier: GPL-2.0
#
# For a description of the syntax of this configuration file,
# see Documentation/kbuild/kconfig-language.rst.
#
mainmenu "Linux/$(ARCH) $(KERNELVERSION) Kernel Configuration"

source "scripts/Kconfig.include"

source "init/Kconfig"

source "kernel/Kconfig.freezer"

source "fs/Kconfig.binfmt"

source "mm/Kconfig"

source "net/Kconfig"

source "drivers/Kconfig"

source "fs/Kconfig"

source "security/Kconfig"

source "crypto/Kconfig"

source "lib/Kconfig"

source "lib/Kconfig.debug"

source "Documentation/Kconfig"

source "io_uring/Kconfig"

config STCP
	tristate "STCP secure network protocol"
	depends on NET && INET
	depends on IPV6 || !IPV6
	select NET_UDP_TUNNEL
	select DST_CACHE
	select CRYPTO_LIB_CURVE25519
	select CRYPTO_LIB_CHACHA20POLY1305
	select CRYPTO_LIB_UTILS
	help
	  STCP is very secure TCP implementation that will
	  automatically apply AES 256 bit encryption.
```

## STCPv2/kernel/module/Kconfig
```kconfig
config STCP
        tristate "STCP secure network protocol"
        depends on NET && INET
        depends on IPV6 || !IPV6
        select NET_UDP_TUNNEL
        select DST_CACHE
        select CRYPTO_LIB_CURVE25519
        select CRYPTO_LIB_CHACHA20POLY1305
        select CRYPTO_LIB_UTILS
        help
          STCP is very secure TCP implementation that will
          automatically apply AES 256 bit encryption.
```

## STCPv4/zephyr/nordic/app-coap/build-v2-clean/Kconfig/boards/Kconfig
```kconfig
# Load Zephyr board Kconfig descriptions.
osource "/home/pomo/zephyr-stcp/zephyr/boards/nordic/nrf9151dk/Kconfig"
```

## STCPv4/zephyr/nordic/app-mqtt/build-v2-clean/Kconfig/Kconfig.modules
```kconfig
menu "nrf (/home/pomo/zephyr-stcp/nrf)"
osource "$(ZEPHYR_NRF_KCONFIG)"
config ZEPHYR_NRF_MODULE
	bool
	default y
endmenu
menu "mcuboot (/home/pomo/zephyr-stcp/bootloader/mcuboot)"
osource "$(ZEPHYR_MCUBOOT_KCONFIG)"
config ZEPHYR_MCUBOOT_MODULE
	bool
	default y
endmenu
menu "mbedtls (/home/pomo/zephyr-stcp/modules/crypto/mbedtls)"
osource "$(ZEPHYR_MBEDTLS_KCONFIG)"
config ZEPHYR_MBEDTLS_MODULE
	bool
	default y
endmenu
menu "oberon-psa-crypto (/home/pomo/zephyr-stcp/modules/crypto/oberon-psa-crypto)"
osource "/home/pomo/zephyr-stcp/modules/crypto/oberon-psa-crypto/Kconfig.oberon_psa_crypto"
config ZEPHYR_OBERON_PSA_CRYPTO_MODULE
	bool
	default y
endmenu
menu "trusted-firmware-m (/home/pomo/zephyr-stcp/modules/tee/tf-m/trusted-firmware-m)"
osource "$(ZEPHYR_TRUSTED_FIRMWARE_M_KCONFIG)"
config ZEPHYR_TRUSTED_FIRMWARE_M_MODULE
	bool
	default y
endmenu
menu "cjson (/home/pomo/zephyr-stcp/modules/lib/cjson)"
osource "$(ZEPHYR_CJSON_KCONFIG)"
config ZEPHYR_CJSON_MODULE
	bool
	default y
endmenu
menu "azure-sdk-for-c (/home/pomo/zephyr-stcp/modules/lib/azure-sdk-for-c)"
osource "$(ZEPHYR_AZURE_SDK_FOR_C_KCONFIG)"
config ZEPHYR_AZURE_SDK_FOR_C_MODULE
	bool
	default y
endmenu
menu "cirrus-logic (/home/pomo/zephyr-stcp/modules/hal/cirrus-logic)"
osource "/home/pomo/zephyr-stcp/modules/hal/cirrus-logic/Kconfig"
config ZEPHYR_CIRRUS_LOGIC_MODULE
	bool
	default y
endmenu
menu "openthread (/home/pomo/zephyr-stcp/modules/lib/openthread)"
osource "$(ZEPHYR_OPENTHREAD_KCONFIG)"
config ZEPHYR_OPENTHREAD_MODULE
	bool
	default y
endmenu
menu "memfault-firmware-sdk (/home/pomo/zephyr-stcp/modules/lib/memfault-firmware-sdk)"
osource "/home/pomo/zephyr-stcp/modules/lib/memfault-firmware-sdk/ports/zephyr/Kconfig"
config ZEPHYR_MEMFAULT_FIRMWARE_SDK_MODULE
	bool
	default y
endmenu
menu "coremark (/home/pomo/zephyr-stcp/modules/benchmark/coremark)"
osource "$(ZEPHYR_COREMARK_KCONFIG)"
config ZEPHYR_COREMARK_MODULE
	bool
	default y
endmenu
menu "hostap (/home/pomo/zephyr-stcp/modules/lib/hostap)"
osource "$(ZEPHYR_HOSTAP_KCONFIG)"
config ZEPHYR_HOSTAP_MODULE
	bool
	default y
endmenu
menu "canopennode (/home/pomo/zephyr-stcp/modules/lib/canopennode)"
osource "$(ZEPHYR_CANOPENNODE_KCONFIG)"
config ZEPHYR_CANOPENNODE_MODULE
	bool
	default y
endmenu
menu "chre (/home/pomo/zephyr-stcp/modules/lib/chre)"
osource "/home/pomo/zephyr-stcp/modules/lib/chre/platform/zephyr/Kconfig"
config ZEPHYR_CHRE_MODULE
	bool
	default y
endmenu
menu "cmsis (/home/pomo/zephyr-stcp/modules/hal/cmsis)"
osource "$(ZEPHYR_CMSIS_KCONFIG)"
config ZEPHYR_CMSIS_MODULE
	bool
	default y
endmenu
menu "cmsis-dsp (/home/pomo/zephyr-stcp/modules/lib/cmsis-dsp)"
osource "$(ZEPHYR_CMSIS_DSP_KCONFIG)"
config ZEPHYR_CMSIS_DSP_MODULE
	bool
	default y
endmenu
menu "cmsis-nn (/home/pomo/zephyr-stcp/modules/lib/cmsis-nn)"
osource "$(ZEPHYR_CMSIS_NN_KCONFIG)"
config ZEPHYR_CMSIS_NN_MODULE
	bool
	default y
endmenu
menu "cmsis_6 (/home/pomo/zephyr-stcp/modules/hal/cmsis_6)"
osource "$(ZEPHYR_CMSIS_6_KCONFIG)"
config ZEPHYR_CMSIS_6_MODULE
	bool
	default y
endmenu
menu "fatfs (/home/pomo/zephyr-stcp/modules/fs/fatfs)"
osource "$(ZEPHYR_FATFS_KCONFIG)"
config ZEPHYR_FATFS_MODULE
	bool
	default y
endmenu
menu "hal_nordic (/home/pomo/zephyr-stcp/modules/hal/nordic)"
osource "$(ZEPHYR_HAL_NORDIC_KCONFIG)"
config ZEPHYR_HAL_NORDIC_MODULE
	bool
	default y

config ZEPHYR_HAL_NORDIC_MODULE_BLOBS
	bool
endmenu
menu "hal_st (/home/pomo/zephyr-stcp/modules/hal/st)"
osource "$(ZEPHYR_HAL_ST_KCONFIG)"
config ZEPHYR_HAL_ST_MODULE
	bool
	default y
endmenu
menu "hal_tdk (/home/pomo/zephyr-stcp/modules/hal/tdk)"
osource "$(ZEPHYR_HAL_TDK_KCONFIG)"
config ZEPHYR_HAL_TDK_MODULE
	bool
	default y
endmenu
config ZEPHYR_HAL_WURTHELEKTRONIK_MODULE
	bool
	default y
menu "liblc3 (/home/pomo/zephyr-stcp/modules/lib/liblc3)"
osource "$(ZEPHYR_LIBLC3_KCONFIG)"
config ZEPHYR_LIBLC3_MODULE
	bool
	default y
endmenu
config ZEPHYR_LIBMETAL_MODULE
	bool
	default y
menu "libsbc (/home/pomo/zephyr-stcp/modules/lib/libsbc)"
osource "$(ZEPHYR_LIBSBC_KCONFIG)"
config ZEPHYR_LIBSBC_MODULE
	bool
	default y
endmenu
menu "littlefs (/home/pomo/zephyr-stcp/modules/fs/littlefs)"
osource "$(ZEPHYR_LITTLEFS_KCONFIG)"
config ZEPHYR_LITTLEFS_MODULE
	bool
	default y
endmenu
menu "loramac-node (/home/pomo/zephyr-stcp/modules/lib/loramac-node)"
osource "$(ZEPHYR_LORAMAC_NODE_KCONFIG)"
config ZEPHYR_LORAMAC_NODE_MODULE
	bool
	default y
endmenu
menu "lvgl (/home/pomo/zephyr-stcp/modules/lib/gui/lvgl)"
osource "/home/pomo/zephyr-stcp/modules/lib/gui/lvgl/zephyr/Kconfig"
config ZEPHYR_LVGL_MODULE
	bool
	default y
endmenu
config ZEPHYR_MIPI_SYS_T_MODULE
	bool
	default y
menu "nanopb (/home/pomo/zephyr-stcp/modules/lib/nanopb)"
osource "$(ZEPHYR_NANOPB_KCONFIG)"
config ZEPHYR_NANOPB_MODULE
	bool
	default y
endmenu
menu "nrf_wifi (/home/pomo/zephyr-stcp/modules/lib/nrf_wifi)"
osource "$(ZEPHYR_NRF_WIFI_KCONFIG)"
config ZEPHYR_NRF_WIFI_MODULE
	bool
	default y

config ZEPHYR_NRF_WIFI_MODULE_BLOBS
	bool
endmenu
config ZEPHYR_OPEN_AMP_MODULE
	bool
	default y
menu "percepio (/home/pomo/zephyr-stcp/modules/debug/percepio)"
osource "/home/pomo/zephyr-stcp/modules/debug/percepio/zephyr/Kconfig"
config ZEPHYR_PERCEPIO_MODULE
	bool
	default y
endmenu
menu "picolibc (/home/pomo/zephyr-stcp/modules/lib/picolibc)"
osource "/home/pomo/zephyr-stcp/modules/lib/picolibc/zephyr/Kconfig"
config ZEPHYR_PICOLIBC_MODULE
	bool
	default y
endmenu
menu "segger (/home/pomo/zephyr-stcp/modules/debug/segger)"
osource "$(ZEPHYR_SEGGER_KCONFIG)"
config ZEPHYR_SEGGER_MODULE
	bool
	default y
endmenu
config ZEPHYR_TF_M_TESTS_MODULE
	bool
	default y
menu "uoscore-uedhoc (/home/pomo/zephyr-stcp/modules/lib/uoscore-uedhoc)"
osource "$(ZEPHYR_UOSCORE_UEDHOC_KCONFIG)"
config ZEPHYR_UOSCORE_UEDHOC_MODULE
	bool
	default y
endmenu
menu "zcbor (/home/pomo/zephyr-stcp/modules/lib/zcbor)"
osource "$(ZEPHYR_ZCBOR_KCONFIG)"
config ZEPHYR_ZCBOR_MODULE
	bool
	default y
endmenu
menu "module-v2 (/srv/stcp-project/STCP/STCPv2/zephyr/nordic/module-v2)"
osource "/srv/stcp-project/STCP/STCPv2/zephyr/nordic/module-v2/Kconfig"
config ZEPHYR_MODULE_V2_MODULE
	bool
	default y
endmenu
menu "nrfxlib (/home/pomo/zephyr-stcp/nrfxlib)"
osource "/home/pomo/zephyr-stcp/nrfxlib/Kconfig.nrfxlib"
config ZEPHYR_NRFXLIB_MODULE
	bool
	default y
endmenu
config ZEPHYR_NRF_HW_MODELS_MODULE
	bool
	default y
menu "connectedhomeip (/home/pomo/zephyr-stcp/modules/lib/matter)"
osource "/home/pomo/zephyr-stcp/modules/lib/matter/config/nrfconnect/chip-module/Kconfig"
config ZEPHYR_CONNECTEDHOMEIP_MODULE
	bool
	default y
endmenu
```

## STCPv4/zephyr/nordic/app-mqtt/build-v2-clean/Kconfig/arch/Kconfig
```kconfig
# Load Zephyr Arch Kconfig descriptions.
osource "/home/pomo/zephyr-stcp/zephyr/arch/rx/Kconfig"
osource "/home/pomo/zephyr-stcp/zephyr/arch/x86/Kconfig"
osource "/home/pomo/zephyr-stcp/zephyr/arch/xtensa/Kconfig"
osource "/home/pomo/zephyr-stcp/zephyr/arch/sparc/Kconfig"
osource "/home/pomo/zephyr-stcp/zephyr/arch/riscv/Kconfig"
osource "/home/pomo/zephyr-stcp/zephyr/arch/posix/Kconfig"
osource "/home/pomo/zephyr-stcp/zephyr/arch/mips/Kconfig"
osource "/home/pomo/zephyr-stcp/zephyr/arch/arm64/Kconfig"
osource "/home/pomo/zephyr-stcp/zephyr/arch/arm/Kconfig"
osource "/home/pomo/zephyr-stcp/zephyr/arch/arc/Kconfig"
```
